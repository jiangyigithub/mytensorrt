VERSION ""

NS_ :

BS_:

BU_: Central_ECU Radar

BO_ 562 Location_Data_32: 64 Radar
 SG_ Loc_ElevAngleQly_32_004 : 416|8@1+ (1,0) [0|255] ""  Central_ECU
 SG_ Loc_ElevAngleQly_32_003 : 392|8@1+ (1,0) [0|255] ""  Central_ECU
 SG_ Loc_ElevAngleQly_32_002 : 368|8@1+ (1,0) [0|255] ""  Central_ECU
 SG_ Loc_ElevAngleQly_32_001 : 344|8@1+ (1,0) [0|255] ""  Central_ECU
 SG_ Loc_AziAngleQly_32_004 : 408|8@1+ (1,0) [0|255] ""  Central_ECU
 SG_ Loc_AziAngleQly_32_003 : 384|8@1+ (1,0) [0|255] ""  Central_ECU
 SG_ Loc_AziAngleQly_32_002 : 360|8@1+ (1,0) [0|255] ""  Central_ECU
 SG_ Loc_AziAngleQly_32_001 : 336|8@1+ (1,0) [0|255] ""  Central_ECU
 SG_ Loc_RadialDistVeloQly_32_004 : 400|8@1+ (1,0) [0|255] ""  Central_ECU
 SG_ Loc_RadialDistVeloQly_32_003 : 376|8@1+ (1,0) [0|255] ""  Central_ECU
 SG_ Loc_RadialDistVeloQly_32_002 : 352|8@1+ (1,0) [0|255] ""  Central_ECU
 SG_ Loc_RadialDistVeloQly_32_001 : 328|8@1+ (1,0) [0|255] ""  Central_ECU
 SG_ Loc_Validity_32_004 : 327|1@1+ (1,0) [0|1] ""  Central_ECU
 SG_ Loc_Validity_32_003 : 326|1@1+ (1,0) [0|1] ""  Central_ECU
 SG_ Loc_Validity_32_002 : 325|1@1+ (1,0) [0|1] ""  Central_ECU
 SG_ Loc_Validity_32_001 : 324|1@1+ (1,0) [0|1] ""  Central_ECU
 SG_ Loc_32_Blockcnt : 320|4@1+ (1,0) [0|15] ""  Central_ECU
 SG_ Loc_32_CRC : 296|16@1+ (1,0) [0|65535] ""  Central_ECU
 SG_ Loc_32_AliveCtr : 312|8@1+ (1,0) [0|255] ""  Central_ECU
 SG_ Loc_SNR_32_004 : 237|11@1+ (0.0625,0) [0|40] "dB"  Central_ECU
 SG_ Loc_SNR_32_003 : 163|11@1+ (0.0625,0) [0|40] "dB"  Central_ECU
 SG_ Loc_SNR_32_002 : 89|11@1+ (0.0625,0) [0|40] "dB"  Central_ECU
 SG_ Loc_RCS_32_004 : 286|10@1+ (0.125,-50) [-50|70] "dBm^2"  Central_ECU
 SG_ Loc_RCS_32_003 : 212|10@1+ (0.125,-50) [-50|70] "dBm^2"  Central_ECU
 SG_ Loc_RCS_32_002 : 138|10@1+ (0.125,-50) [-50|70] "dBm^2"  Central_ECU
 SG_ Loc_RadialVelo_32_004 : 248|15@1+ (0.0078125,-128) [-128|127] "m/s"  Central_ECU
 SG_ Loc_RadialVelo_32_003 : 174|15@1+ (0.0078125,-128) [-128|127] "m/s"  Central_ECU
 SG_ Loc_RadialVelo_32_002 : 100|15@1+ (0.0078125,-128) [-128|127] "m/s"  Central_ECU
 SG_ Loc_RadialDist_32_004 : 222|15@1+ (0.0078125,0) [0|250] "m"  Central_ECU
 SG_ Loc_RadialDist_32_003 : 148|15@1+ (0.0078125,0) [0|250] "m"  Central_ECU
 SG_ Loc_RadialDist_32_002 : 74|15@1+ (0.0078125,0) [0|250] "m"  Central_ECU
 SG_ Loc_ElevAngle_32_004 : 275|11@1+ (0.001,-0.785) [-0.785|0.785] "rad"  Central_ECU
 SG_ Loc_ElevAngle_32_003 : 201|11@1+ (0.001,-0.785) [-0.785|0.785] "rad"  Central_ECU
 SG_ Loc_ElevAngle_32_002 : 127|11@1+ (0.001,-0.785) [-0.785|0.785] "rad"  Central_ECU
 SG_ Loc_AziAngle_32_004 : 263|12@1+ (0.001,-1.57) [-1.57|1.57] "rad"  Central_ECU
 SG_ Loc_AziAngle_32_003 : 189|12@1+ (0.001,-1.57) [-1.57|1.57] "rad"  Central_ECU
 SG_ Loc_AziAngle_32_002 : 115|12@1+ (0.001,-1.57) [-1.57|1.57] "rad"  Central_ECU
 SG_ Loc_RCS_32_001 : 64|10@1+ (0.125,-50) [-50|70] "dBm^2"  Central_ECU
 SG_ Loc_ElevAngle_32_001 : 53|11@1+ (0.001,-0.785) [-0.785|0.785] "rad"  Central_ECU
 SG_ Loc_AziAngle_32_001 : 41|12@1+ (0.001,-1.57) [-1.57|1.57] "rad"  Central_ECU
 SG_ Loc_RadialVelo_32_001 : 26|15@1+ (0.0078125,-128) [-128|127] "m/s"  Central_ECU
 SG_ Loc_SNR_32_001 : 15|11@1+ (0.0625,0) [0|40] "dB"  Central_ECU
 SG_ Loc_RadialDist_32_001 : 0|15@1+ (0.0078125,0) [0|250] "m"  Central_ECU

BO_ 561 Location_Data_31: 64 Radar
 SG_ Loc_ElevAngleQly_31_004 : 416|8@1+ (1,0) [0|255] ""  Central_ECU
 SG_ Loc_ElevAngleQly_31_003 : 392|8@1+ (1,0) [0|255] ""  Central_ECU
 SG_ Loc_ElevAngleQly_31_002 : 368|8@1+ (1,0) [0|255] ""  Central_ECU
 SG_ Loc_ElevAngleQly_31_001 : 344|8@1+ (1,0) [0|255] ""  Central_ECU
 SG_ Loc_AziAngleQly_31_004 : 408|8@1+ (1,0) [0|255] ""  Central_ECU
 SG_ Loc_AziAngleQly_31_003 : 384|8@1+ (1,0) [0|255] ""  Central_ECU
 SG_ Loc_AziAngleQly_31_002 : 360|8@1+ (1,0) [0|255] ""  Central_ECU
 SG_ Loc_AziAngleQly_31_001 : 336|8@1+ (1,0) [0|255] ""  Central_ECU
 SG_ Loc_RadialDistVeloQly_31_004 : 400|8@1+ (1,0) [0|255] ""  Central_ECU
 SG_ Loc_RadialDistVeloQly_31_003 : 376|8@1+ (1,0) [0|255] ""  Central_ECU
 SG_ Loc_RadialDistVeloQly_31_002 : 352|8@1+ (1,0) [0|255] ""  Central_ECU
 SG_ Loc_RadialDistVeloQly_31_001 : 328|8@1+ (1,0) [0|255] ""  Central_ECU
 SG_ Loc_Validity_31_004 : 327|1@1+ (1,0) [0|1] ""  Central_ECU
 SG_ Loc_Validity_31_003 : 326|1@1+ (1,0) [0|1] ""  Central_ECU
 SG_ Loc_Validity_31_002 : 325|1@1+ (1,0) [0|1] ""  Central_ECU
 SG_ Loc_Validity_31_001 : 324|1@1+ (1,0) [0|1] ""  Central_ECU
 SG_ Loc_31_Blockcnt : 320|4@1+ (1,0) [0|15] ""  Central_ECU
 SG_ Loc_31_CRC : 296|16@1+ (1,0) [0|65535] ""  Central_ECU
 SG_ Loc_31_AliveCtr : 312|8@1+ (1,0) [0|255] ""  Central_ECU
 SG_ Loc_SNR_31_004 : 237|11@1+ (0.0625,0) [0|40] "dB"  Central_ECU
 SG_ Loc_SNR_31_003 : 163|11@1+ (0.0625,0) [0|40] "dB"  Central_ECU
 SG_ Loc_SNR_31_002 : 89|11@1+ (0.0625,0) [0|40] "dB"  Central_ECU
 SG_ Loc_RCS_31_004 : 286|10@1+ (0.125,-50) [-50|70] "dBm^2"  Central_ECU
 SG_ Loc_RCS_31_003 : 212|10@1+ (0.125,-50) [-50|70] "dBm^2"  Central_ECU
 SG_ Loc_RCS_31_002 : 138|10@1+ (0.125,-50) [-50|70] "dBm^2"  Central_ECU
 SG_ Loc_RadialVelo_31_004 : 248|15@1+ (0.0078125,-128) [-128|127] "m/s"  Central_ECU
 SG_ Loc_RadialVelo_31_003 : 174|15@1+ (0.0078125,-128) [-128|127] "m/s"  Central_ECU
 SG_ Loc_RadialVelo_31_002 : 100|15@1+ (0.0078125,-128) [-128|127] "m/s"  Central_ECU
 SG_ Loc_RadialDist_31_004 : 222|15@1+ (0.0078125,0) [0|250] "m"  Central_ECU
 SG_ Loc_RadialDist_31_003 : 148|15@1+ (0.0078125,0) [0|250] "m"  Central_ECU
 SG_ Loc_RadialDist_31_002 : 74|15@1+ (0.0078125,0) [0|250] "m"  Central_ECU
 SG_ Loc_ElevAngle_31_004 : 275|11@1+ (0.001,-0.785) [-0.785|0.785] "rad"  Central_ECU
 SG_ Loc_ElevAngle_31_003 : 201|11@1+ (0.001,-0.785) [-0.785|0.785] "rad"  Central_ECU
 SG_ Loc_ElevAngle_31_002 : 127|11@1+ (0.001,-0.785) [-0.785|0.785] "rad"  Central_ECU
 SG_ Loc_AziAngle_31_004 : 263|12@1+ (0.001,-1.57) [-1.57|1.57] "rad"  Central_ECU
 SG_ Loc_AziAngle_31_003 : 189|12@1+ (0.001,-1.57) [-1.57|1.57] "rad"  Central_ECU
 SG_ Loc_AziAngle_31_002 : 115|12@1+ (0.001,-1.57) [-1.57|1.57] "rad"  Central_ECU
 SG_ Loc_RCS_31_001 : 64|10@1+ (0.125,-50) [-50|70] "dBm^2"  Central_ECU
 SG_ Loc_ElevAngle_31_001 : 53|11@1+ (0.001,-0.785) [-0.785|0.785] "rad"  Central_ECU
 SG_ Loc_AziAngle_31_001 : 41|12@1+ (0.001,-1.57) [-1.57|1.57] "rad"  Central_ECU
 SG_ Loc_RadialVelo_31_001 : 26|15@1+ (0.0078125,-128) [-128|127] "m/s"  Central_ECU
 SG_ Loc_SNR_31_001 : 15|11@1+ (0.0625,0) [0|40] "dB"  Central_ECU
 SG_ Loc_RadialDist_31_001 : 0|15@1+ (0.0078125,0) [0|250] "m"  Central_ECU

BO_ 560 Location_Data_30: 64 Radar
 SG_ Loc_ElevAngleQly_30_004 : 416|8@1+ (1,0) [0|255] ""  Central_ECU
 SG_ Loc_ElevAngleQly_30_003 : 392|8@1+ (1,0) [0|255] ""  Central_ECU
 SG_ Loc_ElevAngleQly_30_002 : 368|8@1+ (1,0) [0|255] ""  Central_ECU
 SG_ Loc_ElevAngleQly_30_001 : 344|8@1+ (1,0) [0|255] ""  Central_ECU
 SG_ Loc_AziAngleQly_30_004 : 408|8@1+ (1,0) [0|255] ""  Central_ECU
 SG_ Loc_AziAngleQly_30_003 : 384|8@1+ (1,0) [0|255] ""  Central_ECU
 SG_ Loc_AziAngleQly_30_002 : 360|8@1+ (1,0) [0|255] ""  Central_ECU
 SG_ Loc_AziAngleQly_30_001 : 336|8@1+ (1,0) [0|255] ""  Central_ECU
 SG_ Loc_RadialDistVeloQly_30_004 : 400|8@1+ (1,0) [0|255] ""  Central_ECU
 SG_ Loc_RadialDistVeloQly_30_003 : 376|8@1+ (1,0) [0|255] ""  Central_ECU
 SG_ Loc_RadialDistVeloQly_30_002 : 352|8@1+ (1,0) [0|255] ""  Central_ECU
 SG_ Loc_RadialDistVeloQly_30_001 : 328|8@1+ (1,0) [0|255] ""  Central_ECU
 SG_ Loc_Validity_30_004 : 327|1@1+ (1,0) [0|1] ""  Central_ECU
 SG_ Loc_Validity_30_003 : 326|1@1+ (1,0) [0|1] ""  Central_ECU
 SG_ Loc_Validity_30_002 : 325|1@1+ (1,0) [0|1] ""  Central_ECU
 SG_ Loc_Validity_30_001 : 324|1@1+ (1,0) [0|1] ""  Central_ECU
 SG_ Loc_30_Blockcnt : 320|4@1+ (1,0) [0|15] ""  Central_ECU
 SG_ Loc_30_CRC : 296|16@1+ (1,0) [0|65535] ""  Central_ECU
 SG_ Loc_30_AliveCtr : 312|8@1+ (1,0) [0|255] ""  Central_ECU
 SG_ Loc_SNR_30_004 : 237|11@1+ (0.0625,0) [0|40] "dB"  Central_ECU
 SG_ Loc_SNR_30_003 : 163|11@1+ (0.0625,0) [0|40] "dB"  Central_ECU
 SG_ Loc_SNR_30_002 : 89|11@1+ (0.0625,0) [0|40] "dB"  Central_ECU
 SG_ Loc_RCS_30_004 : 286|10@1+ (0.125,-50) [-50|70] "dBm^2"  Central_ECU
 SG_ Loc_RCS_30_003 : 212|10@1+ (0.125,-50) [-50|70] "dBm^2"  Central_ECU
 SG_ Loc_RCS_30_002 : 138|10@1+ (0.125,-50) [-50|70] "dBm^2"  Central_ECU
 SG_ Loc_RadialVelo_30_004 : 248|15@1+ (0.0078125,-128) [-128|127] "m/s"  Central_ECU
 SG_ Loc_RadialVelo_30_003 : 174|15@1+ (0.0078125,-128) [-128|127] "m/s"  Central_ECU
 SG_ Loc_RadialVelo_30_002 : 100|15@1+ (0.0078125,-128) [-128|127] "m/s"  Central_ECU
 SG_ Loc_RadialDist_30_004 : 222|15@1+ (0.0078125,0) [0|250] "m"  Central_ECU
 SG_ Loc_RadialDist_30_003 : 148|15@1+ (0.0078125,0) [0|250] "m"  Central_ECU
 SG_ Loc_RadialDist_30_002 : 74|15@1+ (0.0078125,0) [0|250] "m"  Central_ECU
 SG_ Loc_ElevAngle_30_004 : 275|11@1+ (0.001,-0.785) [-0.785|0.785] "rad"  Central_ECU
 SG_ Loc_ElevAngle_30_003 : 201|11@1+ (0.001,-0.785) [-0.785|0.785] "rad"  Central_ECU
 SG_ Loc_ElevAngle_30_002 : 127|11@1+ (0.001,-0.785) [-0.785|0.785] "rad"  Central_ECU
 SG_ Loc_AziAngle_30_004 : 263|12@1+ (0.001,-1.57) [-1.57|1.57] "rad"  Central_ECU
 SG_ Loc_AziAngle_30_003 : 189|12@1+ (0.001,-1.57) [-1.57|1.57] "rad"  Central_ECU
 SG_ Loc_AziAngle_30_002 : 115|12@1+ (0.001,-1.57) [-1.57|1.57] "rad"  Central_ECU
 SG_ Loc_RCS_30_001 : 64|10@1+ (0.125,-50) [-50|70] "dBm^2"  Central_ECU
 SG_ Loc_ElevAngle_30_001 : 53|11@1+ (0.001,-0.785) [-0.785|0.785] "rad"  Central_ECU
 SG_ Loc_AziAngle_30_001 : 41|12@1+ (0.001,-1.57) [-1.57|1.57] "rad"  Central_ECU
 SG_ Loc_RadialVelo_30_001 : 26|15@1+ (0.0078125,-128) [-128|127] "m/s"  Central_ECU
 SG_ Loc_SNR_30_001 : 15|11@1+ (0.0625,0) [0|40] "dB"  Central_ECU
 SG_ Loc_RadialDist_30_001 : 0|15@1+ (0.0078125,0) [0|250] "m"  Central_ECU

BO_ 553 Location_Data_29: 64 Radar
 SG_ Loc_ElevAngleQly_29_004 : 416|8@1+ (1,0) [0|255] ""  Central_ECU
 SG_ Loc_ElevAngleQly_29_003 : 392|8@1+ (1,0) [0|255] ""  Central_ECU
 SG_ Loc_ElevAngleQly_29_002 : 368|8@1+ (1,0) [0|255] ""  Central_ECU
 SG_ Loc_ElevAngleQly_29_001 : 344|8@1+ (1,0) [0|255] ""  Central_ECU
 SG_ Loc_AziAngleQly_29_004 : 408|8@1+ (1,0) [0|255] ""  Central_ECU
 SG_ Loc_AziAngleQly_29_003 : 384|8@1+ (1,0) [0|255] ""  Central_ECU
 SG_ Loc_AziAngleQly_29_002 : 360|8@1+ (1,0) [0|255] ""  Central_ECU
 SG_ Loc_AziAngleQly_29_001 : 336|8@1+ (1,0) [0|255] ""  Central_ECU
 SG_ Loc_RadialDistVeloQly_29_004 : 400|8@1+ (1,0) [0|255] ""  Central_ECU
 SG_ Loc_RadialDistVeloQly_29_003 : 376|8@1+ (1,0) [0|255] ""  Central_ECU
 SG_ Loc_RadialDistVeloQly_29_002 : 352|8@1+ (1,0) [0|255] ""  Central_ECU
 SG_ Loc_RadialDistVeloQly_29_001 : 328|8@1+ (1,0) [0|255] ""  Central_ECU
 SG_ Loc_Validity_29_004 : 327|1@1+ (1,0) [0|1] ""  Central_ECU
 SG_ Loc_Validity_29_003 : 326|1@1+ (1,0) [0|1] ""  Central_ECU
 SG_ Loc_Validity_29_002 : 325|1@1+ (1,0) [0|1] ""  Central_ECU
 SG_ Loc_Validity_29_001 : 324|1@1+ (1,0) [0|1] ""  Central_ECU
 SG_ Loc_29_Blockcnt : 320|4@1+ (1,0) [0|15] ""  Central_ECU
 SG_ Loc_29_CRC : 296|16@1+ (1,0) [0|65535] ""  Central_ECU
 SG_ Loc_29_AliveCtr : 312|8@1+ (1,0) [0|255] ""  Central_ECU
 SG_ Loc_SNR_29_004 : 237|11@1+ (0.0625,0) [0|40] "dB"  Central_ECU
 SG_ Loc_SNR_29_003 : 163|11@1+ (0.0625,0) [0|40] "dB"  Central_ECU
 SG_ Loc_SNR_29_002 : 89|11@1+ (0.0625,0) [0|40] "dB"  Central_ECU
 SG_ Loc_RCS_29_004 : 286|10@1+ (0.125,-50) [-50|70] "dBm^2"  Central_ECU
 SG_ Loc_RCS_29_003 : 212|10@1+ (0.125,-50) [-50|70] "dBm^2"  Central_ECU
 SG_ Loc_RCS_29_002 : 138|10@1+ (0.125,-50) [-50|70] "dBm^2"  Central_ECU
 SG_ Loc_RadialVelo_29_004 : 248|15@1+ (0.0078125,-128) [-128|127] "m/s"  Central_ECU
 SG_ Loc_RadialVelo_29_003 : 174|15@1+ (0.0078125,-128) [-128|127] "m/s"  Central_ECU
 SG_ Loc_RadialVelo_29_002 : 100|15@1+ (0.0078125,-128) [-128|127] "m/s"  Central_ECU
 SG_ Loc_RadialDist_29_004 : 222|15@1+ (0.0078125,0) [0|250] "m"  Central_ECU
 SG_ Loc_RadialDist_29_003 : 148|15@1+ (0.0078125,0) [0|250] "m"  Central_ECU
 SG_ Loc_RadialDist_29_002 : 74|15@1+ (0.0078125,0) [0|250] "m"  Central_ECU
 SG_ Loc_ElevAngle_29_004 : 275|11@1+ (0.001,-0.785) [-0.785|0.785] "rad"  Central_ECU
 SG_ Loc_ElevAngle_29_003 : 201|11@1+ (0.001,-0.785) [-0.785|0.785] "rad"  Central_ECU
 SG_ Loc_ElevAngle_29_002 : 127|11@1+ (0.001,-0.785) [-0.785|0.785] "rad"  Central_ECU
 SG_ Loc_AziAngle_29_004 : 263|12@1+ (0.001,-1.57) [-1.57|1.57] "rad"  Central_ECU
 SG_ Loc_AziAngle_29_003 : 189|12@1+ (0.001,-1.57) [-1.57|1.57] "rad"  Central_ECU
 SG_ Loc_AziAngle_29_002 : 115|12@1+ (0.001,-1.57) [-1.57|1.57] "rad"  Central_ECU
 SG_ Loc_RCS_29_001 : 64|10@1+ (0.125,-50) [-50|70] "dBm^2"  Central_ECU
 SG_ Loc_ElevAngle_29_001 : 53|11@1+ (0.001,-0.785) [-0.785|0.785] "rad"  Central_ECU
 SG_ Loc_AziAngle_29_001 : 41|12@1+ (0.001,-1.57) [-1.57|1.57] "rad"  Central_ECU
 SG_ Loc_RadialVelo_29_001 : 26|15@1+ (0.0078125,-128) [-128|127] "m/s"  Central_ECU
 SG_ Loc_SNR_29_001 : 15|11@1+ (0.0625,0) [0|40] "dB"  Central_ECU
 SG_ Loc_RadialDist_29_001 : 0|15@1+ (0.0078125,0) [0|250] "m"  Central_ECU

BO_ 552 Location_Data_28: 64 Radar
 SG_ Loc_ElevAngleQly_28_004 : 416|8@1+ (1,0) [0|255] ""  Central_ECU
 SG_ Loc_ElevAngleQly_28_003 : 392|8@1+ (1,0) [0|255] ""  Central_ECU
 SG_ Loc_ElevAngleQly_28_002 : 368|8@1+ (1,0) [0|255] ""  Central_ECU
 SG_ Loc_ElevAngleQly_28_001 : 344|8@1+ (1,0) [0|255] ""  Central_ECU
 SG_ Loc_AziAngleQly_28_004 : 408|8@1+ (1,0) [0|255] ""  Central_ECU
 SG_ Loc_AziAngleQly_28_003 : 384|8@1+ (1,0) [0|255] ""  Central_ECU
 SG_ Loc_AziAngleQly_28_002 : 360|8@1+ (1,0) [0|255] ""  Central_ECU
 SG_ Loc_AziAngleQly_28_001 : 336|8@1+ (1,0) [0|255] ""  Central_ECU
 SG_ Loc_RadialDistVeloQly_28_004 : 400|8@1+ (1,0) [0|255] ""  Central_ECU
 SG_ Loc_RadialDistVeloQly_28_003 : 376|8@1+ (1,0) [0|255] ""  Central_ECU
 SG_ Loc_RadialDistVeloQly_28_002 : 352|8@1+ (1,0) [0|255] ""  Central_ECU
 SG_ Loc_RadialDistVeloQly_28_001 : 328|8@1+ (1,0) [0|255] ""  Central_ECU
 SG_ Loc_Validity_28_004 : 327|1@1+ (1,0) [0|1] ""  Central_ECU
 SG_ Loc_Validity_28_003 : 326|1@1+ (1,0) [0|1] ""  Central_ECU
 SG_ Loc_Validity_28_002 : 325|1@1+ (1,0) [0|1] ""  Central_ECU
 SG_ Loc_Validity_28_001 : 324|1@1+ (1,0) [0|1] ""  Central_ECU
 SG_ Loc_28_Blockcnt : 320|4@1+ (1,0) [0|15] ""  Central_ECU
 SG_ Loc_28_CRC : 296|16@1+ (1,0) [0|65535] ""  Central_ECU
 SG_ Loc_28_AliveCtr : 312|8@1+ (1,0) [0|255] ""  Central_ECU
 SG_ Loc_SNR_28_004 : 237|11@1+ (0.0625,0) [0|40] "dB"  Central_ECU
 SG_ Loc_SNR_28_003 : 163|11@1+ (0.0625,0) [0|40] "dB"  Central_ECU
 SG_ Loc_SNR_28_002 : 89|11@1+ (0.0625,0) [0|40] "dB"  Central_ECU
 SG_ Loc_RCS_28_004 : 286|10@1+ (0.125,-50) [-50|70] "dBm^2"  Central_ECU
 SG_ Loc_RCS_28_003 : 212|10@1+ (0.125,-50) [-50|70] "dBm^2"  Central_ECU
 SG_ Loc_RCS_28_002 : 138|10@1+ (0.125,-50) [-50|70] "dBm^2"  Central_ECU
 SG_ Loc_RadialVelo_28_004 : 248|15@1+ (0.0078125,-128) [-128|127] "m/s"  Central_ECU
 SG_ Loc_RadialVelo_28_003 : 174|15@1+ (0.0078125,-128) [-128|127] "m/s"  Central_ECU
 SG_ Loc_RadialVelo_28_002 : 100|15@1+ (0.0078125,-128) [-128|127] "m/s"  Central_ECU
 SG_ Loc_RadialDist_28_004 : 222|15@1+ (0.0078125,0) [0|250] "m"  Central_ECU
 SG_ Loc_RadialDist_28_003 : 148|15@1+ (0.0078125,0) [0|250] "m"  Central_ECU
 SG_ Loc_RadialDist_28_002 : 74|15@1+ (0.0078125,0) [0|250] "m"  Central_ECU
 SG_ Loc_ElevAngle_28_004 : 275|11@1+ (0.001,-0.785) [-0.785|0.785] "rad"  Central_ECU
 SG_ Loc_ElevAngle_28_003 : 201|11@1+ (0.001,-0.785) [-0.785|0.785] "rad"  Central_ECU
 SG_ Loc_ElevAngle_28_002 : 127|11@1+ (0.001,-0.785) [-0.785|0.785] "rad"  Central_ECU
 SG_ Loc_AziAngle_28_004 : 263|12@1+ (0.001,-1.57) [-1.57|1.57] "rad"  Central_ECU
 SG_ Loc_AziAngle_28_003 : 189|12@1+ (0.001,-1.57) [-1.57|1.57] "rad"  Central_ECU
 SG_ Loc_AziAngle_28_002 : 115|12@1+ (0.001,-1.57) [-1.57|1.57] "rad"  Central_ECU
 SG_ Loc_RCS_28_001 : 64|10@1+ (0.125,-50) [-50|70] "dBm^2"  Central_ECU
 SG_ Loc_ElevAngle_28_001 : 53|11@1+ (0.001,-0.785) [-0.785|0.785] "rad"  Central_ECU
 SG_ Loc_AziAngle_28_001 : 41|12@1+ (0.001,-1.57) [-1.57|1.57] "rad"  Central_ECU
 SG_ Loc_RadialVelo_28_001 : 26|15@1+ (0.0078125,-128) [-128|127] "m/s"  Central_ECU
 SG_ Loc_SNR_28_001 : 15|11@1+ (0.0625,0) [0|40] "dB"  Central_ECU
 SG_ Loc_RadialDist_28_001 : 0|15@1+ (0.0078125,0) [0|250] "m"  Central_ECU

BO_ 551 Location_Data_27: 64 Radar
 SG_ Loc_ElevAngleQly_27_004 : 416|8@1+ (1,0) [0|255] ""  Central_ECU
 SG_ Loc_ElevAngleQly_27_003 : 392|8@1+ (1,0) [0|255] ""  Central_ECU
 SG_ Loc_ElevAngleQly_27_002 : 368|8@1+ (1,0) [0|255] ""  Central_ECU
 SG_ Loc_ElevAngleQly_27_001 : 344|8@1+ (1,0) [0|255] ""  Central_ECU
 SG_ Loc_AziAngleQly_27_004 : 408|8@1+ (1,0) [0|255] ""  Central_ECU
 SG_ Loc_AziAngleQly_27_003 : 384|8@1+ (1,0) [0|255] ""  Central_ECU
 SG_ Loc_AziAngleQly_27_002 : 360|8@1+ (1,0) [0|255] ""  Central_ECU
 SG_ Loc_AziAngleQly_27_001 : 336|8@1+ (1,0) [0|255] ""  Central_ECU
 SG_ Loc_RadialDistVeloQly_27_004 : 400|8@1+ (1,0) [0|255] ""  Central_ECU
 SG_ Loc_RadialDistVeloQly_27_003 : 376|8@1+ (1,0) [0|255] ""  Central_ECU
 SG_ Loc_RadialDistVeloQly_27_002 : 352|8@1+ (1,0) [0|255] ""  Central_ECU
 SG_ Loc_RadialDistVeloQly_27_001 : 328|8@1+ (1,0) [0|255] ""  Central_ECU
 SG_ Loc_Validity_27_004 : 327|1@1+ (1,0) [0|1] ""  Central_ECU
 SG_ Loc_Validity_27_003 : 326|1@1+ (1,0) [0|1] ""  Central_ECU
 SG_ Loc_Validity_27_002 : 325|1@1+ (1,0) [0|1] ""  Central_ECU
 SG_ Loc_Validity_27_001 : 324|1@1+ (1,0) [0|1] ""  Central_ECU
 SG_ Loc_27_Blockcnt : 320|4@1+ (1,0) [0|15] ""  Central_ECU
 SG_ Loc_27_CRC : 296|16@1+ (1,0) [0|65535] ""  Central_ECU
 SG_ Loc_27_AliveCtr : 312|8@1+ (1,0) [0|255] ""  Central_ECU
 SG_ Loc_SNR_27_004 : 237|11@1+ (0.0625,0) [0|40] "dB"  Central_ECU
 SG_ Loc_SNR_27_003 : 163|11@1+ (0.0625,0) [0|40] "dB"  Central_ECU
 SG_ Loc_SNR_27_002 : 89|11@1+ (0.0625,0) [0|40] "dB"  Central_ECU
 SG_ Loc_RCS_27_004 : 286|10@1+ (0.125,-50) [-50|70] "dBm^2"  Central_ECU
 SG_ Loc_RCS_27_003 : 212|10@1+ (0.125,-50) [-50|70] "dBm^2"  Central_ECU
 SG_ Loc_RCS_27_002 : 138|10@1+ (0.125,-50) [-50|70] "dBm^2"  Central_ECU
 SG_ Loc_RadialVelo_27_004 : 248|15@1+ (0.0078125,-128) [-128|127] "m/s"  Central_ECU
 SG_ Loc_RadialVelo_27_003 : 174|15@1+ (0.0078125,-128) [-128|127] "m/s"  Central_ECU
 SG_ Loc_RadialVelo_27_002 : 100|15@1+ (0.0078125,-128) [-128|127] "m/s"  Central_ECU
 SG_ Loc_RadialDist_27_004 : 222|15@1+ (0.0078125,0) [0|250] "m"  Central_ECU
 SG_ Loc_RadialDist_27_003 : 148|15@1+ (0.0078125,0) [0|250] "m"  Central_ECU
 SG_ Loc_RadialDist_27_002 : 74|15@1+ (0.0078125,0) [0|250] "m"  Central_ECU
 SG_ Loc_ElevAngle_27_004 : 275|11@1+ (0.001,-0.785) [-0.785|0.785] "rad"  Central_ECU
 SG_ Loc_ElevAngle_27_003 : 201|11@1+ (0.001,-0.785) [-0.785|0.785] "rad"  Central_ECU
 SG_ Loc_ElevAngle_27_002 : 127|11@1+ (0.001,-0.785) [-0.785|0.785] "rad"  Central_ECU
 SG_ Loc_AziAngle_27_004 : 263|12@1+ (0.001,-1.57) [-1.57|1.57] "rad"  Central_ECU
 SG_ Loc_AziAngle_27_003 : 189|12@1+ (0.001,-1.57) [-1.57|1.57] "rad"  Central_ECU
 SG_ Loc_AziAngle_27_002 : 115|12@1+ (0.001,-1.57) [-1.57|1.57] "rad"  Central_ECU
 SG_ Loc_RCS_27_001 : 64|10@1+ (0.125,-50) [-50|70] "dBm^2"  Central_ECU
 SG_ Loc_ElevAngle_27_001 : 53|11@1+ (0.001,-0.785) [-0.785|0.785] "rad"  Central_ECU
 SG_ Loc_AziAngle_27_001 : 41|12@1+ (0.001,-1.57) [-1.57|1.57] "rad"  Central_ECU
 SG_ Loc_RadialVelo_27_001 : 26|15@1+ (0.0078125,-128) [-128|127] "m/s"  Central_ECU
 SG_ Loc_SNR_27_001 : 15|11@1+ (0.0625,0) [0|40] "dB"  Central_ECU
 SG_ Loc_RadialDist_27_001 : 0|15@1+ (0.0078125,0) [0|250] "m"  Central_ECU

BO_ 550 Location_Data_26: 64 Radar
 SG_ Loc_ElevAngleQly_26_004 : 416|8@1+ (1,0) [0|255] ""  Central_ECU
 SG_ Loc_ElevAngleQly_26_003 : 392|8@1+ (1,0) [0|255] ""  Central_ECU
 SG_ Loc_ElevAngleQly_26_002 : 368|8@1+ (1,0) [0|255] ""  Central_ECU
 SG_ Loc_ElevAngleQly_26_001 : 344|8@1+ (1,0) [0|255] ""  Central_ECU
 SG_ Loc_AziAngleQly_26_004 : 408|8@1+ (1,0) [0|255] ""  Central_ECU
 SG_ Loc_AziAngleQly_26_003 : 384|8@1+ (1,0) [0|255] ""  Central_ECU
 SG_ Loc_AziAngleQly_26_002 : 360|8@1+ (1,0) [0|255] ""  Central_ECU
 SG_ Loc_AziAngleQly_26_001 : 336|8@1+ (1,0) [0|255] ""  Central_ECU
 SG_ Loc_RadialDistVeloQly_26_004 : 400|8@1+ (1,0) [0|255] ""  Central_ECU
 SG_ Loc_RadialDistVeloQly_26_003 : 376|8@1+ (1,0) [0|255] ""  Central_ECU
 SG_ Loc_RadialDistVeloQly_26_002 : 352|8@1+ (1,0) [0|255] ""  Central_ECU
 SG_ Loc_RadialDistVeloQly_26_001 : 328|8@1+ (1,0) [0|255] ""  Central_ECU
 SG_ Loc_Validity_26_004 : 327|1@1+ (1,0) [0|1] ""  Central_ECU
 SG_ Loc_Validity_26_003 : 326|1@1+ (1,0) [0|1] ""  Central_ECU
 SG_ Loc_Validity_26_002 : 325|1@1+ (1,0) [0|1] ""  Central_ECU
 SG_ Loc_Validity_26_001 : 324|1@1+ (1,0) [0|1] ""  Central_ECU
 SG_ Loc_26_Blockcnt : 320|4@1+ (1,0) [0|15] ""  Central_ECU
 SG_ Loc_26_CRC : 296|16@1+ (1,0) [0|65535] ""  Central_ECU
 SG_ Loc_26_AliveCtr : 312|8@1+ (1,0) [0|255] ""  Central_ECU
 SG_ Loc_SNR_26_004 : 237|11@1+ (0.0625,0) [0|40] "dB"  Central_ECU
 SG_ Loc_SNR_26_003 : 163|11@1+ (0.0625,0) [0|40] "dB"  Central_ECU
 SG_ Loc_SNR_26_002 : 89|11@1+ (0.0625,0) [0|40] "dB"  Central_ECU
 SG_ Loc_RCS_26_004 : 286|10@1+ (0.125,-50) [-50|70] "dBm^2"  Central_ECU
 SG_ Loc_RCS_26_003 : 212|10@1+ (0.125,-50) [-50|70] "dBm^2"  Central_ECU
 SG_ Loc_RCS_26_002 : 138|10@1+ (0.125,-50) [-50|70] "dBm^2"  Central_ECU
 SG_ Loc_RadialVelo_26_004 : 248|15@1+ (0.0078125,-128) [-128|127] "m/s"  Central_ECU
 SG_ Loc_RadialVelo_26_003 : 174|15@1+ (0.0078125,-128) [-128|127] "m/s"  Central_ECU
 SG_ Loc_RadialVelo_26_002 : 100|15@1+ (0.0078125,-128) [-128|127] "m/s"  Central_ECU
 SG_ Loc_RadialDist_26_004 : 222|15@1+ (0.0078125,0) [0|250] "m"  Central_ECU
 SG_ Loc_RadialDist_26_003 : 148|15@1+ (0.0078125,0) [0|250] "m"  Central_ECU
 SG_ Loc_RadialDist_26_002 : 74|15@1+ (0.0078125,0) [0|250] "m"  Central_ECU
 SG_ Loc_ElevAngle_26_004 : 275|11@1+ (0.001,-0.785) [-0.785|0.785] "rad"  Central_ECU
 SG_ Loc_ElevAngle_26_003 : 201|11@1+ (0.001,-0.785) [-0.785|0.785] "rad"  Central_ECU
 SG_ Loc_ElevAngle_26_002 : 127|11@1+ (0.001,-0.785) [-0.785|0.785] "rad"  Central_ECU
 SG_ Loc_AziAngle_26_004 : 263|12@1+ (0.001,-1.57) [-1.57|1.57] "rad"  Central_ECU
 SG_ Loc_AziAngle_26_003 : 189|12@1+ (0.001,-1.57) [-1.57|1.57] "rad"  Central_ECU
 SG_ Loc_AziAngle_26_002 : 115|12@1+ (0.001,-1.57) [-1.57|1.57] "rad"  Central_ECU
 SG_ Loc_RCS_26_001 : 64|10@1+ (0.125,-50) [-50|70] "dBm^2"  Central_ECU
 SG_ Loc_ElevAngle_26_001 : 53|11@1+ (0.001,-0.785) [-0.785|0.785] "rad"  Central_ECU
 SG_ Loc_AziAngle_26_001 : 41|12@1+ (0.001,-1.57) [-1.57|1.57] "rad"  Central_ECU
 SG_ Loc_RadialVelo_26_001 : 26|15@1+ (0.0078125,-128) [-128|127] "m/s"  Central_ECU
 SG_ Loc_SNR_26_001 : 15|11@1+ (0.0625,0) [0|40] "dB"  Central_ECU
 SG_ Loc_RadialDist_26_001 : 0|15@1+ (0.0078125,0) [0|250] "m"  Central_ECU

BO_ 549 Location_Data_25: 64 Radar
 SG_ Loc_ElevAngleQly_25_004 : 416|8@1+ (1,0) [0|255] ""  Central_ECU
 SG_ Loc_ElevAngleQly_25_003 : 392|8@1+ (1,0) [0|255] ""  Central_ECU
 SG_ Loc_ElevAngleQly_25_002 : 368|8@1+ (1,0) [0|255] ""  Central_ECU
 SG_ Loc_ElevAngleQly_25_001 : 344|8@1+ (1,0) [0|255] ""  Central_ECU
 SG_ Loc_AziAngleQly_25_004 : 408|8@1+ (1,0) [0|255] ""  Central_ECU
 SG_ Loc_AziAngleQly_25_003 : 384|8@1+ (1,0) [0|255] ""  Central_ECU
 SG_ Loc_AziAngleQly_25_002 : 360|8@1+ (1,0) [0|255] ""  Central_ECU
 SG_ Loc_AziAngleQly_25_001 : 336|8@1+ (1,0) [0|255] ""  Central_ECU
 SG_ Loc_RadialDistVeloQly_25_004 : 400|8@1+ (1,0) [0|255] ""  Central_ECU
 SG_ Loc_RadialDistVeloQly_25_003 : 376|8@1+ (1,0) [0|255] ""  Central_ECU
 SG_ Loc_RadialDistVeloQly_25_002 : 352|8@1+ (1,0) [0|255] ""  Central_ECU
 SG_ Loc_RadialDistVeloQly_25_001 : 328|8@1+ (1,0) [0|255] ""  Central_ECU
 SG_ Loc_Validity_25_004 : 327|1@1+ (1,0) [0|1] ""  Central_ECU
 SG_ Loc_Validity_25_003 : 326|1@1+ (1,0) [0|1] ""  Central_ECU
 SG_ Loc_Validity_25_002 : 325|1@1+ (1,0) [0|1] ""  Central_ECU
 SG_ Loc_Validity_25_001 : 324|1@1+ (1,0) [0|1] ""  Central_ECU
 SG_ Loc_25_Blockcnt : 320|4@1+ (1,0) [0|15] ""  Central_ECU
 SG_ Loc_25_CRC : 296|16@1+ (1,0) [0|65535] ""  Central_ECU
 SG_ Loc_25_AliveCtr : 312|8@1+ (1,0) [0|255] ""  Central_ECU
 SG_ Loc_SNR_25_004 : 237|11@1+ (0.0625,0) [0|40] "dB"  Central_ECU
 SG_ Loc_SNR_25_003 : 163|11@1+ (0.0625,0) [0|40] "dB"  Central_ECU
 SG_ Loc_SNR_25_002 : 89|11@1+ (0.0625,0) [0|40] "dB"  Central_ECU
 SG_ Loc_RCS_25_004 : 286|10@1+ (0.125,-50) [-50|70] "dBm^2"  Central_ECU
 SG_ Loc_RCS_25_003 : 212|10@1+ (0.125,-50) [-50|70] "dBm^2"  Central_ECU
 SG_ Loc_RCS_25_002 : 138|10@1+ (0.125,-50) [-50|70] "dBm^2"  Central_ECU
 SG_ Loc_RadialVelo_25_004 : 248|15@1+ (0.0078125,-128) [-128|127] "m/s"  Central_ECU
 SG_ Loc_RadialVelo_25_003 : 174|15@1+ (0.0078125,-128) [-128|127] "m/s"  Central_ECU
 SG_ Loc_RadialVelo_25_002 : 100|15@1+ (0.0078125,-128) [-128|127] "m/s"  Central_ECU
 SG_ Loc_RadialDist_25_004 : 222|15@1+ (0.0078125,0) [0|250] "m"  Central_ECU
 SG_ Loc_RadialDist_25_003 : 148|15@1+ (0.0078125,0) [0|250] "m"  Central_ECU
 SG_ Loc_RadialDist_25_002 : 74|15@1+ (0.0078125,0) [0|250] "m"  Central_ECU
 SG_ Loc_ElevAngle_25_004 : 275|11@1+ (0.001,-0.785) [-0.785|0.785] "rad"  Central_ECU
 SG_ Loc_ElevAngle_25_003 : 201|11@1+ (0.001,-0.785) [-0.785|0.785] "rad"  Central_ECU
 SG_ Loc_ElevAngle_25_002 : 127|11@1+ (0.001,-0.785) [-0.785|0.785] "rad"  Central_ECU
 SG_ Loc_AziAngle_25_004 : 263|12@1+ (0.001,-1.57) [-1.57|1.57] "rad"  Central_ECU
 SG_ Loc_AziAngle_25_003 : 189|12@1+ (0.001,-1.57) [-1.57|1.57] "rad"  Central_ECU
 SG_ Loc_AziAngle_25_002 : 115|12@1+ (0.001,-1.57) [-1.57|1.57] "rad"  Central_ECU
 SG_ Loc_RCS_25_001 : 64|10@1+ (0.125,-50) [-50|70] "dBm^2"  Central_ECU
 SG_ Loc_ElevAngle_25_001 : 53|11@1+ (0.001,-0.785) [-0.785|0.785] "rad"  Central_ECU
 SG_ Loc_AziAngle_25_001 : 41|12@1+ (0.001,-1.57) [-1.57|1.57] "rad"  Central_ECU
 SG_ Loc_RadialVelo_25_001 : 26|15@1+ (0.0078125,-128) [-128|127] "m/s"  Central_ECU
 SG_ Loc_SNR_25_001 : 15|11@1+ (0.0625,0) [0|40] "dB"  Central_ECU
 SG_ Loc_RadialDist_25_001 : 0|15@1+ (0.0078125,0) [0|250] "m"  Central_ECU

BO_ 548 Location_Data_24: 64 Radar
 SG_ Loc_ElevAngleQly_24_004 : 416|8@1+ (1,0) [0|255] ""  Central_ECU
 SG_ Loc_ElevAngleQly_24_003 : 392|8@1+ (1,0) [0|255] ""  Central_ECU
 SG_ Loc_ElevAngleQly_24_002 : 368|8@1+ (1,0) [0|255] ""  Central_ECU
 SG_ Loc_ElevAngleQly_24_001 : 344|8@1+ (1,0) [0|255] ""  Central_ECU
 SG_ Loc_AziAngleQly_24_004 : 408|8@1+ (1,0) [0|255] ""  Central_ECU
 SG_ Loc_AziAngleQly_24_003 : 384|8@1+ (1,0) [0|255] ""  Central_ECU
 SG_ Loc_AziAngleQly_24_002 : 360|8@1+ (1,0) [0|255] ""  Central_ECU
 SG_ Loc_AziAngleQly_24_001 : 336|8@1+ (1,0) [0|255] ""  Central_ECU
 SG_ Loc_RadialDistVeloQly_24_004 : 400|8@1+ (1,0) [0|255] ""  Central_ECU
 SG_ Loc_RadialDistVeloQly_24_003 : 376|8@1+ (1,0) [0|255] ""  Central_ECU
 SG_ Loc_RadialDistVeloQly_24_002 : 352|8@1+ (1,0) [0|255] ""  Central_ECU
 SG_ Loc_RadialDistVeloQly_24_001 : 328|8@1+ (1,0) [0|255] ""  Central_ECU
 SG_ Loc_Validity_24_004 : 327|1@1+ (1,0) [0|1] ""  Central_ECU
 SG_ Loc_Validity_24_003 : 326|1@1+ (1,0) [0|1] ""  Central_ECU
 SG_ Loc_Validity_24_002 : 325|1@1+ (1,0) [0|1] ""  Central_ECU
 SG_ Loc_Validity_24_001 : 324|1@1+ (1,0) [0|1] ""  Central_ECU
 SG_ Loc_24_Blockcnt : 320|4@1+ (1,0) [0|15] ""  Central_ECU
 SG_ Loc_24_CRC : 296|16@1+ (1,0) [0|65535] ""  Central_ECU
 SG_ Loc_24_AliveCtr : 312|8@1+ (1,0) [0|255] ""  Central_ECU
 SG_ Loc_SNR_24_004 : 237|11@1+ (0.0625,0) [0|40] "dB"  Central_ECU
 SG_ Loc_SNR_24_003 : 163|11@1+ (0.0625,0) [0|40] "dB"  Central_ECU
 SG_ Loc_SNR_24_002 : 89|11@1+ (0.0625,0) [0|40] "dB"  Central_ECU
 SG_ Loc_RCS_24_004 : 286|10@1+ (0.125,-50) [-50|70] "dBm^2"  Central_ECU
 SG_ Loc_RCS_24_003 : 212|10@1+ (0.125,-50) [-50|70] "dBm^2"  Central_ECU
 SG_ Loc_RCS_24_002 : 138|10@1+ (0.125,-50) [-50|70] "dBm^2"  Central_ECU
 SG_ Loc_RadialVelo_24_004 : 248|15@1+ (0.0078125,-128) [-128|127] "m/s"  Central_ECU
 SG_ Loc_RadialVelo_24_003 : 174|15@1+ (0.0078125,-128) [-128|127] "m/s"  Central_ECU
 SG_ Loc_RadialVelo_24_002 : 100|15@1+ (0.0078125,-128) [-128|127] "m/s"  Central_ECU
 SG_ Loc_RadialDist_24_004 : 222|15@1+ (0.0078125,0) [0|250] "m"  Central_ECU
 SG_ Loc_RadialDist_24_003 : 148|15@1+ (0.0078125,0) [0|250] "m"  Central_ECU
 SG_ Loc_RadialDist_24_002 : 74|15@1+ (0.0078125,0) [0|250] "m"  Central_ECU
 SG_ Loc_ElevAngle_24_004 : 275|11@1+ (0.001,-0.785) [-0.785|0.785] "rad"  Central_ECU
 SG_ Loc_ElevAngle_24_003 : 201|11@1+ (0.001,-0.785) [-0.785|0.785] "rad"  Central_ECU
 SG_ Loc_ElevAngle_24_002 : 127|11@1+ (0.001,-0.785) [-0.785|0.785] "rad"  Central_ECU
 SG_ Loc_AziAngle_24_004 : 263|12@1+ (0.001,-1.57) [-1.57|1.57] "rad"  Central_ECU
 SG_ Loc_AziAngle_24_003 : 189|12@1+ (0.001,-1.57) [-1.57|1.57] "rad"  Central_ECU
 SG_ Loc_AziAngle_24_002 : 115|12@1+ (0.001,-1.57) [-1.57|1.57] "rad"  Central_ECU
 SG_ Loc_RCS_24_001 : 64|10@1+ (0.125,-50) [-50|70] "dBm^2"  Central_ECU
 SG_ Loc_ElevAngle_24_001 : 53|11@1+ (0.001,-0.785) [-0.785|0.785] "rad"  Central_ECU
 SG_ Loc_AziAngle_24_001 : 41|12@1+ (0.001,-1.57) [-1.57|1.57] "rad"  Central_ECU
 SG_ Loc_RadialVelo_24_001 : 26|15@1+ (0.0078125,-128) [-128|127] "m/s"  Central_ECU
 SG_ Loc_SNR_24_001 : 15|11@1+ (0.0625,0) [0|40] "dB"  Central_ECU
 SG_ Loc_RadialDist_24_001 : 0|15@1+ (0.0078125,0) [0|250] "m"  Central_ECU

BO_ 547 Location_Data_23: 64 Radar
 SG_ Loc_ElevAngleQly_23_004 : 416|8@1+ (1,0) [0|255] ""  Central_ECU
 SG_ Loc_ElevAngleQly_23_003 : 392|8@1+ (1,0) [0|255] ""  Central_ECU
 SG_ Loc_ElevAngleQly_23_002 : 368|8@1+ (1,0) [0|255] ""  Central_ECU
 SG_ Loc_ElevAngleQly_23_001 : 344|8@1+ (1,0) [0|255] ""  Central_ECU
 SG_ Loc_AziAngleQly_23_004 : 408|8@1+ (1,0) [0|255] ""  Central_ECU
 SG_ Loc_AziAngleQly_23_003 : 384|8@1+ (1,0) [0|255] ""  Central_ECU
 SG_ Loc_AziAngleQly_23_002 : 360|8@1+ (1,0) [0|255] ""  Central_ECU
 SG_ Loc_AziAngleQly_23_001 : 336|8@1+ (1,0) [0|255] ""  Central_ECU
 SG_ Loc_RadialDistVeloQly_23_004 : 400|8@1+ (1,0) [0|255] ""  Central_ECU
 SG_ Loc_RadialDistVeloQly_23_003 : 376|8@1+ (1,0) [0|255] ""  Central_ECU
 SG_ Loc_RadialDistVeloQly_23_002 : 352|8@1+ (1,0) [0|255] ""  Central_ECU
 SG_ Loc_RadialDistVeloQly_23_001 : 328|8@1+ (1,0) [0|255] ""  Central_ECU
 SG_ Loc_Validity_23_004 : 327|1@1+ (1,0) [0|1] ""  Central_ECU
 SG_ Loc_Validity_23_003 : 326|1@1+ (1,0) [0|1] ""  Central_ECU
 SG_ Loc_Validity_23_002 : 325|1@1+ (1,0) [0|1] ""  Central_ECU
 SG_ Loc_Validity_23_001 : 324|1@1+ (1,0) [0|1] ""  Central_ECU
 SG_ Loc_23_Blockcnt : 320|4@1+ (1,0) [0|15] ""  Central_ECU
 SG_ Loc_23_CRC : 296|16@1+ (1,0) [0|65535] ""  Central_ECU
 SG_ Loc_23_AliveCtr : 312|8@1+ (1,0) [0|255] ""  Central_ECU
 SG_ Loc_SNR_23_004 : 237|11@1+ (0.0625,0) [0|40] "dB"  Central_ECU
 SG_ Loc_SNR_23_003 : 163|11@1+ (0.0625,0) [0|40] "dB"  Central_ECU
 SG_ Loc_SNR_23_002 : 89|11@1+ (0.0625,0) [0|40] "dB"  Central_ECU
 SG_ Loc_RCS_23_004 : 286|10@1+ (0.125,-50) [-50|70] "dBm^2"  Central_ECU
 SG_ Loc_RCS_23_003 : 212|10@1+ (0.125,-50) [-50|70] "dBm^2"  Central_ECU
 SG_ Loc_RCS_23_002 : 138|10@1+ (0.125,-50) [-50|70] "dBm^2"  Central_ECU
 SG_ Loc_RadialVelo_23_004 : 248|15@1+ (0.0078125,-128) [-128|127] "m/s"  Central_ECU
 SG_ Loc_RadialVelo_23_003 : 174|15@1+ (0.0078125,-128) [-128|127] "m/s"  Central_ECU
 SG_ Loc_RadialVelo_23_002 : 100|15@1+ (0.0078125,-128) [-128|127] "m/s"  Central_ECU
 SG_ Loc_RadialDist_23_004 : 222|15@1+ (0.0078125,0) [0|250] "m"  Central_ECU
 SG_ Loc_RadialDist_23_003 : 148|15@1+ (0.0078125,0) [0|250] "m"  Central_ECU
 SG_ Loc_RadialDist_23_002 : 74|15@1+ (0.0078125,0) [0|250] "m"  Central_ECU
 SG_ Loc_ElevAngle_23_004 : 275|11@1+ (0.001,-0.785) [-0.785|0.785] "rad"  Central_ECU
 SG_ Loc_ElevAngle_23_003 : 201|11@1+ (0.001,-0.785) [-0.785|0.785] "rad"  Central_ECU
 SG_ Loc_ElevAngle_23_002 : 127|11@1+ (0.001,-0.785) [-0.785|0.785] "rad"  Central_ECU
 SG_ Loc_AziAngle_23_004 : 263|12@1+ (0.001,-1.57) [-1.57|1.57] "rad"  Central_ECU
 SG_ Loc_AziAngle_23_003 : 189|12@1+ (0.001,-1.57) [-1.57|1.57] "rad"  Central_ECU
 SG_ Loc_AziAngle_23_002 : 115|12@1+ (0.001,-1.57) [-1.57|1.57] "rad"  Central_ECU
 SG_ Loc_RCS_23_001 : 64|10@1+ (0.125,-50) [-50|70] "dBm^2"  Central_ECU
 SG_ Loc_ElevAngle_23_001 : 53|11@1+ (0.001,-0.785) [-0.785|0.785] "rad"  Central_ECU
 SG_ Loc_AziAngle_23_001 : 41|12@1+ (0.001,-1.57) [-1.57|1.57] "rad"  Central_ECU
 SG_ Loc_RadialVelo_23_001 : 26|15@1+ (0.0078125,-128) [-128|127] "m/s"  Central_ECU
 SG_ Loc_SNR_23_001 : 15|11@1+ (0.0625,0) [0|40] "dB"  Central_ECU
 SG_ Loc_RadialDist_23_001 : 0|15@1+ (0.0078125,0) [0|250] "m"  Central_ECU

BO_ 546 Location_Data_22: 64 Radar
 SG_ Loc_ElevAngleQly_22_004 : 416|8@1+ (1,0) [0|255] ""  Central_ECU
 SG_ Loc_ElevAngleQly_22_003 : 392|8@1+ (1,0) [0|255] ""  Central_ECU
 SG_ Loc_ElevAngleQly_22_002 : 368|8@1+ (1,0) [0|255] ""  Central_ECU
 SG_ Loc_ElevAngleQly_22_001 : 344|8@1+ (1,0) [0|255] ""  Central_ECU
 SG_ Loc_AziAngleQly_22_004 : 408|8@1+ (1,0) [0|255] ""  Central_ECU
 SG_ Loc_AziAngleQly_22_003 : 384|8@1+ (1,0) [0|255] ""  Central_ECU
 SG_ Loc_AziAngleQly_22_002 : 360|8@1+ (1,0) [0|255] ""  Central_ECU
 SG_ Loc_AziAngleQly_22_001 : 336|8@1+ (1,0) [0|255] ""  Central_ECU
 SG_ Loc_RadialDistVeloQly_22_004 : 400|8@1+ (1,0) [0|255] ""  Central_ECU
 SG_ Loc_RadialDistVeloQly_22_003 : 376|8@1+ (1,0) [0|255] ""  Central_ECU
 SG_ Loc_RadialDistVeloQly_22_002 : 352|8@1+ (1,0) [0|255] ""  Central_ECU
 SG_ Loc_RadialDistVeloQly_22_001 : 328|8@1+ (1,0) [0|255] ""  Central_ECU
 SG_ Loc_Validity_22_004 : 327|1@1+ (1,0) [0|1] ""  Central_ECU
 SG_ Loc_Validity_22_003 : 326|1@1+ (1,0) [0|1] ""  Central_ECU
 SG_ Loc_Validity_22_002 : 325|1@1+ (1,0) [0|1] ""  Central_ECU
 SG_ Loc_Validity_22_001 : 324|1@1+ (1,0) [0|1] ""  Central_ECU
 SG_ Loc_22_Blockcnt : 320|4@1+ (1,0) [0|15] ""  Central_ECU
 SG_ Loc_22_CRC : 296|16@1+ (1,0) [0|65535] ""  Central_ECU
 SG_ Loc_22_AliveCtr : 312|8@1+ (1,0) [0|255] ""  Central_ECU
 SG_ Loc_SNR_22_004 : 237|11@1+ (0.0625,0) [0|40] "dB"  Central_ECU
 SG_ Loc_SNR_22_003 : 163|11@1+ (0.0625,0) [0|40] "dB"  Central_ECU
 SG_ Loc_SNR_22_002 : 89|11@1+ (0.0625,0) [0|40] "dB"  Central_ECU
 SG_ Loc_RCS_22_004 : 286|10@1+ (0.125,-50) [-50|70] "dBm^2"  Central_ECU
 SG_ Loc_RCS_22_003 : 212|10@1+ (0.125,-50) [-50|70] "dBm^2"  Central_ECU
 SG_ Loc_RCS_22_002 : 138|10@1+ (0.125,-50) [-50|70] "dBm^2"  Central_ECU
 SG_ Loc_RadialVelo_22_004 : 248|15@1+ (0.0078125,-128) [-128|127] "m/s"  Central_ECU
 SG_ Loc_RadialVelo_22_003 : 174|15@1+ (0.0078125,-128) [-128|127] "m/s"  Central_ECU
 SG_ Loc_RadialVelo_22_002 : 100|15@1+ (0.0078125,-128) [-128|127] "m/s"  Central_ECU
 SG_ Loc_RadialDist_22_004 : 222|15@1+ (0.0078125,0) [0|250] "m"  Central_ECU
 SG_ Loc_RadialDist_22_003 : 148|15@1+ (0.0078125,0) [0|250] "m"  Central_ECU
 SG_ Loc_RadialDist_22_002 : 74|15@1+ (0.0078125,0) [0|250] "m"  Central_ECU
 SG_ Loc_ElevAngle_22_004 : 275|11@1+ (0.001,-0.785) [-0.785|0.785] "rad"  Central_ECU
 SG_ Loc_ElevAngle_22_003 : 201|11@1+ (0.001,-0.785) [-0.785|0.785] "rad"  Central_ECU
 SG_ Loc_ElevAngle_22_002 : 127|11@1+ (0.001,-0.785) [-0.785|0.785] "rad"  Central_ECU
 SG_ Loc_AziAngle_22_004 : 263|12@1+ (0.001,-1.57) [-1.57|1.57] "rad"  Central_ECU
 SG_ Loc_AziAngle_22_003 : 189|12@1+ (0.001,-1.57) [-1.57|1.57] "rad"  Central_ECU
 SG_ Loc_AziAngle_22_002 : 115|12@1+ (0.001,-1.57) [-1.57|1.57] "rad"  Central_ECU
 SG_ Loc_RCS_22_001 : 64|10@1+ (0.125,-50) [-50|70] "dBm^2"  Central_ECU
 SG_ Loc_ElevAngle_22_001 : 53|11@1+ (0.001,-0.785) [-0.785|0.785] "rad"  Central_ECU
 SG_ Loc_AziAngle_22_001 : 41|12@1+ (0.001,-1.57) [-1.57|1.57] "rad"  Central_ECU
 SG_ Loc_RadialVelo_22_001 : 26|15@1+ (0.0078125,-128) [-128|127] "m/s"  Central_ECU
 SG_ Loc_SNR_22_001 : 15|11@1+ (0.0625,0) [0|40] "dB"  Central_ECU
 SG_ Loc_RadialDist_22_001 : 0|15@1+ (0.0078125,0) [0|250] "m"  Central_ECU

BO_ 545 Location_Data_21: 64 Radar
 SG_ Loc_ElevAngleQly_21_004 : 416|8@1+ (1,0) [0|255] ""  Central_ECU
 SG_ Loc_ElevAngleQly_21_003 : 392|8@1+ (1,0) [0|255] ""  Central_ECU
 SG_ Loc_ElevAngleQly_21_002 : 368|8@1+ (1,0) [0|255] ""  Central_ECU
 SG_ Loc_ElevAngleQly_21_001 : 344|8@1+ (1,0) [0|255] ""  Central_ECU
 SG_ Loc_AziAngleQly_21_004 : 408|8@1+ (1,0) [0|255] ""  Central_ECU
 SG_ Loc_AziAngleQly_21_003 : 384|8@1+ (1,0) [0|255] ""  Central_ECU
 SG_ Loc_AziAngleQly_21_002 : 360|8@1+ (1,0) [0|255] ""  Central_ECU
 SG_ Loc_AziAngleQly_21_001 : 336|8@1+ (1,0) [0|255] ""  Central_ECU
 SG_ Loc_RadialDistVeloQly_21_004 : 400|8@1+ (1,0) [0|255] ""  Central_ECU
 SG_ Loc_RadialDistVeloQly_21_003 : 376|8@1+ (1,0) [0|255] ""  Central_ECU
 SG_ Loc_RadialDistVeloQly_21_002 : 352|8@1+ (1,0) [0|255] ""  Central_ECU
 SG_ Loc_RadialDistVeloQly_21_001 : 328|8@1+ (1,0) [0|255] ""  Central_ECU
 SG_ Loc_Validity_21_004 : 327|1@1+ (1,0) [0|1] ""  Central_ECU
 SG_ Loc_Validity_21_003 : 326|1@1+ (1,0) [0|1] ""  Central_ECU
 SG_ Loc_Validity_21_002 : 325|1@1+ (1,0) [0|1] ""  Central_ECU
 SG_ Loc_Validity_21_001 : 324|1@1+ (1,0) [0|1] ""  Central_ECU
 SG_ Loc_21_Blockcnt : 320|4@1+ (1,0) [0|15] ""  Central_ECU
 SG_ Loc_21_CRC : 296|16@1+ (1,0) [0|65535] ""  Central_ECU
 SG_ Loc_21_AliveCtr : 312|8@1+ (1,0) [0|255] ""  Central_ECU
 SG_ Loc_SNR_21_004 : 237|11@1+ (0.0625,0) [0|40] "dB"  Central_ECU
 SG_ Loc_SNR_21_003 : 163|11@1+ (0.0625,0) [0|40] "dB"  Central_ECU
 SG_ Loc_SNR_21_002 : 89|11@1+ (0.0625,0) [0|40] "dB"  Central_ECU
 SG_ Loc_RCS_21_004 : 286|10@1+ (0.125,-50) [-50|70] "dBm^2"  Central_ECU
 SG_ Loc_RCS_21_003 : 212|10@1+ (0.125,-50) [-50|70] "dBm^2"  Central_ECU
 SG_ Loc_RCS_21_002 : 138|10@1+ (0.125,-50) [-50|70] "dBm^2"  Central_ECU
 SG_ Loc_RadialVelo_21_004 : 248|15@1+ (0.0078125,-128) [-128|127] "m/s"  Central_ECU
 SG_ Loc_RadialVelo_21_003 : 174|15@1+ (0.0078125,-128) [-128|127] "m/s"  Central_ECU
 SG_ Loc_RadialVelo_21_002 : 100|15@1+ (0.0078125,-128) [-128|127] "m/s"  Central_ECU
 SG_ Loc_RadialDist_21_004 : 222|15@1+ (0.0078125,0) [0|250] "m"  Central_ECU
 SG_ Loc_RadialDist_21_003 : 148|15@1+ (0.0078125,0) [0|250] "m"  Central_ECU
 SG_ Loc_RadialDist_21_002 : 74|15@1+ (0.0078125,0) [0|250] "m"  Central_ECU
 SG_ Loc_ElevAngle_21_004 : 275|11@1+ (0.001,-0.785) [-0.785|0.785] "rad"  Central_ECU
 SG_ Loc_ElevAngle_21_003 : 201|11@1+ (0.001,-0.785) [-0.785|0.785] "rad"  Central_ECU
 SG_ Loc_ElevAngle_21_002 : 127|11@1+ (0.001,-0.785) [-0.785|0.785] "rad"  Central_ECU
 SG_ Loc_AziAngle_21_004 : 263|12@1+ (0.001,-1.57) [-1.57|1.57] "rad"  Central_ECU
 SG_ Loc_AziAngle_21_003 : 189|12@1+ (0.001,-1.57) [-1.57|1.57] "rad"  Central_ECU
 SG_ Loc_AziAngle_21_002 : 115|12@1+ (0.001,-1.57) [-1.57|1.57] "rad"  Central_ECU
 SG_ Loc_RCS_21_001 : 64|10@1+ (0.125,-50) [-50|70] "dBm^2"  Central_ECU
 SG_ Loc_ElevAngle_21_001 : 53|11@1+ (0.001,-0.785) [-0.785|0.785] "rad"  Central_ECU
 SG_ Loc_AziAngle_21_001 : 41|12@1+ (0.001,-1.57) [-1.57|1.57] "rad"  Central_ECU
 SG_ Loc_RadialVelo_21_001 : 26|15@1+ (0.0078125,-128) [-128|127] "m/s"  Central_ECU
 SG_ Loc_SNR_21_001 : 15|11@1+ (0.0625,0) [0|40] "dB"  Central_ECU
 SG_ Loc_RadialDist_21_001 : 0|15@1+ (0.0078125,0) [0|250] "m"  Central_ECU

BO_ 544 Location_Data_20: 64 Radar
 SG_ Loc_ElevAngleQly_20_004 : 416|8@1+ (1,0) [0|255] ""  Central_ECU
 SG_ Loc_ElevAngleQly_20_003 : 392|8@1+ (1,0) [0|255] ""  Central_ECU
 SG_ Loc_ElevAngleQly_20_002 : 368|8@1+ (1,0) [0|255] ""  Central_ECU
 SG_ Loc_ElevAngleQly_20_001 : 344|8@1+ (1,0) [0|255] ""  Central_ECU
 SG_ Loc_AziAngleQly_20_004 : 408|8@1+ (1,0) [0|255] ""  Central_ECU
 SG_ Loc_AziAngleQly_20_003 : 384|8@1+ (1,0) [0|255] ""  Central_ECU
 SG_ Loc_AziAngleQly_20_002 : 360|8@1+ (1,0) [0|255] ""  Central_ECU
 SG_ Loc_AziAngleQly_20_001 : 336|8@1+ (1,0) [0|255] ""  Central_ECU
 SG_ Loc_RadialDistVeloQly_20_004 : 400|8@1+ (1,0) [0|255] ""  Central_ECU
 SG_ Loc_RadialDistVeloQly_20_003 : 376|8@1+ (1,0) [0|255] ""  Central_ECU
 SG_ Loc_RadialDistVeloQly_20_002 : 352|8@1+ (1,0) [0|255] ""  Central_ECU
 SG_ Loc_RadialDistVeloQly_20_001 : 328|8@1+ (1,0) [0|255] ""  Central_ECU
 SG_ Loc_Validity_20_004 : 327|1@1+ (1,0) [0|1] ""  Central_ECU
 SG_ Loc_Validity_20_003 : 326|1@1+ (1,0) [0|1] ""  Central_ECU
 SG_ Loc_Validity_20_002 : 325|1@1+ (1,0) [0|1] ""  Central_ECU
 SG_ Loc_Validity_20_001 : 324|1@1+ (1,0) [0|1] ""  Central_ECU
 SG_ Loc_20_Blockcnt : 320|4@1+ (1,0) [0|15] ""  Central_ECU
 SG_ Loc_20_CRC : 296|16@1+ (1,0) [0|65535] ""  Central_ECU
 SG_ Loc_20_AliveCtr : 312|8@1+ (1,0) [0|255] ""  Central_ECU
 SG_ Loc_SNR_20_004 : 237|11@1+ (0.0625,0) [0|40] "dB"  Central_ECU
 SG_ Loc_SNR_20_003 : 163|11@1+ (0.0625,0) [0|40] "dB"  Central_ECU
 SG_ Loc_SNR_20_002 : 89|11@1+ (0.0625,0) [0|40] "dB"  Central_ECU
 SG_ Loc_RCS_20_004 : 286|10@1+ (0.125,-50) [-50|70] "dBm^2"  Central_ECU
 SG_ Loc_RCS_20_003 : 212|10@1+ (0.125,-50) [-50|70] "dBm^2"  Central_ECU
 SG_ Loc_RCS_20_002 : 138|10@1+ (0.125,-50) [-50|70] "dBm^2"  Central_ECU
 SG_ Loc_RadialVelo_20_004 : 248|15@1+ (0.0078125,-128) [-128|127] "m/s"  Central_ECU
 SG_ Loc_RadialVelo_20_003 : 174|15@1+ (0.0078125,-128) [-128|127] "m/s"  Central_ECU
 SG_ Loc_RadialVelo_20_002 : 100|15@1+ (0.0078125,-128) [-128|127] "m/s"  Central_ECU
 SG_ Loc_RadialDist_20_004 : 222|15@1+ (0.0078125,0) [0|250] "m"  Central_ECU
 SG_ Loc_RadialDist_20_003 : 148|15@1+ (0.0078125,0) [0|250] "m"  Central_ECU
 SG_ Loc_RadialDist_20_002 : 74|15@1+ (0.0078125,0) [0|250] "m"  Central_ECU
 SG_ Loc_ElevAngle_20_004 : 275|11@1+ (0.001,-0.785) [-0.785|0.785] "rad"  Central_ECU
 SG_ Loc_ElevAngle_20_003 : 201|11@1+ (0.001,-0.785) [-0.785|0.785] "rad"  Central_ECU
 SG_ Loc_ElevAngle_20_002 : 127|11@1+ (0.001,-0.785) [-0.785|0.785] "rad"  Central_ECU
 SG_ Loc_AziAngle_20_004 : 263|12@1+ (0.001,-1.57) [-1.57|1.57] "rad"  Central_ECU
 SG_ Loc_AziAngle_20_003 : 189|12@1+ (0.001,-1.57) [-1.57|1.57] "rad"  Central_ECU
 SG_ Loc_AziAngle_20_002 : 115|12@1+ (0.001,-1.57) [-1.57|1.57] "rad"  Central_ECU
 SG_ Loc_RCS_20_001 : 64|10@1+ (0.125,-50) [-50|70] "dBm^2"  Central_ECU
 SG_ Loc_ElevAngle_20_001 : 53|11@1+ (0.001,-0.785) [-0.785|0.785] "rad"  Central_ECU
 SG_ Loc_AziAngle_20_001 : 41|12@1+ (0.001,-1.57) [-1.57|1.57] "rad"  Central_ECU
 SG_ Loc_RadialVelo_20_001 : 26|15@1+ (0.0078125,-128) [-128|127] "m/s"  Central_ECU
 SG_ Loc_SNR_20_001 : 15|11@1+ (0.0625,0) [0|40] "dB"  Central_ECU
 SG_ Loc_RadialDist_20_001 : 0|15@1+ (0.0078125,0) [0|250] "m"  Central_ECU

BO_ 537 Location_Data_19: 64 Radar
 SG_ Loc_ElevAngleQly_19_004 : 416|8@1+ (1,0) [0|255] ""  Central_ECU
 SG_ Loc_ElevAngleQly_19_003 : 392|8@1+ (1,0) [0|255] ""  Central_ECU
 SG_ Loc_ElevAngleQly_19_002 : 368|8@1+ (1,0) [0|255] ""  Central_ECU
 SG_ Loc_ElevAngleQly_19_001 : 344|8@1+ (1,0) [0|255] ""  Central_ECU
 SG_ Loc_AziAngleQly_19_004 : 408|8@1+ (1,0) [0|255] ""  Central_ECU
 SG_ Loc_AziAngleQly_19_003 : 384|8@1+ (1,0) [0|255] ""  Central_ECU
 SG_ Loc_AziAngleQly_19_002 : 360|8@1+ (1,0) [0|255] ""  Central_ECU
 SG_ Loc_AziAngleQly_19_001 : 336|8@1+ (1,0) [0|255] ""  Central_ECU
 SG_ Loc_RadialDistVeloQly_19_004 : 400|8@1+ (1,0) [0|255] ""  Central_ECU
 SG_ Loc_RadialDistVeloQly_19_003 : 376|8@1+ (1,0) [0|255] ""  Central_ECU
 SG_ Loc_RadialDistVeloQly_19_002 : 352|8@1+ (1,0) [0|255] ""  Central_ECU
 SG_ Loc_RadialDistVeloQly_19_001 : 328|8@1+ (1,0) [0|255] ""  Central_ECU
 SG_ Loc_Validity_19_004 : 327|1@1+ (1,0) [0|1] ""  Central_ECU
 SG_ Loc_Validity_19_003 : 326|1@1+ (1,0) [0|1] ""  Central_ECU
 SG_ Loc_Validity_19_002 : 325|1@1+ (1,0) [0|1] ""  Central_ECU
 SG_ Loc_Validity_19_001 : 324|1@1+ (1,0) [0|1] ""  Central_ECU
 SG_ Loc_19_Blockcnt : 320|4@1+ (1,0) [0|15] ""  Central_ECU
 SG_ Loc_19_CRC : 296|16@1+ (1,0) [0|65535] ""  Central_ECU
 SG_ Loc_19_AliveCtr : 312|8@1+ (1,0) [0|255] ""  Central_ECU
 SG_ Loc_SNR_19_004 : 237|11@1+ (0.0625,0) [0|40] "dB"  Central_ECU
 SG_ Loc_SNR_19_003 : 163|11@1+ (0.0625,0) [0|40] "dB"  Central_ECU
 SG_ Loc_SNR_19_002 : 89|11@1+ (0.0625,0) [0|40] "dB"  Central_ECU
 SG_ Loc_RCS_19_004 : 286|10@1+ (0.125,-50) [-50|70] "dBm^2"  Central_ECU
 SG_ Loc_RCS_19_003 : 212|10@1+ (0.125,-50) [-50|70] "dBm^2"  Central_ECU
 SG_ Loc_RCS_19_002 : 138|10@1+ (0.125,-50) [-50|70] "dBm^2"  Central_ECU
 SG_ Loc_RadialVelo_19_004 : 248|15@1+ (0.0078125,-128) [-128|127] "m/s"  Central_ECU
 SG_ Loc_RadialVelo_19_003 : 174|15@1+ (0.0078125,-128) [-128|127] "m/s"  Central_ECU
 SG_ Loc_RadialVelo_19_002 : 100|15@1+ (0.0078125,-128) [-128|127] "m/s"  Central_ECU
 SG_ Loc_RadialDist_19_004 : 222|15@1+ (0.0078125,0) [0|250] "m"  Central_ECU
 SG_ Loc_RadialDist_19_003 : 148|15@1+ (0.0078125,0) [0|250] "m"  Central_ECU
 SG_ Loc_RadialDist_19_002 : 74|15@1+ (0.0078125,0) [0|250] "m"  Central_ECU
 SG_ Loc_ElevAngle_19_004 : 275|11@1+ (0.001,-0.785) [-0.785|0.785] "rad"  Central_ECU
 SG_ Loc_ElevAngle_19_003 : 201|11@1+ (0.001,-0.785) [-0.785|0.785] "rad"  Central_ECU
 SG_ Loc_ElevAngle_19_002 : 127|11@1+ (0.001,-0.785) [-0.785|0.785] "rad"  Central_ECU
 SG_ Loc_AziAngle_19_004 : 263|12@1+ (0.001,-1.57) [-1.57|1.57] "rad"  Central_ECU
 SG_ Loc_AziAngle_19_003 : 189|12@1+ (0.001,-1.57) [-1.57|1.57] "rad"  Central_ECU
 SG_ Loc_AziAngle_19_002 : 115|12@1+ (0.001,-1.57) [-1.57|1.57] "rad"  Central_ECU
 SG_ Loc_RCS_19_001 : 64|10@1+ (0.125,-50) [-50|70] "dBm^2"  Central_ECU
 SG_ Loc_ElevAngle_19_001 : 53|11@1+ (0.001,-0.785) [-0.785|0.785] "rad"  Central_ECU
 SG_ Loc_AziAngle_19_001 : 41|12@1+ (0.001,-1.57) [-1.57|1.57] "rad"  Central_ECU
 SG_ Loc_RadialVelo_19_001 : 26|15@1+ (0.0078125,-128) [-128|127] "m/s"  Central_ECU
 SG_ Loc_SNR_19_001 : 15|11@1+ (0.0625,0) [0|40] "dB"  Central_ECU
 SG_ Loc_RadialDist_19_001 : 0|15@1+ (0.0078125,0) [0|250] "m"  Central_ECU

BO_ 536 Location_Data_18: 64 Radar
 SG_ Loc_ElevAngleQly_18_004 : 416|8@1+ (1,0) [0|255] ""  Central_ECU
 SG_ Loc_ElevAngleQly_18_003 : 392|8@1+ (1,0) [0|255] ""  Central_ECU
 SG_ Loc_ElevAngleQly_18_002 : 368|8@1+ (1,0) [0|255] ""  Central_ECU
 SG_ Loc_ElevAngleQly_18_001 : 344|8@1+ (1,0) [0|255] ""  Central_ECU
 SG_ Loc_AziAngleQly_18_004 : 408|8@1+ (1,0) [0|255] ""  Central_ECU
 SG_ Loc_AziAngleQly_18_003 : 384|8@1+ (1,0) [0|255] ""  Central_ECU
 SG_ Loc_AziAngleQly_18_002 : 360|8@1+ (1,0) [0|255] ""  Central_ECU
 SG_ Loc_AziAngleQly_18_001 : 336|8@1+ (1,0) [0|255] ""  Central_ECU
 SG_ Loc_RadialDistVeloQly_18_004 : 400|8@1+ (1,0) [0|255] ""  Central_ECU
 SG_ Loc_RadialDistVeloQly_18_003 : 376|8@1+ (1,0) [0|255] ""  Central_ECU
 SG_ Loc_RadialDistVeloQly_18_002 : 352|8@1+ (1,0) [0|255] ""  Central_ECU
 SG_ Loc_RadialDistVeloQly_18_001 : 328|8@1+ (1,0) [0|255] ""  Central_ECU
 SG_ Loc_Validity_18_004 : 327|1@1+ (1,0) [0|1] ""  Central_ECU
 SG_ Loc_Validity_18_003 : 326|1@1+ (1,0) [0|1] ""  Central_ECU
 SG_ Loc_Validity_18_002 : 325|1@1+ (1,0) [0|1] ""  Central_ECU
 SG_ Loc_Validity_18_001 : 324|1@1+ (1,0) [0|1] ""  Central_ECU
 SG_ Loc_18_Blockcnt : 320|4@1+ (1,0) [0|15] ""  Central_ECU
 SG_ Loc_18_CRC : 296|16@1+ (1,0) [0|65535] ""  Central_ECU
 SG_ Loc_18_AliveCtr : 312|8@1+ (1,0) [0|255] ""  Central_ECU
 SG_ Loc_SNR_18_004 : 237|11@1+ (0.0625,0) [0|40] "dB"  Central_ECU
 SG_ Loc_SNR_18_003 : 163|11@1+ (0.0625,0) [0|40] "dB"  Central_ECU
 SG_ Loc_SNR_18_002 : 89|11@1+ (0.0625,0) [0|40] "dB"  Central_ECU
 SG_ Loc_RCS_18_004 : 286|10@1+ (0.125,-50) [-50|70] "dBm^2"  Central_ECU
 SG_ Loc_RCS_18_003 : 212|10@1+ (0.125,-50) [-50|70] "dBm^2"  Central_ECU
 SG_ Loc_RCS_18_002 : 138|10@1+ (0.125,-50) [-50|70] "dBm^2"  Central_ECU
 SG_ Loc_RadialVelo_18_004 : 248|15@1+ (0.0078125,-128) [-128|127] "m/s"  Central_ECU
 SG_ Loc_RadialVelo_18_003 : 174|15@1+ (0.0078125,-128) [-128|127] "m/s"  Central_ECU
 SG_ Loc_RadialVelo_18_002 : 100|15@1+ (0.0078125,-128) [-128|127] "m/s"  Central_ECU
 SG_ Loc_RadialDist_18_004 : 222|15@1+ (0.0078125,0) [0|250] "m"  Central_ECU
 SG_ Loc_RadialDist_18_003 : 148|15@1+ (0.0078125,0) [0|250] "m"  Central_ECU
 SG_ Loc_RadialDist_18_002 : 74|15@1+ (0.0078125,0) [0|250] "m"  Central_ECU
 SG_ Loc_ElevAngle_18_004 : 275|11@1+ (0.001,-0.785) [-0.785|0.785] "rad"  Central_ECU
 SG_ Loc_ElevAngle_18_003 : 201|11@1+ (0.001,-0.785) [-0.785|0.785] "rad"  Central_ECU
 SG_ Loc_ElevAngle_18_002 : 127|11@1+ (0.001,-0.785) [-0.785|0.785] "rad"  Central_ECU
 SG_ Loc_AziAngle_18_004 : 263|12@1+ (0.001,-1.57) [-1.57|1.57] "rad"  Central_ECU
 SG_ Loc_AziAngle_18_003 : 189|12@1+ (0.001,-1.57) [-1.57|1.57] "rad"  Central_ECU
 SG_ Loc_AziAngle_18_002 : 115|12@1+ (0.001,-1.57) [-1.57|1.57] "rad"  Central_ECU
 SG_ Loc_RCS_18_001 : 64|10@1+ (0.125,-50) [-50|70] "dBm^2"  Central_ECU
 SG_ Loc_ElevAngle_18_001 : 53|11@1+ (0.001,-0.785) [-0.785|0.785] "rad"  Central_ECU
 SG_ Loc_AziAngle_18_001 : 41|12@1+ (0.001,-1.57) [-1.57|1.57] "rad"  Central_ECU
 SG_ Loc_RadialVelo_18_001 : 26|15@1+ (0.0078125,-128) [-128|127] "m/s"  Central_ECU
 SG_ Loc_SNR_18_001 : 15|11@1+ (0.0625,0) [0|40] "dB"  Central_ECU
 SG_ Loc_RadialDist_18_001 : 0|15@1+ (0.0078125,0) [0|250] "m"  Central_ECU

BO_ 535 Location_Data_17: 64 Radar
 SG_ Loc_ElevAngleQly_17_004 : 416|8@1+ (1,0) [0|255] ""  Central_ECU
 SG_ Loc_ElevAngleQly_17_003 : 392|8@1+ (1,0) [0|255] ""  Central_ECU
 SG_ Loc_ElevAngleQly_17_002 : 368|8@1+ (1,0) [0|255] ""  Central_ECU
 SG_ Loc_ElevAngleQly_17_001 : 344|8@1+ (1,0) [0|255] ""  Central_ECU
 SG_ Loc_AziAngleQly_17_004 : 408|8@1+ (1,0) [0|255] ""  Central_ECU
 SG_ Loc_AziAngleQly_17_003 : 384|8@1+ (1,0) [0|255] ""  Central_ECU
 SG_ Loc_AziAngleQly_17_002 : 360|8@1+ (1,0) [0|255] ""  Central_ECU
 SG_ Loc_AziAngleQly_17_001 : 336|8@1+ (1,0) [0|255] ""  Central_ECU
 SG_ Loc_RadialDistVeloQly_17_004 : 400|8@1+ (1,0) [0|255] ""  Central_ECU
 SG_ Loc_RadialDistVeloQly_17_003 : 376|8@1+ (1,0) [0|255] ""  Central_ECU
 SG_ Loc_RadialDistVeloQly_17_002 : 352|8@1+ (1,0) [0|255] ""  Central_ECU
 SG_ Loc_RadialDistVeloQly_17_001 : 328|8@1+ (1,0) [0|255] ""  Central_ECU
 SG_ Loc_Validity_17_004 : 327|1@1+ (1,0) [0|1] ""  Central_ECU
 SG_ Loc_Validity_17_003 : 326|1@1+ (1,0) [0|1] ""  Central_ECU
 SG_ Loc_Validity_17_002 : 325|1@1+ (1,0) [0|1] ""  Central_ECU
 SG_ Loc_Validity_17_001 : 324|1@1+ (1,0) [0|1] ""  Central_ECU
 SG_ Loc_17_Blockcnt : 320|4@1+ (1,0) [0|15] ""  Central_ECU
 SG_ Loc_17_CRC : 296|16@1+ (1,0) [0|65535] ""  Central_ECU
 SG_ Loc_17_AliveCtr : 312|8@1+ (1,0) [0|255] ""  Central_ECU
 SG_ Loc_SNR_17_004 : 237|11@1+ (0.0625,0) [0|40] "dB"  Central_ECU
 SG_ Loc_SNR_17_003 : 163|11@1+ (0.0625,0) [0|40] "dB"  Central_ECU
 SG_ Loc_SNR_17_002 : 89|11@1+ (0.0625,0) [0|40] "dB"  Central_ECU
 SG_ Loc_RCS_17_004 : 286|10@1+ (0.125,-50) [-50|70] "dBm^2"  Central_ECU
 SG_ Loc_RCS_17_003 : 212|10@1+ (0.125,-50) [-50|70] "dBm^2"  Central_ECU
 SG_ Loc_RCS_17_002 : 138|10@1+ (0.125,-50) [-50|70] "dBm^2"  Central_ECU
 SG_ Loc_RadialVelo_17_004 : 248|15@1+ (0.0078125,-128) [-128|127] "m/s"  Central_ECU
 SG_ Loc_RadialVelo_17_003 : 174|15@1+ (0.0078125,-128) [-128|127] "m/s"  Central_ECU
 SG_ Loc_RadialVelo_17_002 : 100|15@1+ (0.0078125,-128) [-128|127] "m/s"  Central_ECU
 SG_ Loc_RadialDist_17_004 : 222|15@1+ (0.0078125,0) [0|250] "m"  Central_ECU
 SG_ Loc_RadialDist_17_003 : 148|15@1+ (0.0078125,0) [0|250] "m"  Central_ECU
 SG_ Loc_RadialDist_17_002 : 74|15@1+ (0.0078125,0) [0|250] "m"  Central_ECU
 SG_ Loc_ElevAngle_17_004 : 275|11@1+ (0.001,-0.785) [-0.785|0.785] "rad"  Central_ECU
 SG_ Loc_ElevAngle_17_003 : 201|11@1+ (0.001,-0.785) [-0.785|0.785] "rad"  Central_ECU
 SG_ Loc_ElevAngle_17_002 : 127|11@1+ (0.001,-0.785) [-0.785|0.785] "rad"  Central_ECU
 SG_ Loc_AziAngle_17_004 : 263|12@1+ (0.001,-1.57) [-1.57|1.57] "rad"  Central_ECU
 SG_ Loc_AziAngle_17_003 : 189|12@1+ (0.001,-1.57) [-1.57|1.57] "rad"  Central_ECU
 SG_ Loc_AziAngle_17_002 : 115|12@1+ (0.001,-1.57) [-1.57|1.57] "rad"  Central_ECU
 SG_ Loc_RCS_17_001 : 64|10@1+ (0.125,-50) [-50|70] "dBm^2"  Central_ECU
 SG_ Loc_ElevAngle_17_001 : 53|11@1+ (0.001,-0.785) [-0.785|0.785] "rad"  Central_ECU
 SG_ Loc_AziAngle_17_001 : 41|12@1+ (0.001,-1.57) [-1.57|1.57] "rad"  Central_ECU
 SG_ Loc_RadialVelo_17_001 : 26|15@1+ (0.0078125,-128) [-128|127] "m/s"  Central_ECU
 SG_ Loc_SNR_17_001 : 15|11@1+ (0.0625,0) [0|40] "dB"  Central_ECU
 SG_ Loc_RadialDist_17_001 : 0|15@1+ (0.0078125,0) [0|250] "m"  Central_ECU

BO_ 513 Location_Data_01: 64 Radar
 SG_ Loc_ElevAngleQly_01_004 : 416|8@1+ (1,0) [0|255] ""  Central_ECU
 SG_ Loc_ElevAngleQly_01_003 : 392|8@1+ (1,0) [0|255] ""  Central_ECU
 SG_ Loc_ElevAngleQly_01_002 : 368|8@1+ (1,0) [0|255] ""  Central_ECU
 SG_ Loc_ElevAngleQly_01_001 : 344|8@1+ (1,0) [0|255] ""  Central_ECU
 SG_ Loc_AziAngleQly_01_004 : 408|8@1+ (1,0) [0|255] ""  Central_ECU
 SG_ Loc_AziAngleQly_01_003 : 384|8@1+ (1,0) [0|255] ""  Central_ECU
 SG_ Loc_AziAngleQly_01_002 : 360|8@1+ (1,0) [0|255] ""  Central_ECU
 SG_ Loc_AziAngleQly_01_001 : 336|8@1+ (1,0) [0|255] ""  Central_ECU
 SG_ Loc_RadialDistVeloQly_01_004 : 400|8@1+ (1,0) [0|255] ""  Central_ECU
 SG_ Loc_RadialDistVeloQly_01_003 : 376|8@1+ (1,0) [0|255] ""  Central_ECU
 SG_ Loc_RadialDistVeloQly_01_002 : 352|8@1+ (1,0) [0|255] ""  Central_ECU
 SG_ Loc_RadialDistVeloQly_01_001 : 328|8@1+ (1,0) [0|255] ""  Central_ECU
 SG_ Loc_Validity_01_004 : 327|1@1+ (1,0) [0|1] ""  Central_ECU
 SG_ Loc_Validity_01_003 : 326|1@1+ (1,0) [0|1] ""  Central_ECU
 SG_ Loc_Validity_01_002 : 325|1@1+ (1,0) [0|1] ""  Central_ECU
 SG_ Loc_Validity_01_001 : 324|1@1+ (1,0) [0|1] ""  Central_ECU
 SG_ Loc_01_Blockcnt : 320|4@1+ (1,0) [0|15] ""  Central_ECU
 SG_ Loc_01_CRC : 296|16@1+ (1,0) [0|65535] ""  Central_ECU
 SG_ Loc_01_AliveCtr : 312|8@1+ (1,0) [0|255] ""  Central_ECU
 SG_ Loc_SNR_01_004 : 237|11@1+ (0.0625,0) [0|40] "dB"  Central_ECU
 SG_ Loc_SNR_01_003 : 163|11@1+ (0.0625,0) [0|40] "dB"  Central_ECU
 SG_ Loc_SNR_01_002 : 89|11@1+ (0.0625,0) [0|40] "dB"  Central_ECU
 SG_ Loc_RCS_01_004 : 286|10@1+ (0.125,-50) [-50|70] "dBm^2"  Central_ECU
 SG_ Loc_RCS_01_003 : 212|10@1+ (0.125,-50) [-50|70] "dBm^2"  Central_ECU
 SG_ Loc_RCS_01_002 : 138|10@1+ (0.125,-50) [-50|70] "dBm^2"  Central_ECU
 SG_ Loc_RadialVelo_01_004 : 248|15@1+ (0.0078125,-128) [-128|127] "m/s"  Central_ECU
 SG_ Loc_RadialVelo_01_003 : 174|15@1+ (0.0078125,-128) [-128|127] "m/s"  Central_ECU
 SG_ Loc_RadialVelo_01_002 : 100|15@1+ (0.0078125,-128) [-128|127] "m/s"  Central_ECU
 SG_ Loc_RadialDist_01_004 : 222|15@1+ (0.0078125,0) [0|250] "m"  Central_ECU
 SG_ Loc_RadialDist_01_003 : 148|15@1+ (0.0078125,0) [0|250] "m"  Central_ECU
 SG_ Loc_RadialDist_01_002 : 74|15@1+ (0.0078125,0) [0|250] "m"  Central_ECU
 SG_ Loc_ElevAngle_01_004 : 275|11@1+ (0.001,-0.785) [-0.785|0.785] "rad"  Central_ECU
 SG_ Loc_ElevAngle_01_003 : 201|11@1+ (0.001,-0.785) [-0.785|0.785] "rad"  Central_ECU
 SG_ Loc_ElevAngle_01_002 : 127|11@1+ (0.001,-0.785) [-0.785|0.785] "rad"  Central_ECU
 SG_ Loc_AziAngle_01_004 : 263|12@1+ (0.001,-1.57) [-1.57|1.57] "rad"  Central_ECU
 SG_ Loc_AziAngle_01_003 : 189|12@1+ (0.001,-1.57) [-1.57|1.57] "rad"  Central_ECU
 SG_ Loc_AziAngle_01_002 : 115|12@1+ (0.001,-1.57) [-1.57|1.57] "rad"  Central_ECU
 SG_ Loc_RCS_01_001 : 64|10@1+ (0.125,-50) [-50|70] "dBm^2"  Central_ECU
 SG_ Loc_ElevAngle_01_001 : 53|11@1+ (0.001,-0.785) [-0.785|0.785] "rad"  Central_ECU
 SG_ Loc_AziAngle_01_001 : 41|12@1+ (0.001,-1.57) [-1.57|1.57] "rad"  Central_ECU
 SG_ Loc_RadialVelo_01_001 : 26|15@1+ (0.0078125,-128) [-128|127] "m/s"  Central_ECU
 SG_ Loc_SNR_01_001 : 15|11@1+ (0.0625,0) [0|40] "dB"  Central_ECU
 SG_ Loc_RadialDist_01_001 : 0|15@1+ (0.0078125,0) [0|250] "m"  Central_ECU

BO_ 514 Location_Data_02: 64 Radar
 SG_ Loc_ElevAngleQly_02_004 : 416|8@1+ (1,0) [0|255] ""  Central_ECU
 SG_ Loc_ElevAngleQly_02_003 : 392|8@1+ (1,0) [0|255] ""  Central_ECU
 SG_ Loc_ElevAngleQly_02_002 : 368|8@1+ (1,0) [0|255] ""  Central_ECU
 SG_ Loc_ElevAngleQly_02_001 : 344|8@1+ (1,0) [0|255] ""  Central_ECU
 SG_ Loc_AziAngleQly_02_004 : 408|8@1+ (1,0) [0|255] ""  Central_ECU
 SG_ Loc_AziAngleQly_02_003 : 384|8@1+ (1,0) [0|255] ""  Central_ECU
 SG_ Loc_AziAngleQly_02_002 : 360|8@1+ (1,0) [0|255] ""  Central_ECU
 SG_ Loc_AziAngleQly_02_001 : 336|8@1+ (1,0) [0|255] ""  Central_ECU
 SG_ Loc_RadialDistVeloQly_02_004 : 400|8@1+ (1,0) [0|255] ""  Central_ECU
 SG_ Loc_RadialDistVeloQly_02_003 : 376|8@1+ (1,0) [0|255] ""  Central_ECU
 SG_ Loc_RadialDistVeloQly_02_002 : 352|8@1+ (1,0) [0|255] ""  Central_ECU
 SG_ Loc_RadialDistVeloQly_02_001 : 328|8@1+ (1,0) [0|255] ""  Central_ECU
 SG_ Loc_Validity_02_004 : 327|1@1+ (1,0) [0|1] ""  Central_ECU
 SG_ Loc_Validity_02_003 : 326|1@1+ (1,0) [0|1] ""  Central_ECU
 SG_ Loc_Validity_02_002 : 325|1@1+ (1,0) [0|1] ""  Central_ECU
 SG_ Loc_Validity_02_001 : 324|1@1+ (1,0) [0|1] ""  Central_ECU
 SG_ Loc_02_Blockcnt : 320|4@1+ (1,0) [0|15] ""  Central_ECU
 SG_ Loc_02_CRC : 296|16@1+ (1,0) [0|65535] ""  Central_ECU
 SG_ Loc_02_AliveCtr : 312|8@1+ (1,0) [0|255] ""  Central_ECU
 SG_ Loc_SNR_02_004 : 237|11@1+ (0.0625,0) [0|40] "dB"  Central_ECU
 SG_ Loc_SNR_02_003 : 163|11@1+ (0.0625,0) [0|40] "dB"  Central_ECU
 SG_ Loc_SNR_02_002 : 89|11@1+ (0.0625,0) [0|40] "dB"  Central_ECU
 SG_ Loc_RCS_02_004 : 286|10@1+ (0.125,-50) [-50|70] "dBm^2"  Central_ECU
 SG_ Loc_RCS_02_003 : 212|10@1+ (0.125,-50) [-50|70] "dBm^2"  Central_ECU
 SG_ Loc_RCS_02_002 : 138|10@1+ (0.125,-50) [-50|70] "dBm^2"  Central_ECU
 SG_ Loc_RadialVelo_02_004 : 248|15@1+ (0.0078125,-128) [-128|127] "m/s"  Central_ECU
 SG_ Loc_RadialVelo_02_003 : 174|15@1+ (0.0078125,-128) [-128|127] "m/s"  Central_ECU
 SG_ Loc_RadialVelo_02_002 : 100|15@1+ (0.0078125,-128) [-128|127] "m/s"  Central_ECU
 SG_ Loc_RadialDist_02_004 : 222|15@1+ (0.0078125,0) [0|250] "m"  Central_ECU
 SG_ Loc_RadialDist_02_003 : 148|15@1+ (0.0078125,0) [0|250] "m"  Central_ECU
 SG_ Loc_RadialDist_02_002 : 74|15@1+ (0.0078125,0) [0|250] "m"  Central_ECU
 SG_ Loc_ElevAngle_02_004 : 275|11@1+ (0.001,-0.785) [-0.785|0.785] "rad"  Central_ECU
 SG_ Loc_ElevAngle_02_003 : 201|11@1+ (0.001,-0.785) [-0.785|0.785] "rad"  Central_ECU
 SG_ Loc_ElevAngle_02_002 : 127|11@1+ (0.001,-0.785) [-0.785|0.785] "rad"  Central_ECU
 SG_ Loc_AziAngle_02_004 : 263|12@1+ (0.001,-1.57) [-1.57|1.57] "rad"  Central_ECU
 SG_ Loc_AziAngle_02_003 : 189|12@1+ (0.001,-1.57) [-1.57|1.57] "rad"  Central_ECU
 SG_ Loc_AziAngle_02_002 : 115|12@1+ (0.001,-1.57) [-1.57|1.57] "rad"  Central_ECU
 SG_ Loc_RCS_02_001 : 64|10@1+ (0.125,-50) [-50|70] "dBm^2"  Central_ECU
 SG_ Loc_ElevAngle_02_001 : 53|11@1+ (0.001,-0.785) [-0.785|0.785] "rad"  Central_ECU
 SG_ Loc_AziAngle_02_001 : 41|12@1+ (0.001,-1.57) [-1.57|1.57] "rad"  Central_ECU
 SG_ Loc_RadialVelo_02_001 : 26|15@1+ (0.0078125,-128) [-128|127] "m/s"  Central_ECU
 SG_ Loc_SNR_02_001 : 15|11@1+ (0.0625,0) [0|40] "dB"  Central_ECU
 SG_ Loc_RadialDist_02_001 : 0|15@1+ (0.0078125,0) [0|250] "m"  Central_ECU

BO_ 515 Location_Data_03: 64 Radar
 SG_ Loc_ElevAngleQly_03_004 : 416|8@1+ (1,0) [0|255] ""  Central_ECU
 SG_ Loc_ElevAngleQly_03_003 : 392|8@1+ (1,0) [0|255] ""  Central_ECU
 SG_ Loc_ElevAngleQly_03_002 : 368|8@1+ (1,0) [0|255] ""  Central_ECU
 SG_ Loc_ElevAngleQly_03_001 : 344|8@1+ (1,0) [0|255] ""  Central_ECU
 SG_ Loc_AziAngleQly_03_004 : 408|8@1+ (1,0) [0|255] ""  Central_ECU
 SG_ Loc_AziAngleQly_03_003 : 384|8@1+ (1,0) [0|255] ""  Central_ECU
 SG_ Loc_AziAngleQly_03_002 : 360|8@1+ (1,0) [0|255] ""  Central_ECU
 SG_ Loc_AziAngleQly_03_001 : 336|8@1+ (1,0) [0|255] ""  Central_ECU
 SG_ Loc_RadialDistVeloQly_03_004 : 400|8@1+ (1,0) [0|255] ""  Central_ECU
 SG_ Loc_RadialDistVeloQly_03_003 : 376|8@1+ (1,0) [0|255] ""  Central_ECU
 SG_ Loc_RadialDistVeloQly_03_002 : 352|8@1+ (1,0) [0|255] ""  Central_ECU
 SG_ Loc_RadialDistVeloQly_03_001 : 328|8@1+ (1,0) [0|255] ""  Central_ECU
 SG_ Loc_Validity_03_004 : 327|1@1+ (1,0) [0|1] ""  Central_ECU
 SG_ Loc_Validity_03_003 : 326|1@1+ (1,0) [0|1] ""  Central_ECU
 SG_ Loc_Validity_03_002 : 325|1@1+ (1,0) [0|1] ""  Central_ECU
 SG_ Loc_Validity_03_001 : 324|1@1+ (1,0) [0|1] ""  Central_ECU
 SG_ Loc_03_Blockcnt : 320|4@1+ (1,0) [0|15] ""  Central_ECU
 SG_ Loc_03_CRC : 296|16@1+ (1,0) [0|65535] ""  Central_ECU
 SG_ Loc_03_AliveCtr : 312|8@1+ (1,0) [0|255] ""  Central_ECU
 SG_ Loc_SNR_03_004 : 237|11@1+ (0.0625,0) [0|40] "dB"  Central_ECU
 SG_ Loc_SNR_03_003 : 163|11@1+ (0.0625,0) [0|40] "dB"  Central_ECU
 SG_ Loc_SNR_03_002 : 89|11@1+ (0.0625,0) [0|40] "dB"  Central_ECU
 SG_ Loc_RCS_03_004 : 286|10@1+ (0.125,-50) [-50|70] "dBm^2"  Central_ECU
 SG_ Loc_RCS_03_003 : 212|10@1+ (0.125,-50) [-50|70] "dBm^2"  Central_ECU
 SG_ Loc_RCS_03_002 : 138|10@1+ (0.125,-50) [-50|70] "dBm^2"  Central_ECU
 SG_ Loc_RadialVelo_03_004 : 248|15@1+ (0.0078125,-128) [-128|127] "m/s"  Central_ECU
 SG_ Loc_RadialVelo_03_003 : 174|15@1+ (0.0078125,-128) [-128|127] "m/s"  Central_ECU
 SG_ Loc_RadialVelo_03_002 : 100|15@1+ (0.0078125,-128) [-128|127] "m/s"  Central_ECU
 SG_ Loc_RadialDist_03_004 : 222|15@1+ (0.0078125,0) [0|250] "m"  Central_ECU
 SG_ Loc_RadialDist_03_003 : 148|15@1+ (0.0078125,0) [0|250] "m"  Central_ECU
 SG_ Loc_RadialDist_03_002 : 74|15@1+ (0.0078125,0) [0|250] "m"  Central_ECU
 SG_ Loc_ElevAngle_03_004 : 275|11@1+ (0.001,-0.785) [-0.785|0.785] "rad"  Central_ECU
 SG_ Loc_ElevAngle_03_003 : 201|11@1+ (0.001,-0.785) [-0.785|0.785] "rad"  Central_ECU
 SG_ Loc_ElevAngle_03_002 : 127|11@1+ (0.001,-0.785) [-0.785|0.785] "rad"  Central_ECU
 SG_ Loc_AziAngle_03_004 : 263|12@1+ (0.001,-1.57) [-1.57|1.57] "rad"  Central_ECU
 SG_ Loc_AziAngle_03_003 : 189|12@1+ (0.001,-1.57) [-1.57|1.57] "rad"  Central_ECU
 SG_ Loc_AziAngle_03_002 : 115|12@1+ (0.001,-1.57) [-1.57|1.57] "rad"  Central_ECU
 SG_ Loc_RCS_03_001 : 64|10@1+ (0.125,-50) [-50|70] "dBm^2"  Central_ECU
 SG_ Loc_ElevAngle_03_001 : 53|11@1+ (0.001,-0.785) [-0.785|0.785] "rad"  Central_ECU
 SG_ Loc_AziAngle_03_001 : 41|12@1+ (0.001,-1.57) [-1.57|1.57] "rad"  Central_ECU
 SG_ Loc_RadialVelo_03_001 : 26|15@1+ (0.0078125,-128) [-128|127] "m/s"  Central_ECU
 SG_ Loc_SNR_03_001 : 15|11@1+ (0.0625,0) [0|40] "dB"  Central_ECU
 SG_ Loc_RadialDist_03_001 : 0|15@1+ (0.0078125,0) [0|250] "m"  Central_ECU

BO_ 516 Location_Data_04: 64 Radar
 SG_ Loc_ElevAngleQly_04_004 : 416|8@1+ (1,0) [0|255] ""  Central_ECU
 SG_ Loc_ElevAngleQly_04_003 : 392|8@1+ (1,0) [0|255] ""  Central_ECU
 SG_ Loc_ElevAngleQly_04_002 : 368|8@1+ (1,0) [0|255] ""  Central_ECU
 SG_ Loc_ElevAngleQly_04_001 : 344|8@1+ (1,0) [0|255] ""  Central_ECU
 SG_ Loc_AziAngleQly_04_004 : 408|8@1+ (1,0) [0|255] ""  Central_ECU
 SG_ Loc_AziAngleQly_04_003 : 384|8@1+ (1,0) [0|255] ""  Central_ECU
 SG_ Loc_AziAngleQly_04_002 : 360|8@1+ (1,0) [0|255] ""  Central_ECU
 SG_ Loc_AziAngleQly_04_001 : 336|8@1+ (1,0) [0|255] ""  Central_ECU
 SG_ Loc_RadialDistVeloQly_04_004 : 400|8@1+ (1,0) [0|255] ""  Central_ECU
 SG_ Loc_RadialDistVeloQly_04_003 : 376|8@1+ (1,0) [0|255] ""  Central_ECU
 SG_ Loc_RadialDistVeloQly_04_002 : 352|8@1+ (1,0) [0|255] ""  Central_ECU
 SG_ Loc_RadialDistVeloQly_04_001 : 328|8@1+ (1,0) [0|255] ""  Central_ECU
 SG_ Loc_Validity_04_004 : 327|1@1+ (1,0) [0|1] ""  Central_ECU
 SG_ Loc_Validity_04_003 : 326|1@1+ (1,0) [0|1] ""  Central_ECU
 SG_ Loc_Validity_04_002 : 325|1@1+ (1,0) [0|1] ""  Central_ECU
 SG_ Loc_Validity_04_001 : 324|1@1+ (1,0) [0|1] ""  Central_ECU
 SG_ Loc_04_Blockcnt : 320|4@1+ (1,0) [0|15] ""  Central_ECU
 SG_ Loc_04_CRC : 296|16@1+ (1,0) [0|65535] ""  Central_ECU
 SG_ Loc_04_AliveCtr : 312|8@1+ (1,0) [0|255] ""  Central_ECU
 SG_ Loc_SNR_04_004 : 237|11@1+ (0.0625,0) [0|40] "dB"  Central_ECU
 SG_ Loc_SNR_04_003 : 163|11@1+ (0.0625,0) [0|40] "dB"  Central_ECU
 SG_ Loc_SNR_04_002 : 89|11@1+ (0.0625,0) [0|40] "dB"  Central_ECU
 SG_ Loc_RCS_04_004 : 286|10@1+ (0.125,-50) [-50|70] "dBm^2"  Central_ECU
 SG_ Loc_RCS_04_003 : 212|10@1+ (0.125,-50) [-50|70] "dBm^2"  Central_ECU
 SG_ Loc_RCS_04_002 : 138|10@1+ (0.125,-50) [-50|70] "dBm^2"  Central_ECU
 SG_ Loc_RadialVelo_04_004 : 248|15@1+ (0.0078125,-128) [-128|127] "m/s"  Central_ECU
 SG_ Loc_RadialVelo_04_003 : 174|15@1+ (0.0078125,-128) [-128|127] "m/s"  Central_ECU
 SG_ Loc_RadialVelo_04_002 : 100|15@1+ (0.0078125,-128) [-128|127] "m/s"  Central_ECU
 SG_ Loc_RadialDist_04_004 : 222|15@1+ (0.0078125,0) [0|250] "m"  Central_ECU
 SG_ Loc_RadialDist_04_003 : 148|15@1+ (0.0078125,0) [0|250] "m"  Central_ECU
 SG_ Loc_RadialDist_04_002 : 74|15@1+ (0.0078125,0) [0|250] "m"  Central_ECU
 SG_ Loc_ElevAngle_04_004 : 275|11@1+ (0.001,-0.785) [-0.785|0.785] "rad"  Central_ECU
 SG_ Loc_ElevAngle_04_003 : 201|11@1+ (0.001,-0.785) [-0.785|0.785] "rad"  Central_ECU
 SG_ Loc_ElevAngle_04_002 : 127|11@1+ (0.001,-0.785) [-0.785|0.785] "rad"  Central_ECU
 SG_ Loc_AziAngle_04_004 : 263|12@1+ (0.001,-1.57) [-1.57|1.57] "rad"  Central_ECU
 SG_ Loc_AziAngle_04_003 : 189|12@1+ (0.001,-1.57) [-1.57|1.57] "rad"  Central_ECU
 SG_ Loc_AziAngle_04_002 : 115|12@1+ (0.001,-1.57) [-1.57|1.57] "rad"  Central_ECU
 SG_ Loc_RCS_04_001 : 64|10@1+ (0.125,-50) [-50|70] "dBm^2"  Central_ECU
 SG_ Loc_ElevAngle_04_001 : 53|11@1+ (0.001,-0.785) [-0.785|0.785] "rad"  Central_ECU
 SG_ Loc_AziAngle_04_001 : 41|12@1+ (0.001,-1.57) [-1.57|1.57] "rad"  Central_ECU
 SG_ Loc_RadialVelo_04_001 : 26|15@1+ (0.0078125,-128) [-128|127] "m/s"  Central_ECU
 SG_ Loc_SNR_04_001 : 15|11@1+ (0.0625,0) [0|40] "dB"  Central_ECU
 SG_ Loc_RadialDist_04_001 : 0|15@1+ (0.0078125,0) [0|250] "m"  Central_ECU

BO_ 517 Location_Data_05: 64 Radar
 SG_ Loc_ElevAngleQly_05_004 : 416|8@1+ (1,0) [0|255] ""  Central_ECU
 SG_ Loc_ElevAngleQly_05_003 : 392|8@1+ (1,0) [0|255] ""  Central_ECU
 SG_ Loc_ElevAngleQly_05_002 : 368|8@1+ (1,0) [0|255] ""  Central_ECU
 SG_ Loc_ElevAngleQly_05_001 : 344|8@1+ (1,0) [0|255] ""  Central_ECU
 SG_ Loc_AziAngleQly_05_004 : 408|8@1+ (1,0) [0|255] ""  Central_ECU
 SG_ Loc_AziAngleQly_05_003 : 384|8@1+ (1,0) [0|255] ""  Central_ECU
 SG_ Loc_AziAngleQly_05_002 : 360|8@1+ (1,0) [0|255] ""  Central_ECU
 SG_ Loc_AziAngleQly_05_001 : 336|8@1+ (1,0) [0|255] ""  Central_ECU
 SG_ Loc_RadialDistVeloQly_05_004 : 400|8@1+ (1,0) [0|255] ""  Central_ECU
 SG_ Loc_RadialDistVeloQly_05_003 : 376|8@1+ (1,0) [0|255] ""  Central_ECU
 SG_ Loc_RadialDistVeloQly_05_002 : 352|8@1+ (1,0) [0|255] ""  Central_ECU
 SG_ Loc_RadialDistVeloQly_05_001 : 328|8@1+ (1,0) [0|255] ""  Central_ECU
 SG_ Loc_Validity_05_004 : 327|1@1+ (1,0) [0|1] ""  Central_ECU
 SG_ Loc_Validity_05_003 : 326|1@1+ (1,0) [0|1] ""  Central_ECU
 SG_ Loc_Validity_05_002 : 325|1@1+ (1,0) [0|1] ""  Central_ECU
 SG_ Loc_Validity_05_001 : 324|1@1+ (1,0) [0|1] ""  Central_ECU
 SG_ Loc_05_Blockcnt : 320|4@1+ (1,0) [0|15] ""  Central_ECU
 SG_ Loc_05_CRC : 296|16@1+ (1,0) [0|65535] ""  Central_ECU
 SG_ Loc_05_AliveCtr : 312|8@1+ (1,0) [0|255] ""  Central_ECU
 SG_ Loc_SNR_05_004 : 237|11@1+ (0.0625,0) [0|40] "dB"  Central_ECU
 SG_ Loc_SNR_05_003 : 163|11@1+ (0.0625,0) [0|40] "dB"  Central_ECU
 SG_ Loc_SNR_05_002 : 89|11@1+ (0.0625,0) [0|40] "dB"  Central_ECU
 SG_ Loc_RCS_05_004 : 286|10@1+ (0.125,-50) [-50|70] "dBm^2"  Central_ECU
 SG_ Loc_RCS_05_003 : 212|10@1+ (0.125,-50) [-50|70] "dBm^2"  Central_ECU
 SG_ Loc_RCS_05_002 : 138|10@1+ (0.125,-50) [-50|70] "dBm^2"  Central_ECU
 SG_ Loc_RadialVelo_05_004 : 248|15@1+ (0.0078125,-128) [-128|127] "m/s"  Central_ECU
 SG_ Loc_RadialVelo_05_003 : 174|15@1+ (0.0078125,-128) [-128|127] "m/s"  Central_ECU
 SG_ Loc_RadialVelo_05_002 : 100|15@1+ (0.0078125,-128) [-128|127] "m/s"  Central_ECU
 SG_ Loc_RadialDist_05_004 : 222|15@1+ (0.0078125,0) [0|250] "m"  Central_ECU
 SG_ Loc_RadialDist_05_003 : 148|15@1+ (0.0078125,0) [0|250] "m"  Central_ECU
 SG_ Loc_RadialDist_05_002 : 74|15@1+ (0.0078125,0) [0|250] "m"  Central_ECU
 SG_ Loc_ElevAngle_05_004 : 275|11@1+ (0.001,-0.785) [-0.785|0.785] "rad"  Central_ECU
 SG_ Loc_ElevAngle_05_003 : 201|11@1+ (0.001,-0.785) [-0.785|0.785] "rad"  Central_ECU
 SG_ Loc_ElevAngle_05_002 : 127|11@1+ (0.001,-0.785) [-0.785|0.785] "rad"  Central_ECU
 SG_ Loc_AziAngle_05_004 : 263|12@1+ (0.001,-1.57) [-1.57|1.57] "rad"  Central_ECU
 SG_ Loc_AziAngle_05_003 : 189|12@1+ (0.001,-1.57) [-1.57|1.57] "rad"  Central_ECU
 SG_ Loc_AziAngle_05_002 : 115|12@1+ (0.001,-1.57) [-1.57|1.57] "rad"  Central_ECU
 SG_ Loc_RCS_05_001 : 64|10@1+ (0.125,-50) [-50|70] "dBm^2"  Central_ECU
 SG_ Loc_ElevAngle_05_001 : 53|11@1+ (0.001,-0.785) [-0.785|0.785] "rad"  Central_ECU
 SG_ Loc_AziAngle_05_001 : 41|12@1+ (0.001,-1.57) [-1.57|1.57] "rad"  Central_ECU
 SG_ Loc_RadialVelo_05_001 : 26|15@1+ (0.0078125,-128) [-128|127] "m/s"  Central_ECU
 SG_ Loc_SNR_05_001 : 15|11@1+ (0.0625,0) [0|40] "dB"  Central_ECU
 SG_ Loc_RadialDist_05_001 : 0|15@1+ (0.0078125,0) [0|250] "m"  Central_ECU

BO_ 518 Location_Data_06: 64 Radar
 SG_ Loc_ElevAngleQly_06_004 : 416|8@1+ (1,0) [0|255] ""  Central_ECU
 SG_ Loc_ElevAngleQly_06_003 : 392|8@1+ (1,0) [0|255] ""  Central_ECU
 SG_ Loc_ElevAngleQly_06_002 : 368|8@1+ (1,0) [0|255] ""  Central_ECU
 SG_ Loc_ElevAngleQly_06_001 : 344|8@1+ (1,0) [0|255] ""  Central_ECU
 SG_ Loc_AziAngleQly_06_004 : 408|8@1+ (1,0) [0|255] ""  Central_ECU
 SG_ Loc_AziAngleQly_06_003 : 384|8@1+ (1,0) [0|255] ""  Central_ECU
 SG_ Loc_AziAngleQly_06_002 : 360|8@1+ (1,0) [0|255] ""  Central_ECU
 SG_ Loc_AziAngleQly_06_001 : 336|8@1+ (1,0) [0|255] ""  Central_ECU
 SG_ Loc_RadialDistVeloQly_06_004 : 400|8@1+ (1,0) [0|255] ""  Central_ECU
 SG_ Loc_RadialDistVeloQly_06_003 : 376|8@1+ (1,0) [0|255] ""  Central_ECU
 SG_ Loc_RadialDistVeloQly_06_002 : 352|8@1+ (1,0) [0|255] ""  Central_ECU
 SG_ Loc_RadialDistVeloQly_06_001 : 328|8@1+ (1,0) [0|255] ""  Central_ECU
 SG_ Loc_Validity_06_004 : 327|1@1+ (1,0) [0|1] ""  Central_ECU
 SG_ Loc_Validity_06_003 : 326|1@1+ (1,0) [0|1] ""  Central_ECU
 SG_ Loc_Validity_06_002 : 325|1@1+ (1,0) [0|1] ""  Central_ECU
 SG_ Loc_Validity_06_001 : 324|1@1+ (1,0) [0|1] ""  Central_ECU
 SG_ Loc_06_Blockcnt : 320|4@1+ (1,0) [0|15] ""  Central_ECU
 SG_ Loc_06_CRC : 296|16@1+ (1,0) [0|65535] ""  Central_ECU
 SG_ Loc_06_AliveCtr : 312|8@1+ (1,0) [0|255] ""  Central_ECU
 SG_ Loc_SNR_06_004 : 237|11@1+ (0.0625,0) [0|40] "dB"  Central_ECU
 SG_ Loc_SNR_06_003 : 163|11@1+ (0.0625,0) [0|40] "dB"  Central_ECU
 SG_ Loc_SNR_06_002 : 89|11@1+ (0.0625,0) [0|40] "dB"  Central_ECU
 SG_ Loc_RCS_06_004 : 286|10@1+ (0.125,-50) [-50|70] "dBm^2"  Central_ECU
 SG_ Loc_RCS_06_003 : 212|10@1+ (0.125,-50) [-50|70] "dBm^2"  Central_ECU
 SG_ Loc_RCS_06_002 : 138|10@1+ (0.125,-50) [-50|70] "dBm^2"  Central_ECU
 SG_ Loc_RadialVelo_06_004 : 248|15@1+ (0.0078125,-128) [-128|127] "m/s"  Central_ECU
 SG_ Loc_RadialVelo_06_003 : 174|15@1+ (0.0078125,-128) [-128|127] "m/s"  Central_ECU
 SG_ Loc_RadialVelo_06_002 : 100|15@1+ (0.0078125,-128) [-128|127] "m/s"  Central_ECU
 SG_ Loc_RadialDist_06_004 : 222|15@1+ (0.0078125,0) [0|250] "m"  Central_ECU
 SG_ Loc_RadialDist_06_003 : 148|15@1+ (0.0078125,0) [0|250] "m"  Central_ECU
 SG_ Loc_RadialDist_06_002 : 74|15@1+ (0.0078125,0) [0|250] "m"  Central_ECU
 SG_ Loc_ElevAngle_06_004 : 275|11@1+ (0.001,-0.785) [-0.785|0.785] "rad"  Central_ECU
 SG_ Loc_ElevAngle_06_003 : 201|11@1+ (0.001,-0.785) [-0.785|0.785] "rad"  Central_ECU
 SG_ Loc_ElevAngle_06_002 : 127|11@1+ (0.001,-0.785) [-0.785|0.785] "rad"  Central_ECU
 SG_ Loc_AziAngle_06_004 : 263|12@1+ (0.001,-1.57) [-1.57|1.57] "rad"  Central_ECU
 SG_ Loc_AziAngle_06_003 : 189|12@1+ (0.001,-1.57) [-1.57|1.57] "rad"  Central_ECU
 SG_ Loc_AziAngle_06_002 : 115|12@1+ (0.001,-1.57) [-1.57|1.57] "rad"  Central_ECU
 SG_ Loc_RCS_06_001 : 64|10@1+ (0.125,-50) [-50|70] "dBm^2"  Central_ECU
 SG_ Loc_ElevAngle_06_001 : 53|11@1+ (0.001,-0.785) [-0.785|0.785] "rad"  Central_ECU
 SG_ Loc_AziAngle_06_001 : 41|12@1+ (0.001,-1.57) [-1.57|1.57] "rad"  Central_ECU
 SG_ Loc_RadialVelo_06_001 : 26|15@1+ (0.0078125,-128) [-128|127] "m/s"  Central_ECU
 SG_ Loc_SNR_06_001 : 15|11@1+ (0.0625,0) [0|40] "dB"  Central_ECU
 SG_ Loc_RadialDist_06_001 : 0|15@1+ (0.0078125,0) [0|250] "m"  Central_ECU

BO_ 519 Location_Data_07: 64 Radar
 SG_ Loc_ElevAngleQly_07_004 : 416|8@1+ (1,0) [0|255] ""  Central_ECU
 SG_ Loc_ElevAngleQly_07_003 : 392|8@1+ (1,0) [0|255] ""  Central_ECU
 SG_ Loc_ElevAngleQly_07_002 : 368|8@1+ (1,0) [0|255] ""  Central_ECU
 SG_ Loc_ElevAngleQly_07_001 : 344|8@1+ (1,0) [0|255] ""  Central_ECU
 SG_ Loc_AziAngleQly_07_004 : 408|8@1+ (1,0) [0|255] ""  Central_ECU
 SG_ Loc_AziAngleQly_07_003 : 384|8@1+ (1,0) [0|255] ""  Central_ECU
 SG_ Loc_AziAngleQly_07_002 : 360|8@1+ (1,0) [0|255] ""  Central_ECU
 SG_ Loc_AziAngleQly_07_001 : 336|8@1+ (1,0) [0|255] ""  Central_ECU
 SG_ Loc_RadialDistVeloQly_07_004 : 400|8@1+ (1,0) [0|255] ""  Central_ECU
 SG_ Loc_RadialDistVeloQly_07_003 : 376|8@1+ (1,0) [0|255] ""  Central_ECU
 SG_ Loc_RadialDistVeloQly_07_002 : 352|8@1+ (1,0) [0|255] ""  Central_ECU
 SG_ Loc_RadialDistVeloQly_07_001 : 328|8@1+ (1,0) [0|255] ""  Central_ECU
 SG_ Loc_Validity_07_004 : 327|1@1+ (1,0) [0|1] ""  Central_ECU
 SG_ Loc_Validity_07_003 : 326|1@1+ (1,0) [0|1] ""  Central_ECU
 SG_ Loc_Validity_07_002 : 325|1@1+ (1,0) [0|1] ""  Central_ECU
 SG_ Loc_Validity_07_001 : 324|1@1+ (1,0) [0|1] ""  Central_ECU
 SG_ Loc_07_Blockcnt : 320|4@1+ (1,0) [0|15] ""  Central_ECU
 SG_ Loc_07_CRC : 296|16@1+ (1,0) [0|65535] ""  Central_ECU
 SG_ Loc_07_AliveCtr : 312|8@1+ (1,0) [0|255] ""  Central_ECU
 SG_ Loc_SNR_07_004 : 237|11@1+ (0.0625,0) [0|40] "dB"  Central_ECU
 SG_ Loc_SNR_07_003 : 163|11@1+ (0.0625,0) [0|40] "dB"  Central_ECU
 SG_ Loc_SNR_07_002 : 89|11@1+ (0.0625,0) [0|40] "dB"  Central_ECU
 SG_ Loc_RCS_07_004 : 286|10@1+ (0.125,-50) [-50|70] "dBm^2"  Central_ECU
 SG_ Loc_RCS_07_003 : 212|10@1+ (0.125,-50) [-50|70] "dBm^2"  Central_ECU
 SG_ Loc_RCS_07_002 : 138|10@1+ (0.125,-50) [-50|70] "dBm^2"  Central_ECU
 SG_ Loc_RadialVelo_07_004 : 248|15@1+ (0.0078125,-128) [-128|127] "m/s"  Central_ECU
 SG_ Loc_RadialVelo_07_003 : 174|15@1+ (0.0078125,-128) [-128|127] "m/s"  Central_ECU
 SG_ Loc_RadialVelo_07_002 : 100|15@1+ (0.0078125,-128) [-128|127] "m/s"  Central_ECU
 SG_ Loc_RadialDist_07_004 : 222|15@1+ (0.0078125,0) [0|250] "m"  Central_ECU
 SG_ Loc_RadialDist_07_003 : 148|15@1+ (0.0078125,0) [0|250] "m"  Central_ECU
 SG_ Loc_RadialDist_07_002 : 74|15@1+ (0.0078125,0) [0|250] "m"  Central_ECU
 SG_ Loc_ElevAngle_07_004 : 275|11@1+ (0.001,-0.785) [-0.785|0.785] "rad"  Central_ECU
 SG_ Loc_ElevAngle_07_003 : 201|11@1+ (0.001,-0.785) [-0.785|0.785] "rad"  Central_ECU
 SG_ Loc_ElevAngle_07_002 : 127|11@1+ (0.001,-0.785) [-0.785|0.785] "rad"  Central_ECU
 SG_ Loc_AziAngle_07_004 : 263|12@1+ (0.001,-1.57) [-1.57|1.57] "rad"  Central_ECU
 SG_ Loc_AziAngle_07_003 : 189|12@1+ (0.001,-1.57) [-1.57|1.57] "rad"  Central_ECU
 SG_ Loc_AziAngle_07_002 : 115|12@1+ (0.001,-1.57) [-1.57|1.57] "rad"  Central_ECU
 SG_ Loc_RCS_07_001 : 64|10@1+ (0.125,-50) [-50|70] "dBm^2"  Central_ECU
 SG_ Loc_ElevAngle_07_001 : 53|11@1+ (0.001,-0.785) [-0.785|0.785] "rad"  Central_ECU
 SG_ Loc_AziAngle_07_001 : 41|12@1+ (0.001,-1.57) [-1.57|1.57] "rad"  Central_ECU
 SG_ Loc_RadialVelo_07_001 : 26|15@1+ (0.0078125,-128) [-128|127] "m/s"  Central_ECU
 SG_ Loc_SNR_07_001 : 15|11@1+ (0.0625,0) [0|40] "dB"  Central_ECU
 SG_ Loc_RadialDist_07_001 : 0|15@1+ (0.0078125,0) [0|250] "m"  Central_ECU

BO_ 520 Location_Data_08: 64 Radar
 SG_ Loc_ElevAngleQly_08_004 : 416|8@1+ (1,0) [0|255] ""  Central_ECU
 SG_ Loc_ElevAngleQly_08_003 : 392|8@1+ (1,0) [0|255] ""  Central_ECU
 SG_ Loc_ElevAngleQly_08_002 : 368|8@1+ (1,0) [0|255] ""  Central_ECU
 SG_ Loc_ElevAngleQly_08_001 : 344|8@1+ (1,0) [0|255] ""  Central_ECU
 SG_ Loc_AziAngleQly_08_004 : 408|8@1+ (1,0) [0|255] ""  Central_ECU
 SG_ Loc_AziAngleQly_08_003 : 384|8@1+ (1,0) [0|255] ""  Central_ECU
 SG_ Loc_AziAngleQly_08_002 : 360|8@1+ (1,0) [0|255] ""  Central_ECU
 SG_ Loc_AziAngleQly_08_001 : 336|8@1+ (1,0) [0|255] ""  Central_ECU
 SG_ Loc_RadialDistVeloQly_08_004 : 400|8@1+ (1,0) [0|255] ""  Central_ECU
 SG_ Loc_RadialDistVeloQly_08_003 : 376|8@1+ (1,0) [0|255] ""  Central_ECU
 SG_ Loc_RadialDistVeloQly_08_002 : 352|8@1+ (1,0) [0|255] ""  Central_ECU
 SG_ Loc_RadialDistVeloQly_08_001 : 328|8@1+ (1,0) [0|255] ""  Central_ECU
 SG_ Loc_Validity_08_004 : 327|1@1+ (1,0) [0|1] ""  Central_ECU
 SG_ Loc_Validity_08_003 : 326|1@1+ (1,0) [0|1] ""  Central_ECU
 SG_ Loc_Validity_08_002 : 325|1@1+ (1,0) [0|1] ""  Central_ECU
 SG_ Loc_Validity_08_001 : 324|1@1+ (1,0) [0|1] ""  Central_ECU
 SG_ Loc_08_Blockcnt : 320|4@1+ (1,0) [0|15] ""  Central_ECU
 SG_ Loc_08_CRC : 296|16@1+ (1,0) [0|65535] ""  Central_ECU
 SG_ Loc_08_AliveCtr : 312|8@1+ (1,0) [0|255] ""  Central_ECU
 SG_ Loc_SNR_08_004 : 237|11@1+ (0.0625,0) [0|40] "dB"  Central_ECU
 SG_ Loc_SNR_08_003 : 163|11@1+ (0.0625,0) [0|40] "dB"  Central_ECU
 SG_ Loc_SNR_08_002 : 89|11@1+ (0.0625,0) [0|40] "dB"  Central_ECU
 SG_ Loc_RCS_08_004 : 286|10@1+ (0.125,-50) [-50|70] "dBm^2"  Central_ECU
 SG_ Loc_RCS_08_003 : 212|10@1+ (0.125,-50) [-50|70] "dBm^2"  Central_ECU
 SG_ Loc_RCS_08_002 : 138|10@1+ (0.125,-50) [-50|70] "dBm^2"  Central_ECU
 SG_ Loc_RadialVelo_08_004 : 248|15@1+ (0.0078125,-128) [-128|127] "m/s"  Central_ECU
 SG_ Loc_RadialVelo_08_003 : 174|15@1+ (0.0078125,-128) [-128|127] "m/s"  Central_ECU
 SG_ Loc_RadialVelo_08_002 : 100|15@1+ (0.0078125,-128) [-128|127] "m/s"  Central_ECU
 SG_ Loc_RadialDist_08_004 : 222|15@1+ (0.0078125,0) [0|250] "m"  Central_ECU
 SG_ Loc_RadialDist_08_003 : 148|15@1+ (0.0078125,0) [0|250] "m"  Central_ECU
 SG_ Loc_RadialDist_08_002 : 74|15@1+ (0.0078125,0) [0|250] "m"  Central_ECU
 SG_ Loc_ElevAngle_08_004 : 275|11@1+ (0.001,-0.785) [-0.785|0.785] "rad"  Central_ECU
 SG_ Loc_ElevAngle_08_003 : 201|11@1+ (0.001,-0.785) [-0.785|0.785] "rad"  Central_ECU
 SG_ Loc_ElevAngle_08_002 : 127|11@1+ (0.001,-0.785) [-0.785|0.785] "rad"  Central_ECU
 SG_ Loc_AziAngle_08_004 : 263|12@1+ (0.001,-1.57) [-1.57|1.57] "rad"  Central_ECU
 SG_ Loc_AziAngle_08_003 : 189|12@1+ (0.001,-1.57) [-1.57|1.57] "rad"  Central_ECU
 SG_ Loc_AziAngle_08_002 : 115|12@1+ (0.001,-1.57) [-1.57|1.57] "rad"  Central_ECU
 SG_ Loc_RCS_08_001 : 64|10@1+ (0.125,-50) [-50|70] "dBm^2"  Central_ECU
 SG_ Loc_ElevAngle_08_001 : 53|11@1+ (0.001,-0.785) [-0.785|0.785] "rad"  Central_ECU
 SG_ Loc_AziAngle_08_001 : 41|12@1+ (0.001,-1.57) [-1.57|1.57] "rad"  Central_ECU
 SG_ Loc_RadialVelo_08_001 : 26|15@1+ (0.0078125,-128) [-128|127] "m/s"  Central_ECU
 SG_ Loc_SNR_08_001 : 15|11@1+ (0.0625,0) [0|40] "dB"  Central_ECU
 SG_ Loc_RadialDist_08_001 : 0|15@1+ (0.0078125,0) [0|250] "m"  Central_ECU

BO_ 521 Location_Data_09: 64 Radar
 SG_ Loc_ElevAngleQly_09_004 : 416|8@1+ (1,0) [0|255] ""  Central_ECU
 SG_ Loc_ElevAngleQly_09_003 : 392|8@1+ (1,0) [0|255] ""  Central_ECU
 SG_ Loc_ElevAngleQly_09_002 : 368|8@1+ (1,0) [0|255] ""  Central_ECU
 SG_ Loc_ElevAngleQly_09_001 : 344|8@1+ (1,0) [0|255] ""  Central_ECU
 SG_ Loc_AziAngleQly_09_004 : 408|8@1+ (1,0) [0|255] ""  Central_ECU
 SG_ Loc_AziAngleQly_09_003 : 384|8@1+ (1,0) [0|255] ""  Central_ECU
 SG_ Loc_AziAngleQly_09_002 : 360|8@1+ (1,0) [0|255] ""  Central_ECU
 SG_ Loc_AziAngleQly_09_001 : 336|8@1+ (1,0) [0|255] ""  Central_ECU
 SG_ Loc_RadialDistVeloQly_09_004 : 400|8@1+ (1,0) [0|255] ""  Central_ECU
 SG_ Loc_RadialDistVeloQly_09_003 : 376|8@1+ (1,0) [0|255] ""  Central_ECU
 SG_ Loc_RadialDistVeloQly_09_002 : 352|8@1+ (1,0) [0|255] ""  Central_ECU
 SG_ Loc_RadialDistVeloQly_09_001 : 328|8@1+ (1,0) [0|255] ""  Central_ECU
 SG_ Loc_Validity_09_004 : 327|1@1+ (1,0) [0|1] ""  Central_ECU
 SG_ Loc_Validity_09_003 : 326|1@1+ (1,0) [0|1] ""  Central_ECU
 SG_ Loc_Validity_09_002 : 325|1@1+ (1,0) [0|1] ""  Central_ECU
 SG_ Loc_Validity_09_001 : 324|1@1+ (1,0) [0|1] ""  Central_ECU
 SG_ Loc_09_Blockcnt : 320|4@1+ (1,0) [0|15] ""  Central_ECU
 SG_ Loc_09_CRC : 296|16@1+ (1,0) [0|65535] ""  Central_ECU
 SG_ Loc_09_AliveCtr : 312|8@1+ (1,0) [0|255] ""  Central_ECU
 SG_ Loc_SNR_09_004 : 237|11@1+ (0.0625,0) [0|40] "dB"  Central_ECU
 SG_ Loc_SNR_09_003 : 163|11@1+ (0.0625,0) [0|40] "dB"  Central_ECU
 SG_ Loc_SNR_09_002 : 89|11@1+ (0.0625,0) [0|40] "dB"  Central_ECU
 SG_ Loc_RCS_09_004 : 286|10@1+ (0.125,-50) [-50|70] "dBm^2"  Central_ECU
 SG_ Loc_RCS_09_003 : 212|10@1+ (0.125,-50) [-50|70] "dBm^2"  Central_ECU
 SG_ Loc_RCS_09_002 : 138|10@1+ (0.125,-50) [-50|70] "dBm^2"  Central_ECU
 SG_ Loc_RadialVelo_09_004 : 248|15@1+ (0.0078125,-128) [-128|127] "m/s"  Central_ECU
 SG_ Loc_RadialVelo_09_003 : 174|15@1+ (0.0078125,-128) [-128|127] "m/s"  Central_ECU
 SG_ Loc_RadialVelo_09_002 : 100|15@1+ (0.0078125,-128) [-128|127] "m/s"  Central_ECU
 SG_ Loc_RadialDist_09_004 : 222|15@1+ (0.0078125,0) [0|250] "m"  Central_ECU
 SG_ Loc_RadialDist_09_003 : 148|15@1+ (0.0078125,0) [0|250] "m"  Central_ECU
 SG_ Loc_RadialDist_09_002 : 74|15@1+ (0.0078125,0) [0|250] "m"  Central_ECU
 SG_ Loc_ElevAngle_09_004 : 275|11@1+ (0.001,-0.785) [-0.785|0.785] "rad"  Central_ECU
 SG_ Loc_ElevAngle_09_003 : 201|11@1+ (0.001,-0.785) [-0.785|0.785] "rad"  Central_ECU
 SG_ Loc_ElevAngle_09_002 : 127|11@1+ (0.001,-0.785) [-0.785|0.785] "rad"  Central_ECU
 SG_ Loc_AziAngle_09_004 : 263|12@1+ (0.001,-1.57) [-1.57|1.57] "rad"  Central_ECU
 SG_ Loc_AziAngle_09_003 : 189|12@1+ (0.001,-1.57) [-1.57|1.57] "rad"  Central_ECU
 SG_ Loc_AziAngle_09_002 : 115|12@1+ (0.001,-1.57) [-1.57|1.57] "rad"  Central_ECU
 SG_ Loc_RCS_09_001 : 64|10@1+ (0.125,-50) [-50|70] "dBm^2"  Central_ECU
 SG_ Loc_ElevAngle_09_001 : 53|11@1+ (0.001,-0.785) [-0.785|0.785] "rad"  Central_ECU
 SG_ Loc_AziAngle_09_001 : 41|12@1+ (0.001,-1.57) [-1.57|1.57] "rad"  Central_ECU
 SG_ Loc_RadialVelo_09_001 : 26|15@1+ (0.0078125,-128) [-128|127] "m/s"  Central_ECU
 SG_ Loc_SNR_09_001 : 15|11@1+ (0.0625,0) [0|40] "dB"  Central_ECU
 SG_ Loc_RadialDist_09_001 : 0|15@1+ (0.0078125,0) [0|250] "m"  Central_ECU

BO_ 528 Location_Data_10: 64 Radar
 SG_ Loc_ElevAngleQly_10_004 : 416|8@1+ (1,0) [0|255] ""  Central_ECU
 SG_ Loc_ElevAngleQly_10_003 : 392|8@1+ (1,0) [0|255] ""  Central_ECU
 SG_ Loc_ElevAngleQly_10_002 : 368|8@1+ (1,0) [0|255] ""  Central_ECU
 SG_ Loc_ElevAngleQly_10_001 : 344|8@1+ (1,0) [0|255] ""  Central_ECU
 SG_ Loc_AziAngleQly_10_004 : 408|8@1+ (1,0) [0|255] ""  Central_ECU
 SG_ Loc_AziAngleQly_10_003 : 384|8@1+ (1,0) [0|255] ""  Central_ECU
 SG_ Loc_AziAngleQly_10_002 : 360|8@1+ (1,0) [0|255] ""  Central_ECU
 SG_ Loc_AziAngleQly_10_001 : 336|8@1+ (1,0) [0|255] ""  Central_ECU
 SG_ Loc_RadialDistVeloQly_10_004 : 400|8@1+ (1,0) [0|255] ""  Central_ECU
 SG_ Loc_RadialDistVeloQly_10_003 : 376|8@1+ (1,0) [0|255] ""  Central_ECU
 SG_ Loc_RadialDistVeloQly_10_002 : 352|8@1+ (1,0) [0|255] ""  Central_ECU
 SG_ Loc_RadialDistVeloQly_10_001 : 328|8@1+ (1,0) [0|255] ""  Central_ECU
 SG_ Loc_Validity_10_004 : 327|1@1+ (1,0) [0|1] ""  Central_ECU
 SG_ Loc_Validity_10_003 : 326|1@1+ (1,0) [0|1] ""  Central_ECU
 SG_ Loc_Validity_10_002 : 325|1@1+ (1,0) [0|1] ""  Central_ECU
 SG_ Loc_Validity_10_001 : 324|1@1+ (1,0) [0|1] ""  Central_ECU
 SG_ Loc_10_Blockcnt : 320|4@1+ (1,0) [0|15] ""  Central_ECU
 SG_ Loc_10_CRC : 296|16@1+ (1,0) [0|65535] ""  Central_ECU
 SG_ Loc_10_AliveCtr : 312|8@1+ (1,0) [0|255] ""  Central_ECU
 SG_ Loc_SNR_10_004 : 237|11@1+ (0.0625,0) [0|40] "dB"  Central_ECU
 SG_ Loc_SNR_10_003 : 163|11@1+ (0.0625,0) [0|40] "dB"  Central_ECU
 SG_ Loc_SNR_10_002 : 89|11@1+ (0.0625,0) [0|40] "dB"  Central_ECU
 SG_ Loc_RCS_10_004 : 286|10@1+ (0.125,-50) [-50|70] "dBm^2"  Central_ECU
 SG_ Loc_RCS_10_003 : 212|10@1+ (0.125,-50) [-50|70] "dBm^2"  Central_ECU
 SG_ Loc_RCS_10_002 : 138|10@1+ (0.125,-50) [-50|70] "dBm^2"  Central_ECU
 SG_ Loc_RadialVelo_10_004 : 248|15@1+ (0.0078125,-128) [-128|127] "m/s"  Central_ECU
 SG_ Loc_RadialVelo_10_003 : 174|15@1+ (0.0078125,-128) [-128|127] "m/s"  Central_ECU
 SG_ Loc_RadialVelo_10_002 : 100|15@1+ (0.0078125,-128) [-128|127] "m/s"  Central_ECU
 SG_ Loc_RadialDist_10_004 : 222|15@1+ (0.0078125,0) [0|250] "m"  Central_ECU
 SG_ Loc_RadialDist_10_003 : 148|15@1+ (0.0078125,0) [0|250] "m"  Central_ECU
 SG_ Loc_RadialDist_10_002 : 74|15@1+ (0.0078125,0) [0|250] "m"  Central_ECU
 SG_ Loc_ElevAngle_10_004 : 275|11@1+ (0.001,-0.785) [-0.785|0.785] "rad"  Central_ECU
 SG_ Loc_ElevAngle_10_003 : 201|11@1+ (0.001,-0.785) [-0.785|0.785] "rad"  Central_ECU
 SG_ Loc_ElevAngle_10_002 : 127|11@1+ (0.001,-0.785) [-0.785|0.785] "rad"  Central_ECU
 SG_ Loc_AziAngle_10_004 : 263|12@1+ (0.001,-1.57) [-1.57|1.57] "rad"  Central_ECU
 SG_ Loc_AziAngle_10_003 : 189|12@1+ (0.001,-1.57) [-1.57|1.57] "rad"  Central_ECU
 SG_ Loc_AziAngle_10_002 : 115|12@1+ (0.001,-1.57) [-1.57|1.57] "rad"  Central_ECU
 SG_ Loc_RCS_10_001 : 64|10@1+ (0.125,-50) [-50|70] "dBm^2"  Central_ECU
 SG_ Loc_ElevAngle_10_001 : 53|11@1+ (0.001,-0.785) [-0.785|0.785] "rad"  Central_ECU
 SG_ Loc_AziAngle_10_001 : 41|12@1+ (0.001,-1.57) [-1.57|1.57] "rad"  Central_ECU
 SG_ Loc_RadialVelo_10_001 : 26|15@1+ (0.0078125,-128) [-128|127] "m/s"  Central_ECU
 SG_ Loc_SNR_10_001 : 15|11@1+ (0.0625,0) [0|40] "dB"  Central_ECU
 SG_ Loc_RadialDist_10_001 : 0|15@1+ (0.0078125,0) [0|250] "m"  Central_ECU

BO_ 529 Location_Data_11: 64 Radar
 SG_ Loc_ElevAngleQly_11_004 : 416|8@1+ (1,0) [0|255] ""  Central_ECU
 SG_ Loc_ElevAngleQly_11_003 : 392|8@1+ (1,0) [0|255] ""  Central_ECU
 SG_ Loc_ElevAngleQly_11_002 : 368|8@1+ (1,0) [0|255] ""  Central_ECU
 SG_ Loc_ElevAngleQly_11_001 : 344|8@1+ (1,0) [0|255] ""  Central_ECU
 SG_ Loc_AziAngleQly_11_004 : 408|8@1+ (1,0) [0|255] ""  Central_ECU
 SG_ Loc_AziAngleQly_11_003 : 384|8@1+ (1,0) [0|255] ""  Central_ECU
 SG_ Loc_AziAngleQly_11_002 : 360|8@1+ (1,0) [0|255] ""  Central_ECU
 SG_ Loc_AziAngleQly_11_001 : 336|8@1+ (1,0) [0|255] ""  Central_ECU
 SG_ Loc_RadialDistVeloQly_11_004 : 400|8@1+ (1,0) [0|255] ""  Central_ECU
 SG_ Loc_RadialDistVeloQly_11_003 : 376|8@1+ (1,0) [0|255] ""  Central_ECU
 SG_ Loc_RadialDistVeloQly_11_002 : 352|8@1+ (1,0) [0|255] ""  Central_ECU
 SG_ Loc_RadialDistVeloQly_11_001 : 328|8@1+ (1,0) [0|255] ""  Central_ECU
 SG_ Loc_Validity_11_004 : 327|1@1+ (1,0) [0|1] ""  Central_ECU
 SG_ Loc_Validity_11_003 : 326|1@1+ (1,0) [0|1] ""  Central_ECU
 SG_ Loc_Validity_11_002 : 325|1@1+ (1,0) [0|1] ""  Central_ECU
 SG_ Loc_Validity_11_001 : 324|1@1+ (1,0) [0|1] ""  Central_ECU
 SG_ Loc_11_Blockcnt : 320|4@1+ (1,0) [0|15] ""  Central_ECU
 SG_ Loc_11_CRC : 296|16@1+ (1,0) [0|65535] ""  Central_ECU
 SG_ Loc_11_AliveCtr : 312|8@1+ (1,0) [0|255] ""  Central_ECU
 SG_ Loc_SNR_11_004 : 237|11@1+ (0.0625,0) [0|40] "dB"  Central_ECU
 SG_ Loc_SNR_11_003 : 163|11@1+ (0.0625,0) [0|40] "dB"  Central_ECU
 SG_ Loc_SNR_11_002 : 89|11@1+ (0.0625,0) [0|40] "dB"  Central_ECU
 SG_ Loc_RCS_11_004 : 286|10@1+ (0.125,-50) [-50|70] "dBm^2"  Central_ECU
 SG_ Loc_RCS_11_003 : 212|10@1+ (0.125,-50) [-50|70] "dBm^2"  Central_ECU
 SG_ Loc_RCS_11_002 : 138|10@1+ (0.125,-50) [-50|70] "dBm^2"  Central_ECU
 SG_ Loc_RadialVelo_11_004 : 248|15@1+ (0.0078125,-128) [-128|127] "m/s"  Central_ECU
 SG_ Loc_RadialVelo_11_003 : 174|15@1+ (0.0078125,-128) [-128|127] "m/s"  Central_ECU
 SG_ Loc_RadialVelo_11_002 : 100|15@1+ (0.0078125,-128) [-128|127] "m/s"  Central_ECU
 SG_ Loc_RadialDist_11_004 : 222|15@1+ (0.0078125,0) [0|250] "m"  Central_ECU
 SG_ Loc_RadialDist_11_003 : 148|15@1+ (0.0078125,0) [0|250] "m"  Central_ECU
 SG_ Loc_RadialDist_11_002 : 74|15@1+ (0.0078125,0) [0|250] "m"  Central_ECU
 SG_ Loc_ElevAngle_11_004 : 275|11@1+ (0.001,-0.785) [-0.785|0.785] "rad"  Central_ECU
 SG_ Loc_ElevAngle_11_003 : 201|11@1+ (0.001,-0.785) [-0.785|0.785] "rad"  Central_ECU
 SG_ Loc_ElevAngle_11_002 : 127|11@1+ (0.001,-0.785) [-0.785|0.785] "rad"  Central_ECU
 SG_ Loc_AziAngle_11_004 : 263|12@1+ (0.001,-1.57) [-1.57|1.57] "rad"  Central_ECU
 SG_ Loc_AziAngle_11_003 : 189|12@1+ (0.001,-1.57) [-1.57|1.57] "rad"  Central_ECU
 SG_ Loc_AziAngle_11_002 : 115|12@1+ (0.001,-1.57) [-1.57|1.57] "rad"  Central_ECU
 SG_ Loc_RCS_11_001 : 64|10@1+ (0.125,-50) [-50|70] "dBm^2"  Central_ECU
 SG_ Loc_ElevAngle_11_001 : 53|11@1+ (0.001,-0.785) [-0.785|0.785] "rad"  Central_ECU
 SG_ Loc_AziAngle_11_001 : 41|12@1+ (0.001,-1.57) [-1.57|1.57] "rad"  Central_ECU
 SG_ Loc_RadialVelo_11_001 : 26|15@1+ (0.0078125,-128) [-128|127] "m/s"  Central_ECU
 SG_ Loc_SNR_11_001 : 15|11@1+ (0.0625,0) [0|40] "dB"  Central_ECU
 SG_ Loc_RadialDist_11_001 : 0|15@1+ (0.0078125,0) [0|250] "m"  Central_ECU

BO_ 530 Location_Data_12: 64 Radar
 SG_ Loc_ElevAngleQly_12_004 : 416|8@1+ (1,0) [0|255] ""  Central_ECU
 SG_ Loc_ElevAngleQly_12_003 : 392|8@1+ (1,0) [0|255] ""  Central_ECU
 SG_ Loc_ElevAngleQly_12_002 : 368|8@1+ (1,0) [0|255] ""  Central_ECU
 SG_ Loc_ElevAngleQly_12_001 : 344|8@1+ (1,0) [0|255] ""  Central_ECU
 SG_ Loc_AziAngleQly_12_004 : 408|8@1+ (1,0) [0|255] ""  Central_ECU
 SG_ Loc_AziAngleQly_12_003 : 384|8@1+ (1,0) [0|255] ""  Central_ECU
 SG_ Loc_AziAngleQly_12_002 : 360|8@1+ (1,0) [0|255] ""  Central_ECU
 SG_ Loc_AziAngleQly_12_001 : 336|8@1+ (1,0) [0|255] ""  Central_ECU
 SG_ Loc_RadialDistVeloQly_12_004 : 400|8@1+ (1,0) [0|255] ""  Central_ECU
 SG_ Loc_RadialDistVeloQly_12_003 : 376|8@1+ (1,0) [0|255] ""  Central_ECU
 SG_ Loc_RadialDistVeloQly_12_002 : 352|8@1+ (1,0) [0|255] ""  Central_ECU
 SG_ Loc_RadialDistVeloQly_12_001 : 328|8@1+ (1,0) [0|255] ""  Central_ECU
 SG_ Loc_Validity_12_004 : 327|1@1+ (1,0) [0|1] ""  Central_ECU
 SG_ Loc_Validity_12_003 : 326|1@1+ (1,0) [0|1] ""  Central_ECU
 SG_ Loc_Validity_12_002 : 325|1@1+ (1,0) [0|1] ""  Central_ECU
 SG_ Loc_Validity_12_001 : 324|1@1+ (1,0) [0|1] ""  Central_ECU
 SG_ Loc_12_Blockcnt : 320|4@1+ (1,0) [0|15] ""  Central_ECU
 SG_ Loc_12_CRC : 296|16@1+ (1,0) [0|65535] ""  Central_ECU
 SG_ Loc_12_AliveCtr : 312|8@1+ (1,0) [0|255] ""  Central_ECU
 SG_ Loc_SNR_12_004 : 237|11@1+ (0.0625,0) [0|40] "dB"  Central_ECU
 SG_ Loc_SNR_12_003 : 163|11@1+ (0.0625,0) [0|40] "dB"  Central_ECU
 SG_ Loc_SNR_12_002 : 89|11@1+ (0.0625,0) [0|40] "dB"  Central_ECU
 SG_ Loc_RCS_12_004 : 286|10@1+ (0.125,-50) [-50|70] "dBm^2"  Central_ECU
 SG_ Loc_RCS_12_003 : 212|10@1+ (0.125,-50) [-50|70] "dBm^2"  Central_ECU
 SG_ Loc_RCS_12_002 : 138|10@1+ (0.125,-50) [-50|70] "dBm^2"  Central_ECU
 SG_ Loc_RadialVelo_12_004 : 248|15@1+ (0.0078125,-128) [-128|127] "m/s"  Central_ECU
 SG_ Loc_RadialVelo_12_003 : 174|15@1+ (0.0078125,-128) [-128|127] "m/s"  Central_ECU
 SG_ Loc_RadialVelo_12_002 : 100|15@1+ (0.0078125,-128) [-128|127] "m/s"  Central_ECU
 SG_ Loc_RadialDist_12_004 : 222|15@1+ (0.0078125,0) [0|250] "m"  Central_ECU
 SG_ Loc_RadialDist_12_003 : 148|15@1+ (0.0078125,0) [0|250] "m"  Central_ECU
 SG_ Loc_RadialDist_12_002 : 74|15@1+ (0.0078125,0) [0|250] "m"  Central_ECU
 SG_ Loc_ElevAngle_12_004 : 275|11@1+ (0.001,-0.785) [-0.785|0.785] "rad"  Central_ECU
 SG_ Loc_ElevAngle_12_003 : 201|11@1+ (0.001,-0.785) [-0.785|0.785] "rad"  Central_ECU
 SG_ Loc_ElevAngle_12_002 : 127|11@1+ (0.001,-0.785) [-0.785|0.785] "rad"  Central_ECU
 SG_ Loc_AziAngle_12_004 : 263|12@1+ (0.001,-1.57) [-1.57|1.57] "rad"  Central_ECU
 SG_ Loc_AziAngle_12_003 : 189|12@1+ (0.001,-1.57) [-1.57|1.57] "rad"  Central_ECU
 SG_ Loc_AziAngle_12_002 : 115|12@1+ (0.001,-1.57) [-1.57|1.57] "rad"  Central_ECU
 SG_ Loc_RCS_12_001 : 64|10@1+ (0.125,-50) [-50|70] "dBm^2"  Central_ECU
 SG_ Loc_ElevAngle_12_001 : 53|11@1+ (0.001,-0.785) [-0.785|0.785] "rad"  Central_ECU
 SG_ Loc_AziAngle_12_001 : 41|12@1+ (0.001,-1.57) [-1.57|1.57] "rad"  Central_ECU
 SG_ Loc_RadialVelo_12_001 : 26|15@1+ (0.0078125,-128) [-128|127] "m/s"  Central_ECU
 SG_ Loc_SNR_12_001 : 15|11@1+ (0.0625,0) [0|40] "dB"  Central_ECU
 SG_ Loc_RadialDist_12_001 : 0|15@1+ (0.0078125,0) [0|250] "m"  Central_ECU

BO_ 531 Location_Data_13: 64 Radar
 SG_ Loc_ElevAngleQly_13_004 : 416|8@1+ (1,0) [0|255] ""  Central_ECU
 SG_ Loc_ElevAngleQly_13_003 : 392|8@1+ (1,0) [0|255] ""  Central_ECU
 SG_ Loc_ElevAngleQly_13_002 : 368|8@1+ (1,0) [0|255] ""  Central_ECU
 SG_ Loc_ElevAngleQly_13_001 : 344|8@1+ (1,0) [0|255] ""  Central_ECU
 SG_ Loc_AziAngleQly_13_004 : 408|8@1+ (1,0) [0|255] ""  Central_ECU
 SG_ Loc_AziAngleQly_13_003 : 384|8@1+ (1,0) [0|255] ""  Central_ECU
 SG_ Loc_AziAngleQly_13_002 : 360|8@1+ (1,0) [0|255] ""  Central_ECU
 SG_ Loc_AziAngleQly_13_001 : 336|8@1+ (1,0) [0|255] ""  Central_ECU
 SG_ Loc_RadialDistVeloQly_13_004 : 400|8@1+ (1,0) [0|255] ""  Central_ECU
 SG_ Loc_RadialDistVeloQly_13_003 : 376|8@1+ (1,0) [0|255] ""  Central_ECU
 SG_ Loc_RadialDistVeloQly_13_002 : 352|8@1+ (1,0) [0|255] ""  Central_ECU
 SG_ Loc_RadialDistVeloQly_13_001 : 328|8@1+ (1,0) [0|255] ""  Central_ECU
 SG_ Loc_Validity_13_004 : 327|1@1+ (1,0) [0|1] ""  Central_ECU
 SG_ Loc_Validity_13_003 : 326|1@1+ (1,0) [0|1] ""  Central_ECU
 SG_ Loc_Validity_13_002 : 325|1@1+ (1,0) [0|1] ""  Central_ECU
 SG_ Loc_Validity_13_001 : 324|1@1+ (1,0) [0|1] ""  Central_ECU
 SG_ Loc_13_Blockcnt : 320|4@1+ (1,0) [0|15] ""  Central_ECU
 SG_ Loc_13_CRC : 296|16@1+ (1,0) [0|65535] ""  Central_ECU
 SG_ Loc_13_AliveCtr : 312|8@1+ (1,0) [0|255] ""  Central_ECU
 SG_ Loc_SNR_13_004 : 237|11@1+ (0.0625,0) [0|40] "dB"  Central_ECU
 SG_ Loc_SNR_13_003 : 163|11@1+ (0.0625,0) [0|40] "dB"  Central_ECU
 SG_ Loc_SNR_13_002 : 89|11@1+ (0.0625,0) [0|40] "dB"  Central_ECU
 SG_ Loc_RCS_13_004 : 286|10@1+ (0.125,-50) [-50|70] "dBm^2"  Central_ECU
 SG_ Loc_RCS_13_003 : 212|10@1+ (0.125,-50) [-50|70] "dBm^2"  Central_ECU
 SG_ Loc_RCS_13_002 : 138|10@1+ (0.125,-50) [-50|70] "dBm^2"  Central_ECU
 SG_ Loc_RadialVelo_13_004 : 248|15@1+ (0.0078125,-128) [-128|127] "m/s"  Central_ECU
 SG_ Loc_RadialVelo_13_003 : 174|15@1+ (0.0078125,-128) [-128|127] "m/s"  Central_ECU
 SG_ Loc_RadialVelo_13_002 : 100|15@1+ (0.0078125,-128) [-128|127] "m/s"  Central_ECU
 SG_ Loc_RadialDist_13_004 : 222|15@1+ (0.0078125,0) [0|250] "m"  Central_ECU
 SG_ Loc_RadialDist_13_003 : 148|15@1+ (0.0078125,0) [0|250] "m"  Central_ECU
 SG_ Loc_RadialDist_13_002 : 74|15@1+ (0.0078125,0) [0|250] "m"  Central_ECU
 SG_ Loc_ElevAngle_13_004 : 275|11@1+ (0.001,-0.785) [-0.785|0.785] "rad"  Central_ECU
 SG_ Loc_ElevAngle_13_003 : 201|11@1+ (0.001,-0.785) [-0.785|0.785] "rad"  Central_ECU
 SG_ Loc_ElevAngle_13_002 : 127|11@1+ (0.001,-0.785) [-0.785|0.785] "rad"  Central_ECU
 SG_ Loc_AziAngle_13_004 : 263|12@1+ (0.001,-1.57) [-1.57|1.57] "rad"  Central_ECU
 SG_ Loc_AziAngle_13_003 : 189|12@1+ (0.001,-1.57) [-1.57|1.57] "rad"  Central_ECU
 SG_ Loc_AziAngle_13_002 : 115|12@1+ (0.001,-1.57) [-1.57|1.57] "rad"  Central_ECU
 SG_ Loc_RCS_13_001 : 64|10@1+ (0.125,-50) [-50|70] "dBm^2"  Central_ECU
 SG_ Loc_ElevAngle_13_001 : 53|11@1+ (0.001,-0.785) [-0.785|0.785] "rad"  Central_ECU
 SG_ Loc_AziAngle_13_001 : 41|12@1+ (0.001,-1.57) [-1.57|1.57] "rad"  Central_ECU
 SG_ Loc_RadialVelo_13_001 : 26|15@1+ (0.0078125,-128) [-128|127] "m/s"  Central_ECU
 SG_ Loc_SNR_13_001 : 15|11@1+ (0.0625,0) [0|40] "dB"  Central_ECU
 SG_ Loc_RadialDist_13_001 : 0|15@1+ (0.0078125,0) [0|250] "m"  Central_ECU

BO_ 532 Location_Data_14: 64 Radar
 SG_ Loc_ElevAngleQly_14_004 : 416|8@1+ (1,0) [0|255] ""  Central_ECU
 SG_ Loc_ElevAngleQly_14_003 : 392|8@1+ (1,0) [0|255] ""  Central_ECU
 SG_ Loc_ElevAngleQly_14_002 : 368|8@1+ (1,0) [0|255] ""  Central_ECU
 SG_ Loc_ElevAngleQly_14_001 : 344|8@1+ (1,0) [0|255] ""  Central_ECU
 SG_ Loc_AziAngleQly_14_004 : 408|8@1+ (1,0) [0|255] ""  Central_ECU
 SG_ Loc_AziAngleQly_14_003 : 384|8@1+ (1,0) [0|255] ""  Central_ECU
 SG_ Loc_AziAngleQly_14_002 : 360|8@1+ (1,0) [0|255] ""  Central_ECU
 SG_ Loc_AziAngleQly_14_001 : 336|8@1+ (1,0) [0|255] ""  Central_ECU
 SG_ Loc_RadialDistVeloQly_14_004 : 400|8@1+ (1,0) [0|255] ""  Central_ECU
 SG_ Loc_RadialDistVeloQly_14_003 : 376|8@1+ (1,0) [0|255] ""  Central_ECU
 SG_ Loc_RadialDistVeloQly_14_002 : 352|8@1+ (1,0) [0|255] ""  Central_ECU
 SG_ Loc_RadialDistVeloQly_14_001 : 328|8@1+ (1,0) [0|255] ""  Central_ECU
 SG_ Loc_Validity_14_004 : 327|1@1+ (1,0) [0|1] ""  Central_ECU
 SG_ Loc_Validity_14_003 : 326|1@1+ (1,0) [0|1] ""  Central_ECU
 SG_ Loc_Validity_14_002 : 325|1@1+ (1,0) [0|1] ""  Central_ECU
 SG_ Loc_Validity_14_001 : 324|1@1+ (1,0) [0|1] ""  Central_ECU
 SG_ Loc_14_Blockcnt : 320|4@1+ (1,0) [0|15] ""  Central_ECU
 SG_ Loc_14_CRC : 296|16@1+ (1,0) [0|65535] ""  Central_ECU
 SG_ Loc_14_AliveCtr : 312|8@1+ (1,0) [0|255] ""  Central_ECU
 SG_ Loc_SNR_14_004 : 237|11@1+ (0.0625,0) [0|40] "dB"  Central_ECU
 SG_ Loc_SNR_14_003 : 163|11@1+ (0.0625,0) [0|40] "dB"  Central_ECU
 SG_ Loc_SNR_14_002 : 89|11@1+ (0.0625,0) [0|40] "dB"  Central_ECU
 SG_ Loc_RCS_14_004 : 286|10@1+ (0.125,-50) [-50|70] "dBm^2"  Central_ECU
 SG_ Loc_RCS_14_003 : 212|10@1+ (0.125,-50) [-50|70] "dBm^2"  Central_ECU
 SG_ Loc_RCS_14_002 : 138|10@1+ (0.125,-50) [-50|70] "dBm^2"  Central_ECU
 SG_ Loc_RadialVelo_14_004 : 248|15@1+ (0.0078125,-128) [-128|127] "m/s"  Central_ECU
 SG_ Loc_RadialVelo_14_003 : 174|15@1+ (0.0078125,-128) [-128|127] "m/s"  Central_ECU
 SG_ Loc_RadialVelo_14_002 : 100|15@1+ (0.0078125,-128) [-128|127] "m/s"  Central_ECU
 SG_ Loc_RadialDist_14_004 : 222|15@1+ (0.0078125,0) [0|250] "m"  Central_ECU
 SG_ Loc_RadialDist_14_003 : 148|15@1+ (0.0078125,0) [0|250] "m"  Central_ECU
 SG_ Loc_RadialDist_14_002 : 74|15@1+ (0.0078125,0) [0|250] "m"  Central_ECU
 SG_ Loc_ElevAngle_14_004 : 275|11@1+ (0.001,-0.785) [-0.785|0.785] "rad"  Central_ECU
 SG_ Loc_ElevAngle_14_003 : 201|11@1+ (0.001,-0.785) [-0.785|0.785] "rad"  Central_ECU
 SG_ Loc_ElevAngle_14_002 : 127|11@1+ (0.001,-0.785) [-0.785|0.785] "rad"  Central_ECU
 SG_ Loc_AziAngle_14_004 : 263|12@1+ (0.001,-1.57) [-1.57|1.57] "rad"  Central_ECU
 SG_ Loc_AziAngle_14_003 : 189|12@1+ (0.001,-1.57) [-1.57|1.57] "rad"  Central_ECU
 SG_ Loc_AziAngle_14_002 : 115|12@1+ (0.001,-1.57) [-1.57|1.57] "rad"  Central_ECU
 SG_ Loc_RCS_14_001 : 64|10@1+ (0.125,-50) [-50|70] "dBm^2"  Central_ECU
 SG_ Loc_ElevAngle_14_001 : 53|11@1+ (0.001,-0.785) [-0.785|0.785] "rad"  Central_ECU
 SG_ Loc_AziAngle_14_001 : 41|12@1+ (0.001,-1.57) [-1.57|1.57] "rad"  Central_ECU
 SG_ Loc_RadialVelo_14_001 : 26|15@1+ (0.0078125,-128) [-128|127] "m/s"  Central_ECU
 SG_ Loc_SNR_14_001 : 15|11@1+ (0.0625,0) [0|40] "dB"  Central_ECU
 SG_ Loc_RadialDist_14_001 : 0|15@1+ (0.0078125,0) [0|250] "m"  Central_ECU

BO_ 533 Location_Data_15: 64 Radar
 SG_ Loc_ElevAngleQly_15_004 : 416|8@1+ (1,0) [0|255] ""  Central_ECU
 SG_ Loc_ElevAngleQly_15_003 : 392|8@1+ (1,0) [0|255] ""  Central_ECU
 SG_ Loc_ElevAngleQly_15_002 : 368|8@1+ (1,0) [0|255] ""  Central_ECU
 SG_ Loc_ElevAngleQly_15_001 : 344|8@1+ (1,0) [0|255] ""  Central_ECU
 SG_ Loc_AziAngleQly_15_004 : 408|8@1+ (1,0) [0|255] ""  Central_ECU
 SG_ Loc_AziAngleQly_15_003 : 384|8@1+ (1,0) [0|255] ""  Central_ECU
 SG_ Loc_AziAngleQly_15_002 : 360|8@1+ (1,0) [0|255] ""  Central_ECU
 SG_ Loc_AziAngleQly_15_001 : 336|8@1+ (1,0) [0|255] ""  Central_ECU
 SG_ Loc_RadialDistVeloQly_15_004 : 400|8@1+ (1,0) [0|255] ""  Central_ECU
 SG_ Loc_RadialDistVeloQly_15_003 : 376|8@1+ (1,0) [0|255] ""  Central_ECU
 SG_ Loc_RadialDistVeloQly_15_002 : 352|8@1+ (1,0) [0|255] ""  Central_ECU
 SG_ Loc_RadialDistVeloQly_15_001 : 328|8@1+ (1,0) [0|255] ""  Central_ECU
 SG_ Loc_Validity_15_004 : 327|1@1+ (1,0) [0|1] ""  Central_ECU
 SG_ Loc_Validity_15_003 : 326|1@1+ (1,0) [0|1] ""  Central_ECU
 SG_ Loc_Validity_15_002 : 325|1@1+ (1,0) [0|1] ""  Central_ECU
 SG_ Loc_Validity_15_001 : 324|1@1+ (1,0) [0|1] ""  Central_ECU
 SG_ Loc_15_Blockcnt : 320|4@1+ (1,0) [0|15] ""  Central_ECU
 SG_ Loc_15_CRC : 296|16@1+ (1,0) [0|65535] ""  Central_ECU
 SG_ Loc_15_AliveCtr : 312|8@1+ (1,0) [0|255] ""  Central_ECU
 SG_ Loc_SNR_15_004 : 237|11@1+ (0.0625,0) [0|40] "dB"  Central_ECU
 SG_ Loc_SNR_15_003 : 163|11@1+ (0.0625,0) [0|40] "dB"  Central_ECU
 SG_ Loc_SNR_15_002 : 89|11@1+ (0.0625,0) [0|40] "dB"  Central_ECU
 SG_ Loc_RCS_15_004 : 286|10@1+ (0.125,-50) [-50|70] "dBm^2"  Central_ECU
 SG_ Loc_RCS_15_003 : 212|10@1+ (0.125,-50) [-50|70] "dBm^2"  Central_ECU
 SG_ Loc_RCS_15_002 : 138|10@1+ (0.125,-50) [-50|70] "dBm^2"  Central_ECU
 SG_ Loc_RadialVelo_15_004 : 248|15@1+ (0.0078125,-128) [-128|127] "m/s"  Central_ECU
 SG_ Loc_RadialVelo_15_003 : 174|15@1+ (0.0078125,-128) [-128|127] "m/s"  Central_ECU
 SG_ Loc_RadialVelo_15_002 : 100|15@1+ (0.0078125,-128) [-128|127] "m/s"  Central_ECU
 SG_ Loc_RadialDist_15_004 : 222|15@1+ (0.0078125,0) [0|250] "m"  Central_ECU
 SG_ Loc_RadialDist_15_003 : 148|15@1+ (0.0078125,0) [0|250] "m"  Central_ECU
 SG_ Loc_RadialDist_15_002 : 74|15@1+ (0.0078125,0) [0|250] "m"  Central_ECU
 SG_ Loc_ElevAngle_15_004 : 275|11@1+ (0.001,-0.785) [-0.785|0.785] "rad"  Central_ECU
 SG_ Loc_ElevAngle_15_003 : 201|11@1+ (0.001,-0.785) [-0.785|0.785] "rad"  Central_ECU
 SG_ Loc_ElevAngle_15_002 : 127|11@1+ (0.001,-0.785) [-0.785|0.785] "rad"  Central_ECU
 SG_ Loc_AziAngle_15_004 : 263|12@1+ (0.001,-1.57) [-1.57|1.57] "rad"  Central_ECU
 SG_ Loc_AziAngle_15_003 : 189|12@1+ (0.001,-1.57) [-1.57|1.57] "rad"  Central_ECU
 SG_ Loc_AziAngle_15_002 : 115|12@1+ (0.001,-1.57) [-1.57|1.57] "rad"  Central_ECU
 SG_ Loc_RCS_15_001 : 64|10@1+ (0.125,-50) [-50|70] "dBm^2"  Central_ECU
 SG_ Loc_ElevAngle_15_001 : 53|11@1+ (0.001,-0.785) [-0.785|0.785] "rad"  Central_ECU
 SG_ Loc_AziAngle_15_001 : 41|12@1+ (0.001,-1.57) [-1.57|1.57] "rad"  Central_ECU
 SG_ Loc_RadialVelo_15_001 : 26|15@1+ (0.0078125,-128) [-128|127] "m/s"  Central_ECU
 SG_ Loc_SNR_15_001 : 15|11@1+ (0.0625,0) [0|40] "dB"  Central_ECU
 SG_ Loc_RadialDist_15_001 : 0|15@1+ (0.0078125,0) [0|250] "m"  Central_ECU

BO_ 534 Location_Data_16: 64 Radar
 SG_ Loc_ElevAngleQly_16_004 : 416|8@1+ (1,0) [0|255] ""  Central_ECU
 SG_ Loc_ElevAngleQly_16_003 : 392|8@1+ (1,0) [0|255] ""  Central_ECU
 SG_ Loc_ElevAngleQly_16_002 : 368|8@1+ (1,0) [0|255] ""  Central_ECU
 SG_ Loc_ElevAngleQly_16_001 : 344|8@1+ (1,0) [0|255] ""  Central_ECU
 SG_ Loc_AziAngleQly_16_004 : 408|8@1+ (1,0) [0|255] ""  Central_ECU
 SG_ Loc_AziAngleQly_16_003 : 384|8@1+ (1,0) [0|255] ""  Central_ECU
 SG_ Loc_AziAngleQly_16_002 : 360|8@1+ (1,0) [0|255] ""  Central_ECU
 SG_ Loc_AziAngleQly_16_001 : 336|8@1+ (1,0) [0|255] ""  Central_ECU
 SG_ Loc_RadialDistVeloQly_16_004 : 400|8@1+ (1,0) [0|255] ""  Central_ECU
 SG_ Loc_RadialDistVeloQly_16_003 : 376|8@1+ (1,0) [0|255] ""  Central_ECU
 SG_ Loc_RadialDistVeloQly_16_002 : 352|8@1+ (1,0) [0|255] ""  Central_ECU
 SG_ Loc_RadialDistVeloQly_16_001 : 328|8@1+ (1,0) [0|255] ""  Central_ECU
 SG_ Loc_Validity_16_004 : 327|1@1+ (1,0) [0|1] ""  Central_ECU
 SG_ Loc_Validity_16_003 : 326|1@1+ (1,0) [0|1] ""  Central_ECU
 SG_ Loc_Validity_16_002 : 325|1@1+ (1,0) [0|1] ""  Central_ECU
 SG_ Loc_Validity_16_001 : 324|1@1+ (1,0) [0|1] ""  Central_ECU
 SG_ Loc_16_Blockcnt : 320|4@1+ (1,0) [0|15] ""  Central_ECU
 SG_ Loc_16_CRC : 296|16@1+ (1,0) [0|65535] ""  Central_ECU
 SG_ Loc_16_AliveCtr : 312|8@1+ (1,0) [0|255] ""  Central_ECU
 SG_ Loc_SNR_16_004 : 237|11@1+ (0.0625,0) [0|40] "dB"  Central_ECU
 SG_ Loc_SNR_16_003 : 163|11@1+ (0.0625,0) [0|40] "dB"  Central_ECU
 SG_ Loc_SNR_16_002 : 89|11@1+ (0.0625,0) [0|40] "dB"  Central_ECU
 SG_ Loc_RCS_16_004 : 286|10@1+ (0.125,-50) [-50|70] "dBm^2"  Central_ECU
 SG_ Loc_RCS_16_003 : 212|10@1+ (0.125,-50) [-50|70] "dBm^2"  Central_ECU
 SG_ Loc_RCS_16_002 : 138|10@1+ (0.125,-50) [-50|70] "dBm^2"  Central_ECU
 SG_ Loc_RadialVelo_16_004 : 248|15@1+ (0.0078125,-128) [-128|127] "m/s"  Central_ECU
 SG_ Loc_RadialVelo_16_003 : 174|15@1+ (0.0078125,-128) [-128|127] "m/s"  Central_ECU
 SG_ Loc_RadialVelo_16_002 : 100|15@1+ (0.0078125,-128) [-128|127] "m/s"  Central_ECU
 SG_ Loc_RadialDist_16_004 : 222|15@1+ (0.0078125,0) [0|250] "m"  Central_ECU
 SG_ Loc_RadialDist_16_003 : 148|15@1+ (0.0078125,0) [0|250] "m"  Central_ECU
 SG_ Loc_RadialDist_16_002 : 74|15@1+ (0.0078125,0) [0|250] "m"  Central_ECU
 SG_ Loc_ElevAngle_16_004 : 275|11@1+ (0.001,-0.785) [-0.785|0.785] "rad"  Central_ECU
 SG_ Loc_ElevAngle_16_003 : 201|11@1+ (0.001,-0.785) [-0.785|0.785] "rad"  Central_ECU
 SG_ Loc_ElevAngle_16_002 : 127|11@1+ (0.001,-0.785) [-0.785|0.785] "rad"  Central_ECU
 SG_ Loc_AziAngle_16_004 : 263|12@1+ (0.001,-1.57) [-1.57|1.57] "rad"  Central_ECU
 SG_ Loc_AziAngle_16_003 : 189|12@1+ (0.001,-1.57) [-1.57|1.57] "rad"  Central_ECU
 SG_ Loc_AziAngle_16_002 : 115|12@1+ (0.001,-1.57) [-1.57|1.57] "rad"  Central_ECU
 SG_ Loc_RCS_16_001 : 64|10@1+ (0.125,-50) [-50|70] "dBm^2"  Central_ECU
 SG_ Loc_ElevAngle_16_001 : 53|11@1+ (0.001,-0.785) [-0.785|0.785] "rad"  Central_ECU
 SG_ Loc_AziAngle_16_001 : 41|12@1+ (0.001,-1.57) [-1.57|1.57] "rad"  Central_ECU
 SG_ Loc_RadialVelo_16_001 : 26|15@1+ (0.0078125,-128) [-128|127] "m/s"  Central_ECU
 SG_ Loc_SNR_16_001 : 15|11@1+ (0.0625,0) [0|40] "dB"  Central_ECU
 SG_ Loc_RadialDist_16_001 : 0|15@1+ (0.0078125,0) [0|250] "m"  Central_ECU

CM_ SG_ 513 Loc_ElevAngleQly_01_004 "0x00    Lowest Quality
0xFF    Highest Quality";
CM_ SG_ 513 Loc_ElevAngleQly_01_003 "0x00    Lowest Quality
0xFF    Highest Quality";
CM_ SG_ 513 Loc_ElevAngleQly_01_002 "0x00    Lowest Quality
0xFF    Highest Quality";
CM_ SG_ 513 Loc_ElevAngleQly_01_001 "0x00    Lowest Quality
0xFF    Highest Quality";
CM_ SG_ 513 Loc_AziAngleQly_01_004 "0x00    Lowest Quality
0xFF    Highest Quality";
CM_ SG_ 513 Loc_AziAngleQly_01_003 "0x00    Lowest Quality
0xFF    Highest Quality";
CM_ SG_ 513 Loc_AziAngleQly_01_002 "0x00    Lowest Quality
0xFF    Highest Quality";
CM_ SG_ 513 Loc_AziAngleQly_01_001 "0x00    Lowest Quality
0xFF    Highest Quality";
CM_ SG_ 513 Loc_RadialDistVeloQly_01_004 "0x00    Lowest Quality
0xFF    Highest Quality";
CM_ SG_ 513 Loc_RadialDistVeloQly_01_003 "0x00    Lowest Quality
0xFF    Highest Quality";
CM_ SG_ 513 Loc_RadialDistVeloQly_01_002 "0x00    Lowest Quality
0xFF    Highest Quality";
CM_ SG_ 513 Loc_RadialDistVeloQly_01_001 "0x00    Lowest Quality
0xFF    Highest Quality";
BA_DEF_ BO_  "CANFD_BRS" ENUM  "0","1";
BA_DEF_ BO_  "GenMsgCycleTime" INT 0 50000;
BA_DEF_ BO_  "GenMsgSendType" ENUM  "cyclic","spontaneous","cyclicIfActive","spontaneousWithDelay","cyclicAndSpontaneous","cyclicAndSpontaneousWithDelay","spontaneousWithRepetition","cyclicIfActiveAndSpontaneousWD";
BA_DEF_ BO_  "VFrameFormat" ENUM  "StandardCAN","ExtendedCAN","reserved","reserved","reserved","reserved","reserved","reserved","reserved","reserved","reserved","reserved","reserved","reserved","StandardCAN_FD","ExtendedCAN_FD";
BA_DEF_DEF_  "CANFD_BRS" "1";
BA_DEF_DEF_  "GenMsgCycleTime" 100;
BA_DEF_DEF_  "GenMsgSendType" "cyclic";
BA_DEF_DEF_  "VFrameFormat" "StandardCAN";
BA_ "GenMsgCycleTime" BO_ 562 65;
BA_ "GenMsgSendType" BO_ 562 1;
BA_ "VFrameFormat" BO_ 562 14;
BA_ "GenMsgCycleTime" BO_ 561 65;
BA_ "GenMsgSendType" BO_ 561 1;
BA_ "VFrameFormat" BO_ 561 14;
BA_ "GenMsgCycleTime" BO_ 560 65;
BA_ "GenMsgSendType" BO_ 560 1;
BA_ "VFrameFormat" BO_ 560 14;
BA_ "GenMsgCycleTime" BO_ 553 65;
BA_ "GenMsgSendType" BO_ 553 1;
BA_ "VFrameFormat" BO_ 553 14;
BA_ "GenMsgCycleTime" BO_ 552 65;
BA_ "GenMsgSendType" BO_ 552 1;
BA_ "VFrameFormat" BO_ 552 14;
BA_ "GenMsgCycleTime" BO_ 551 65;
BA_ "GenMsgSendType" BO_ 551 1;
BA_ "VFrameFormat" BO_ 551 14;
BA_ "GenMsgCycleTime" BO_ 550 65;
BA_ "GenMsgSendType" BO_ 550 1;
BA_ "VFrameFormat" BO_ 550 14;
BA_ "GenMsgCycleTime" BO_ 549 65;
BA_ "GenMsgSendType" BO_ 549 1;
BA_ "VFrameFormat" BO_ 549 14;
BA_ "GenMsgCycleTime" BO_ 548 65;
BA_ "GenMsgSendType" BO_ 548 1;
BA_ "VFrameFormat" BO_ 548 14;
BA_ "GenMsgCycleTime" BO_ 547 65;
BA_ "GenMsgSendType" BO_ 547 1;
BA_ "VFrameFormat" BO_ 547 14;
BA_ "GenMsgCycleTime" BO_ 546 65;
BA_ "GenMsgSendType" BO_ 546 1;
BA_ "VFrameFormat" BO_ 546 14;
BA_ "GenMsgCycleTime" BO_ 545 65;
BA_ "GenMsgSendType" BO_ 545 1;
BA_ "VFrameFormat" BO_ 545 14;
BA_ "GenMsgCycleTime" BO_ 544 65;
BA_ "GenMsgSendType" BO_ 544 1;
BA_ "VFrameFormat" BO_ 544 14;
BA_ "GenMsgCycleTime" BO_ 537 65;
BA_ "GenMsgSendType" BO_ 537 1;
BA_ "VFrameFormat" BO_ 537 14;
BA_ "GenMsgCycleTime" BO_ 536 65;
BA_ "GenMsgSendType" BO_ 536 1;
BA_ "VFrameFormat" BO_ 536 14;
BA_ "GenMsgCycleTime" BO_ 535 65;
BA_ "GenMsgSendType" BO_ 535 1;
BA_ "VFrameFormat" BO_ 535 14;
BA_ "GenMsgCycleTime" BO_ 513 65;
BA_ "GenMsgSendType" BO_ 513 1;
BA_ "VFrameFormat" BO_ 513 14;
BA_ "GenMsgCycleTime" BO_ 514 65;
BA_ "GenMsgSendType" BO_ 514 1;
BA_ "VFrameFormat" BO_ 514 14;
BA_ "GenMsgCycleTime" BO_ 515 65;
BA_ "GenMsgSendType" BO_ 515 1;
BA_ "VFrameFormat" BO_ 515 14;
BA_ "GenMsgCycleTime" BO_ 516 65;
BA_ "GenMsgSendType" BO_ 516 1;
BA_ "VFrameFormat" BO_ 516 14;
BA_ "GenMsgCycleTime" BO_ 517 65;
BA_ "GenMsgSendType" BO_ 517 1;
BA_ "VFrameFormat" BO_ 517 14;
BA_ "GenMsgCycleTime" BO_ 518 65;
BA_ "GenMsgSendType" BO_ 518 1;
BA_ "VFrameFormat" BO_ 518 14;
BA_ "GenMsgCycleTime" BO_ 519 65;
BA_ "GenMsgSendType" BO_ 519 1;
BA_ "VFrameFormat" BO_ 519 14;
BA_ "GenMsgCycleTime" BO_ 520 65;
BA_ "GenMsgSendType" BO_ 520 1;
BA_ "VFrameFormat" BO_ 520 14;
BA_ "GenMsgCycleTime" BO_ 521 65;
BA_ "GenMsgSendType" BO_ 521 1;
BA_ "VFrameFormat" BO_ 521 14;
BA_ "GenMsgCycleTime" BO_ 528 65;
BA_ "GenMsgSendType" BO_ 528 1;
BA_ "VFrameFormat" BO_ 528 14;
BA_ "GenMsgCycleTime" BO_ 529 65;
BA_ "GenMsgSendType" BO_ 529 1;
BA_ "VFrameFormat" BO_ 529 14;
BA_ "GenMsgCycleTime" BO_ 530 65;
BA_ "GenMsgSendType" BO_ 530 1;
BA_ "VFrameFormat" BO_ 530 14;
BA_ "GenMsgCycleTime" BO_ 531 65;
BA_ "GenMsgSendType" BO_ 531 1;
BA_ "VFrameFormat" BO_ 531 14;
BA_ "GenMsgCycleTime" BO_ 532 65;
BA_ "GenMsgSendType" BO_ 532 1;
BA_ "VFrameFormat" BO_ 532 14;
BA_ "GenMsgCycleTime" BO_ 533 65;
BA_ "GenMsgSendType" BO_ 533 1;
BA_ "VFrameFormat" BO_ 533 14;
BA_ "GenMsgCycleTime" BO_ 534 65;
BA_ "GenMsgSendType" BO_ 534 1;
BA_ "VFrameFormat" BO_ 534 14;
VAL_ 562 Loc_Validity_32_004 1 "Valid" 0 "Invalid" ;
VAL_ 562 Loc_Validity_32_003 1 "Valid" 0 "Invalid" ;
VAL_ 562 Loc_Validity_32_002 1 "Valid" 0 "Invalid" ;
VAL_ 562 Loc_Validity_32_001 1 "Valid" 0 "Invalid" ;
VAL_ 561 Loc_Validity_31_004 1 "Valid" 0 "Invalid" ;
VAL_ 561 Loc_Validity_31_003 1 "Valid" 0 "Invalid" ;
VAL_ 561 Loc_Validity_31_002 1 "Valid" 0 "Invalid" ;
VAL_ 561 Loc_Validity_31_001 1 "Valid" 0 "Invalid" ;
VAL_ 560 Loc_Validity_30_004 1 "Valid" 0 "Invalid" ;
VAL_ 560 Loc_Validity_30_003 1 "Valid" 0 "Invalid" ;
VAL_ 560 Loc_Validity_30_002 1 "Valid" 0 "Invalid" ;
VAL_ 560 Loc_Validity_30_001 1 "Valid" 0 "Invalid" ;
VAL_ 553 Loc_Validity_29_004 1 "Valid" 0 "Invalid" ;
VAL_ 553 Loc_Validity_29_003 1 "Valid" 0 "Invalid" ;
VAL_ 553 Loc_Validity_29_002 1 "Valid" 0 "Invalid" ;
VAL_ 553 Loc_Validity_29_001 1 "Valid" 0 "Invalid" ;
VAL_ 552 Loc_Validity_28_004 1 "Valid" 0 "Invalid" ;
VAL_ 552 Loc_Validity_28_003 1 "Valid" 0 "Invalid" ;
VAL_ 552 Loc_Validity_28_002 1 "Valid" 0 "Invalid" ;
VAL_ 552 Loc_Validity_28_001 1 "Valid" 0 "Invalid" ;
VAL_ 551 Loc_Validity_27_004 1 "Valid" 0 "Invalid" ;
VAL_ 551 Loc_Validity_27_003 1 "Valid" 0 "Invalid" ;
VAL_ 551 Loc_Validity_27_002 1 "Valid" 0 "Invalid" ;
VAL_ 551 Loc_Validity_27_001 1 "Valid" 0 "Invalid" ;
VAL_ 550 Loc_Validity_26_004 1 "Valid" 0 "Invalid" ;
VAL_ 550 Loc_Validity_26_003 1 "Valid" 0 "Invalid" ;
VAL_ 550 Loc_Validity_26_002 1 "Valid" 0 "Invalid" ;
VAL_ 550 Loc_Validity_26_001 1 "Valid" 0 "Invalid" ;
VAL_ 549 Loc_Validity_25_004 1 "Valid" 0 "Invalid" ;
VAL_ 549 Loc_Validity_25_003 1 "Valid" 0 "Invalid" ;
VAL_ 549 Loc_Validity_25_002 1 "Valid" 0 "Invalid" ;
VAL_ 549 Loc_Validity_25_001 1 "Valid" 0 "Invalid" ;
VAL_ 548 Loc_Validity_24_004 1 "Valid" 0 "Invalid" ;
VAL_ 548 Loc_Validity_24_003 1 "Valid" 0 "Invalid" ;
VAL_ 548 Loc_Validity_24_002 1 "Valid" 0 "Invalid" ;
VAL_ 548 Loc_Validity_24_001 1 "Valid" 0 "Invalid" ;
VAL_ 547 Loc_Validity_23_004 1 "Valid" 0 "Invalid" ;
VAL_ 547 Loc_Validity_23_003 1 "Valid" 0 "Invalid" ;
VAL_ 547 Loc_Validity_23_002 1 "Valid" 0 "Invalid" ;
VAL_ 547 Loc_Validity_23_001 1 "Valid" 0 "Invalid" ;
VAL_ 546 Loc_Validity_22_004 1 "Valid" 0 "Invalid" ;
VAL_ 546 Loc_Validity_22_003 1 "Valid" 0 "Invalid" ;
VAL_ 546 Loc_Validity_22_002 1 "Valid" 0 "Invalid" ;
VAL_ 546 Loc_Validity_22_001 1 "Valid" 0 "Invalid" ;
VAL_ 545 Loc_Validity_21_004 1 "Valid" 0 "Invalid" ;
VAL_ 545 Loc_Validity_21_003 1 "Valid" 0 "Invalid" ;
VAL_ 545 Loc_Validity_21_002 1 "Valid" 0 "Invalid" ;
VAL_ 545 Loc_Validity_21_001 1 "Valid" 0 "Invalid" ;
VAL_ 544 Loc_Validity_20_004 1 "Valid" 0 "Invalid" ;
VAL_ 544 Loc_Validity_20_003 1 "Valid" 0 "Invalid" ;
VAL_ 544 Loc_Validity_20_002 1 "Valid" 0 "Invalid" ;
VAL_ 544 Loc_Validity_20_001 1 "Valid" 0 "Invalid" ;
VAL_ 537 Loc_Validity_19_004 1 "Valid" 0 "Invalid" ;
VAL_ 537 Loc_Validity_19_003 1 "Valid" 0 "Invalid" ;
VAL_ 537 Loc_Validity_19_002 1 "Valid" 0 "Invalid" ;
VAL_ 537 Loc_Validity_19_001 1 "Valid" 0 "Invalid" ;
VAL_ 536 Loc_Validity_18_004 1 "Valid" 0 "Invalid" ;
VAL_ 536 Loc_Validity_18_003 1 "Valid" 0 "Invalid" ;
VAL_ 536 Loc_Validity_18_002 1 "Valid" 0 "Invalid" ;
VAL_ 536 Loc_Validity_18_001 1 "Valid" 0 "Invalid" ;
VAL_ 535 Loc_Validity_17_004 1 "Valid" 0 "Invalid" ;
VAL_ 535 Loc_Validity_17_003 1 "Valid" 0 "Invalid" ;
VAL_ 535 Loc_Validity_17_002 1 "Valid" 0 "Invalid" ;
VAL_ 535 Loc_Validity_17_001 1 "Valid" 0 "Invalid" ;
VAL_ 513 Loc_Validity_01_004 1 "Valid" 0 "Invalid" ;
VAL_ 513 Loc_Validity_01_003 1 "Valid" 0 "Invalid" ;
VAL_ 513 Loc_Validity_01_002 1 "Valid" 0 "Invalid" ;
VAL_ 513 Loc_Validity_01_001 1 "Valid" 0 "Invalid" ;
VAL_ 514 Loc_Validity_02_004 1 "Valid" 0 "Invalid" ;
VAL_ 514 Loc_Validity_02_003 1 "Valid" 0 "Invalid" ;
VAL_ 514 Loc_Validity_02_002 1 "Valid" 0 "Invalid" ;
VAL_ 514 Loc_Validity_02_001 1 "Valid" 0 "Invalid" ;
VAL_ 515 Loc_Validity_03_004 1 "Valid" 0 "Invalid" ;
VAL_ 515 Loc_Validity_03_003 1 "Valid" 0 "Invalid" ;
VAL_ 515 Loc_Validity_03_002 1 "Valid" 0 "Invalid" ;
VAL_ 515 Loc_Validity_03_001 1 "Valid" 0 "Invalid" ;
VAL_ 516 Loc_Validity_04_004 1 "Valid" 0 "Invalid" ;
VAL_ 516 Loc_Validity_04_003 1 "Valid" 0 "Invalid" ;
VAL_ 516 Loc_Validity_04_002 1 "Valid" 0 "Invalid" ;
VAL_ 516 Loc_Validity_04_001 1 "Valid" 0 "Invalid" ;
VAL_ 517 Loc_Validity_05_004 1 "Valid" 0 "Invalid" ;
VAL_ 517 Loc_Validity_05_003 1 "Valid" 0 "Invalid" ;
VAL_ 517 Loc_Validity_05_002 1 "Valid" 0 "Invalid" ;
VAL_ 517 Loc_Validity_05_001 1 "Valid" 0 "Invalid" ;
VAL_ 518 Loc_Validity_06_004 1 "Valid" 0 "Invalid" ;
VAL_ 518 Loc_Validity_06_003 1 "Valid" 0 "Invalid" ;
VAL_ 518 Loc_Validity_06_002 1 "Valid" 0 "Invalid" ;
VAL_ 518 Loc_Validity_06_001 1 "Valid" 0 "Invalid" ;
VAL_ 519 Loc_Validity_07_004 1 "Valid" 0 "Invalid" ;
VAL_ 519 Loc_Validity_07_003 1 "Valid" 0 "Invalid" ;
VAL_ 519 Loc_Validity_07_002 1 "Valid" 0 "Invalid" ;
VAL_ 519 Loc_Validity_07_001 1 "Valid" 0 "Invalid" ;
VAL_ 520 Loc_Validity_08_004 1 "Valid" 0 "Invalid" ;
VAL_ 520 Loc_Validity_08_003 1 "Valid" 0 "Invalid" ;
VAL_ 520 Loc_Validity_08_002 1 "Valid" 0 "Invalid" ;
VAL_ 520 Loc_Validity_08_001 1 "Valid" 0 "Invalid" ;
VAL_ 521 Loc_Validity_09_004 1 "Valid" 0 "Invalid" ;
VAL_ 521 Loc_Validity_09_003 1 "Valid" 0 "Invalid" ;
VAL_ 521 Loc_Validity_09_002 1 "Valid" 0 "Invalid" ;
VAL_ 521 Loc_Validity_09_001 1 "Valid" 0 "Invalid" ;
VAL_ 528 Loc_Validity_10_004 1 "Valid" 0 "Invalid" ;
VAL_ 528 Loc_Validity_10_003 1 "Valid" 0 "Invalid" ;
VAL_ 528 Loc_Validity_10_002 1 "Valid" 0 "Invalid" ;
VAL_ 528 Loc_Validity_10_001 1 "Valid" 0 "Invalid" ;
VAL_ 529 Loc_Validity_11_004 1 "Valid" 0 "Invalid" ;
VAL_ 529 Loc_Validity_11_003 1 "Valid" 0 "Invalid" ;
VAL_ 529 Loc_Validity_11_002 1 "Valid" 0 "Invalid" ;
VAL_ 529 Loc_Validity_11_001 1 "Valid" 0 "Invalid" ;
VAL_ 530 Loc_Validity_12_004 1 "Valid" 0 "Invalid" ;
VAL_ 530 Loc_Validity_12_003 1 "Valid" 0 "Invalid" ;
VAL_ 530 Loc_Validity_12_002 1 "Valid" 0 "Invalid" ;
VAL_ 530 Loc_Validity_12_001 1 "Valid" 0 "Invalid" ;
VAL_ 531 Loc_Validity_13_004 1 "Valid" 0 "Invalid" ;
VAL_ 531 Loc_Validity_13_003 1 "Valid" 0 "Invalid" ;
VAL_ 531 Loc_Validity_13_002 1 "Valid" 0 "Invalid" ;
VAL_ 531 Loc_Validity_13_001 1 "Valid" 0 "Invalid" ;
VAL_ 532 Loc_Validity_14_004 1 "Valid" 0 "Invalid" ;
VAL_ 532 Loc_Validity_14_003 1 "Valid" 0 "Invalid" ;
VAL_ 532 Loc_Validity_14_002 1 "Valid" 0 "Invalid" ;
VAL_ 532 Loc_Validity_14_001 1 "Valid" 0 "Invalid" ;
VAL_ 533 Loc_Validity_15_004 1 "Valid" 0 "Invalid" ;
VAL_ 533 Loc_Validity_15_003 1 "Valid" 0 "Invalid" ;
VAL_ 533 Loc_Validity_15_002 1 "Valid" 0 "Invalid" ;
VAL_ 533 Loc_Validity_15_001 1 "Valid" 0 "Invalid" ;
VAL_ 534 Loc_Validity_16_004 1 "Valid" 0 "Invalid" ;
VAL_ 534 Loc_Validity_16_003 1 "Valid" 0 "Invalid" ;
VAL_ 534 Loc_Validity_16_002 1 "Valid" 0 "Invalid" ;
VAL_ 534 Loc_Validity_16_001 1 "Valid" 0 "Invalid" ;
