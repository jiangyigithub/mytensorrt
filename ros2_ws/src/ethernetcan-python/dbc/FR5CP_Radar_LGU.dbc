VERSION "created by canmatrix"

NS_ :

BS_:

BU_: RadarFrontCenter DASy

BO_ 428 RFC_Location_056_057: 64 RadarFrontCenter
 SG_ RFC_Loc056_CRC : 0|16@1+ (1,0) [0|65535] ""  DASy
 SG_ RFC_Loc056_AliveCtr : 16|8@1+ (1,0) [0|255] ""  DASy
 SG_ RFC_Loc056_ProtBlockCtr : 24|8@1+ (1,0) [0|255] ""  DASy
 SG_ RFC_Loc056_Dr : 32|16@1+ (0.0078125,0) [0|511.9921875] "m"  DASy
 SG_ RFC_Loc056_Vr : 48|16@1+ (0.00390625,-128) [-128|127.99609375] "m/s"  DASy
 SG_ RFC_Loc056_Theta : 64|16@1+ (0.01,-327.68) [-90|90] "deg"  DASy
 SG_ RFC_Loc056_Phi : 80|16@1+ (0.01,-327.68) [-30|30] "deg"  DASy
 SG_ RFC_Loc056_DrVnce : 96|16@1+ (1.52588E-005,0) [0|0.999984741210937] "m^2"  DASy
 SG_ RFC_Loc056_VrVnce : 112|16@1+ (1.52588E-005,0) [0|0.999984741210937] "m^2/s^2"  DASy
 SG_ RFC_Loc056_ThetaVnce : 128|16@1+ (0.00390625,0) [0|255.99609375] "deg^2"  DASy
 SG_ RFC_Loc056_PhiVnce : 144|16@1+ (0.00390625,0) [0|255.99609375] "deg^2"  DASy
 SG_ RFC_Loc056_RCS : 176|16@1+ (0.00390625,-128) [-128|127.99609375] "dBsm"  DASy
 SG_ RFC_Loc056_RSSI : 192|16@1+ (0.00195312,0) [0|127.998046875] "dimensionless"  DASy
 SG_ RFC_Loc057_Dr : 256|16@1+ (0.0078125,0) [0|511.9921875] "m"  DASy
 SG_ RFC_Loc057_Vr : 272|16@1+ (0.00390625,-128) [-128|127.99609375] "m/s"  DASy
 SG_ RFC_Loc057_Theta : 288|16@1+ (0.01,-327.68) [-90|90] "deg"  DASy
 SG_ RFC_Loc057_Phi : 304|16@1+ (0.01,-327.68) [-30|30] "deg"  DASy
 SG_ RFC_Loc057_DrVnce : 320|16@1+ (1.52588E-005,0) [0|0.999984741210937] "m^2"  DASy
 SG_ RFC_Loc057_VrVnce : 336|16@1+ (1.52588E-005,0) [0|0.999984741210937] "m^2/s^2"  DASy
 SG_ RFC_Loc057_ThetaVnce : 352|16@1+ (0.00390625,0) [0|255.99609375] "deg^2"  DASy
 SG_ RFC_Loc057_PhiVnce : 368|16@1+ (0.00390625,0) [0|255.99609375] "deg^2"  DASy
 SG_ RFC_Loc057_RCS : 400|16@1+ (0.00390625,-128) [-128|127.99609375] "dBsm"  DASy
 SG_ RFC_Loc057_RSSI : 416|16@1+ (0.00195312,0) [0|127.998046875] "dimensionless"  DASy

BO_ 429 RFC_Location_058_059: 64 RadarFrontCenter
 SG_ RFC_Loc058_CRC : 0|16@1+ (1,0) [0|65535] ""  DASy
 SG_ RFC_Loc058_AliveCtr : 16|8@1+ (1,0) [0|255] ""  DASy
 SG_ RFC_Loc058_ProtBlockCtr : 24|8@1+ (1,0) [0|255] ""  DASy
 SG_ RFC_Loc058_Dr : 32|16@1+ (0.0078125,0) [0|511.9921875] "m"  DASy
 SG_ RFC_Loc058_Vr : 48|16@1+ (0.00390625,-128) [-128|127.99609375] "m/s"  DASy
 SG_ RFC_Loc058_Theta : 64|16@1+ (0.01,-327.68) [-90|90] "deg"  DASy
 SG_ RFC_Loc058_Phi : 80|16@1+ (0.01,-327.68) [-30|30] "deg"  DASy
 SG_ RFC_Loc058_DrVnce : 96|16@1+ (1.52588E-005,0) [0|0.999984741210937] "m^2"  DASy
 SG_ RFC_Loc058_VrVnce : 112|16@1+ (1.52588E-005,0) [0|0.999984741210937] "m^2/s^2"  DASy
 SG_ RFC_Loc058_ThetaVnce : 128|16@1+ (0.00390625,0) [0|255.99609375] "deg^2"  DASy
 SG_ RFC_Loc058_PhiVnce : 144|16@1+ (0.00390625,0) [0|255.99609375] "deg^2"  DASy
 SG_ RFC_Loc058_RCS : 176|16@1+ (0.00390625,-128) [-128|127.99609375] "dBsm"  DASy
 SG_ RFC_Loc058_RSSI : 192|16@1+ (0.00195312,0) [0|127.998046875] "dimensionless"  DASy
 SG_ RFC_Loc059_Dr : 256|16@1+ (0.0078125,0) [0|511.9921875] "m"  DASy
 SG_ RFC_Loc059_Vr : 272|16@1+ (0.00390625,-128) [-128|127.99609375] "m/s"  DASy
 SG_ RFC_Loc059_Theta : 288|16@1+ (0.01,-327.68) [-90|90] "deg"  DASy
 SG_ RFC_Loc059_Phi : 304|16@1+ (0.01,-327.68) [-30|30] "deg"  DASy
 SG_ RFC_Loc059_DrVnce : 320|16@1+ (1.52588E-005,0) [0|0.999984741210937] "m^2"  DASy
 SG_ RFC_Loc059_VrVnce : 336|16@1+ (1.52588E-005,0) [0|0.999984741210937] "m^2/s^2"  DASy
 SG_ RFC_Loc059_ThetaVnce : 352|16@1+ (0.00390625,0) [0|255.99609375] "deg^2"  DASy
 SG_ RFC_Loc059_PhiVnce : 368|16@1+ (0.00390625,0) [0|255.99609375] "deg^2"  DASy
 SG_ RFC_Loc059_RCS : 400|16@1+ (0.00390625,-128) [-128|127.99609375] "dBsm"  DASy
 SG_ RFC_Loc059_RSSI : 416|16@1+ (0.00195312,0) [0|127.998046875] "dimensionless"  DASy

BO_ 430 RFC_Location_060_061: 64 RadarFrontCenter
 SG_ RFC_Loc060_CRC : 0|16@1+ (1,0) [0|65535] ""  DASy
 SG_ RFC_Loc060_AliveCtr : 16|8@1+ (1,0) [0|255] ""  DASy
 SG_ RFC_Loc060_ProtBlockCtr : 24|8@1+ (1,0) [0|255] ""  DASy
 SG_ RFC_Loc060_Dr : 32|16@1+ (0.0078125,0) [0|511.9921875] "m"  DASy
 SG_ RFC_Loc060_Vr : 48|16@1+ (0.00390625,-128) [-128|127.99609375] "m/s"  DASy
 SG_ RFC_Loc060_Theta : 64|16@1+ (0.01,-327.68) [-90|90] "deg"  DASy
 SG_ RFC_Loc060_Phi : 80|16@1+ (0.01,-327.68) [-30|30] "deg"  DASy
 SG_ RFC_Loc060_DrVnce : 96|16@1+ (1.52588E-005,0) [0|0.999984741210937] "m^2"  DASy
 SG_ RFC_Loc060_VrVnce : 112|16@1+ (1.52588E-005,0) [0|0.999984741210937] "m^2/s^2"  DASy
 SG_ RFC_Loc060_ThetaVnce : 128|16@1+ (0.00390625,0) [0|255.99609375] "deg^2"  DASy
 SG_ RFC_Loc060_PhiVnce : 144|16@1+ (0.00390625,0) [0|255.99609375] "deg^2"  DASy
 SG_ RFC_Loc060_RCS : 176|16@1+ (0.00390625,-128) [-128|127.99609375] "dBsm"  DASy
 SG_ RFC_Loc060_RSSI : 192|16@1+ (0.00195312,0) [0|127.998046875] "dimensionless"  DASy
 SG_ RFC_Loc061_Dr : 256|16@1+ (0.0078125,0) [0|511.9921875] "m"  DASy
 SG_ RFC_Loc061_Vr : 272|16@1+ (0.00390625,-128) [-128|127.99609375] "m/s"  DASy
 SG_ RFC_Loc061_Theta : 288|16@1+ (0.01,-327.68) [-90|90] "deg"  DASy
 SG_ RFC_Loc061_Phi : 304|16@1+ (0.01,-327.68) [-30|30] "deg"  DASy
 SG_ RFC_Loc061_DrVnce : 320|16@1+ (1.52588E-005,0) [0|0.999984741210937] "m^2"  DASy
 SG_ RFC_Loc061_VrVnce : 336|16@1+ (1.52588E-005,0) [0|0.999984741210937] "m^2/s^2"  DASy
 SG_ RFC_Loc061_ThetaVnce : 352|16@1+ (0.00390625,0) [0|255.99609375] "deg^2"  DASy
 SG_ RFC_Loc061_PhiVnce : 368|16@1+ (0.00390625,0) [0|255.99609375] "deg^2"  DASy
 SG_ RFC_Loc061_RCS : 400|16@1+ (0.00390625,-128) [-128|127.99609375] "dBsm"  DASy
 SG_ RFC_Loc061_RSSI : 416|16@1+ (0.00195312,0) [0|127.998046875] "dimensionless"  DASy

BO_ 431 RFC_Location_062_063: 64 RadarFrontCenter
 SG_ RFC_Loc062_CRC : 0|16@1+ (1,0) [0|65535] ""  DASy
 SG_ RFC_Loc062_AliveCtr : 16|8@1+ (1,0) [0|255] ""  DASy
 SG_ RFC_Loc062_ProtBlockCtr : 24|8@1+ (1,0) [0|255] ""  DASy
 SG_ RFC_Loc062_Dr : 32|16@1+ (0.0078125,0) [0|511.9921875] "m"  DASy
 SG_ RFC_Loc062_Vr : 48|16@1+ (0.00390625,-128) [-128|127.99609375] "m/s"  DASy
 SG_ RFC_Loc062_Theta : 64|16@1+ (0.01,-327.68) [-90|90] "deg"  DASy
 SG_ RFC_Loc062_Phi : 80|16@1+ (0.01,-327.68) [-30|30] "deg"  DASy
 SG_ RFC_Loc062_DrVnce : 96|16@1+ (1.52588E-005,0) [0|0.999984741210937] "m^2"  DASy
 SG_ RFC_Loc062_VrVnce : 112|16@1+ (1.52588E-005,0) [0|0.999984741210937] "m^2/s^2"  DASy
 SG_ RFC_Loc062_ThetaVnce : 128|16@1+ (0.00390625,0) [0|255.99609375] "deg^2"  DASy
 SG_ RFC_Loc062_PhiVnce : 144|16@1+ (0.00390625,0) [0|255.99609375] "deg^2"  DASy
 SG_ RFC_Loc062_RCS : 176|16@1+ (0.00390625,-128) [-128|127.99609375] "dBsm"  DASy
 SG_ RFC_Loc062_RSSI : 192|16@1+ (0.00195312,0) [0|127.998046875] "dimensionless"  DASy
 SG_ RFC_Loc063_Dr : 256|16@1+ (0.0078125,0) [0|511.9921875] "m"  DASy
 SG_ RFC_Loc063_Vr : 272|16@1+ (0.00390625,-128) [-128|127.99609375] "m/s"  DASy
 SG_ RFC_Loc063_Theta : 288|16@1+ (0.01,-327.68) [-90|90] "deg"  DASy
 SG_ RFC_Loc063_Phi : 304|16@1+ (0.01,-327.68) [-30|30] "deg"  DASy
 SG_ RFC_Loc063_DrVnce : 320|16@1+ (1.52588E-005,0) [0|0.999984741210937] "m^2"  DASy
 SG_ RFC_Loc063_VrVnce : 336|16@1+ (1.52588E-005,0) [0|0.999984741210937] "m^2/s^2"  DASy
 SG_ RFC_Loc063_ThetaVnce : 352|16@1+ (0.00390625,0) [0|255.99609375] "deg^2"  DASy
 SG_ RFC_Loc063_PhiVnce : 368|16@1+ (0.00390625,0) [0|255.99609375] "deg^2"  DASy
 SG_ RFC_Loc063_RCS : 400|16@1+ (0.00390625,-128) [-128|127.99609375] "dBsm"  DASy
 SG_ RFC_Loc063_RSSI : 416|16@1+ (0.00195312,0) [0|127.998046875] "dimensionless"  DASy

BO_ 432 RFC_Location_064_065: 64 RadarFrontCenter
 SG_ RFC_Loc064_CRC : 0|16@1+ (1,0) [0|65535] ""  DASy
 SG_ RFC_Loc064_AliveCtr : 16|8@1+ (1,0) [0|255] ""  DASy
 SG_ RFC_Loc064_ProtBlockCtr : 24|8@1+ (1,0) [0|255] ""  DASy
 SG_ RFC_Loc064_Dr : 32|16@1+ (0.0078125,0) [0|511.9921875] "m"  DASy
 SG_ RFC_Loc064_Vr : 48|16@1+ (0.00390625,-128) [-128|127.99609375] "m/s"  DASy
 SG_ RFC_Loc064_Theta : 64|16@1+ (0.01,-327.68) [-90|90] "deg"  DASy
 SG_ RFC_Loc064_Phi : 80|16@1+ (0.01,-327.68) [-30|30] "deg"  DASy
 SG_ RFC_Loc064_DrVnce : 96|16@1+ (1.52588E-005,0) [0|0.999984741210937] "m^2"  DASy
 SG_ RFC_Loc064_VrVnce : 112|16@1+ (1.52588E-005,0) [0|0.999984741210937] "m^2/s^2"  DASy
 SG_ RFC_Loc064_ThetaVnce : 128|16@1+ (0.00390625,0) [0|255.99609375] "deg^2"  DASy
 SG_ RFC_Loc064_PhiVnce : 144|16@1+ (0.00390625,0) [0|255.99609375] "deg^2"  DASy
 SG_ RFC_Loc064_RCS : 176|16@1+ (0.00390625,-128) [-128|127.99609375] "dBsm"  DASy
 SG_ RFC_Loc064_RSSI : 192|16@1+ (0.00195312,0) [0|127.998046875] "dimensionless"  DASy
 SG_ RFC_Loc065_Dr : 256|16@1+ (0.0078125,0) [0|511.9921875] "m"  DASy
 SG_ RFC_Loc065_Vr : 272|16@1+ (0.00390625,-128) [-128|127.99609375] "m/s"  DASy
 SG_ RFC_Loc065_Theta : 288|16@1+ (0.01,-327.68) [-90|90] "deg"  DASy
 SG_ RFC_Loc065_Phi : 304|16@1+ (0.01,-327.68) [-30|30] "deg"  DASy
 SG_ RFC_Loc065_DrVnce : 320|16@1+ (1.52588E-005,0) [0|0.999984741210937] "m^2"  DASy
 SG_ RFC_Loc065_VrVnce : 336|16@1+ (1.52588E-005,0) [0|0.999984741210937] "m^2/s^2"  DASy
 SG_ RFC_Loc065_ThetaVnce : 352|16@1+ (0.00390625,0) [0|255.99609375] "deg^2"  DASy
 SG_ RFC_Loc065_PhiVnce : 368|16@1+ (0.00390625,0) [0|255.99609375] "deg^2"  DASy
 SG_ RFC_Loc065_RCS : 400|16@1+ (0.00390625,-128) [-128|127.99609375] "dBsm"  DASy
 SG_ RFC_Loc065_RSSI : 416|16@1+ (0.00195312,0) [0|127.998046875] "dimensionless"  DASy

BO_ 433 RFC_Location_066_067: 64 RadarFrontCenter
 SG_ RFC_Loc066_CRC : 0|16@1+ (1,0) [0|65535] ""  DASy
 SG_ RFC_Loc066_AliveCtr : 16|8@1+ (1,0) [0|255] ""  DASy
 SG_ RFC_Loc066_ProtBlockCtr : 24|8@1+ (1,0) [0|255] ""  DASy
 SG_ RFC_Loc066_Dr : 32|16@1+ (0.0078125,0) [0|511.9921875] "m"  DASy
 SG_ RFC_Loc066_Vr : 48|16@1+ (0.00390625,-128) [-128|127.99609375] "m/s"  DASy
 SG_ RFC_Loc066_Theta : 64|16@1+ (0.01,-327.68) [-90|90] "deg"  DASy
 SG_ RFC_Loc066_Phi : 80|16@1+ (0.01,-327.68) [-30|30] "deg"  DASy
 SG_ RFC_Loc066_DrVnce : 96|16@1+ (1.52588E-005,0) [0|0.999984741210937] "m^2"  DASy
 SG_ RFC_Loc066_VrVnce : 112|16@1+ (1.52588E-005,0) [0|0.999984741210937] "m^2/s^2"  DASy
 SG_ RFC_Loc066_ThetaVnce : 128|16@1+ (0.00390625,0) [0|255.99609375] "deg^2"  DASy
 SG_ RFC_Loc066_PhiVnce : 144|16@1+ (0.00390625,0) [0|255.99609375] "deg^2"  DASy
 SG_ RFC_Loc066_RCS : 176|16@1+ (0.00390625,-128) [-128|127.99609375] "dBsm"  DASy
 SG_ RFC_Loc066_RSSI : 192|16@1+ (0.00195312,0) [0|127.998046875] "dimensionless"  DASy
 SG_ RFC_Loc067_Dr : 256|16@1+ (0.0078125,0) [0|511.9921875] "m"  DASy
 SG_ RFC_Loc067_Vr : 272|16@1+ (0.00390625,-128) [-128|127.99609375] "m/s"  DASy
 SG_ RFC_Loc067_Theta : 288|16@1+ (0.01,-327.68) [-90|90] "deg"  DASy
 SG_ RFC_Loc067_Phi : 304|16@1+ (0.01,-327.68) [-30|30] "deg"  DASy
 SG_ RFC_Loc067_DrVnce : 320|16@1+ (1.52588E-005,0) [0|0.999984741210937] "m^2"  DASy
 SG_ RFC_Loc067_VrVnce : 336|16@1+ (1.52588E-005,0) [0|0.999984741210937] "m^2/s^2"  DASy
 SG_ RFC_Loc067_ThetaVnce : 352|16@1+ (0.00390625,0) [0|255.99609375] "deg^2"  DASy
 SG_ RFC_Loc067_PhiVnce : 368|16@1+ (0.00390625,0) [0|255.99609375] "deg^2"  DASy
 SG_ RFC_Loc067_RCS : 400|16@1+ (0.00390625,-128) [-128|127.99609375] "dBsm"  DASy
 SG_ RFC_Loc067_RSSI : 416|16@1+ (0.00195312,0) [0|127.998046875] "dimensionless"  DASy

BO_ 434 RFC_Location_068_069: 64 RadarFrontCenter
 SG_ RFC_Loc068_CRC : 0|16@1+ (1,0) [0|65535] ""  DASy
 SG_ RFC_Loc068_AliveCtr : 16|8@1+ (1,0) [0|255] ""  DASy
 SG_ RFC_Loc068_ProtBlockCtr : 24|8@1+ (1,0) [0|255] ""  DASy
 SG_ RFC_Loc068_Dr : 32|16@1+ (0.0078125,0) [0|511.9921875] "m"  DASy
 SG_ RFC_Loc068_Vr : 48|16@1+ (0.00390625,-128) [-128|127.99609375] "m/s"  DASy
 SG_ RFC_Loc068_Theta : 64|16@1+ (0.01,-327.68) [-90|90] "deg"  DASy
 SG_ RFC_Loc068_Phi : 80|16@1+ (0.01,-327.68) [-30|30] "deg"  DASy
 SG_ RFC_Loc068_DrVnce : 96|16@1+ (1.52588E-005,0) [0|0.999984741210937] "m^2"  DASy
 SG_ RFC_Loc068_VrVnce : 112|16@1+ (1.52588E-005,0) [0|0.999984741210937] "m^2/s^2"  DASy
 SG_ RFC_Loc068_ThetaVnce : 128|16@1+ (0.00390625,0) [0|255.99609375] "deg^2"  DASy
 SG_ RFC_Loc068_PhiVnce : 144|16@1+ (0.00390625,0) [0|255.99609375] "deg^2"  DASy
 SG_ RFC_Loc068_RCS : 176|16@1+ (0.00390625,-128) [-128|127.99609375] "dBsm"  DASy
 SG_ RFC_Loc068_RSSI : 192|16@1+ (0.00195312,0) [0|127.998046875] "dimensionless"  DASy
 SG_ RFC_Loc069_Dr : 256|16@1+ (0.0078125,0) [0|511.9921875] "m"  DASy
 SG_ RFC_Loc069_Vr : 272|16@1+ (0.00390625,-128) [-128|127.99609375] "m/s"  DASy
 SG_ RFC_Loc069_Theta : 288|16@1+ (0.01,-327.68) [-90|90] "deg"  DASy
 SG_ RFC_Loc069_Phi : 304|16@1+ (0.01,-327.68) [-30|30] "deg"  DASy
 SG_ RFC_Loc069_DrVnce : 320|16@1+ (1.52588E-005,0) [0|0.999984741210937] "m^2"  DASy
 SG_ RFC_Loc069_VrVnce : 336|16@1+ (1.52588E-005,0) [0|0.999984741210937] "m^2/s^2"  DASy
 SG_ RFC_Loc069_ThetaVnce : 352|16@1+ (0.00390625,0) [0|255.99609375] "deg^2"  DASy
 SG_ RFC_Loc069_PhiVnce : 368|16@1+ (0.00390625,0) [0|255.99609375] "deg^2"  DASy
 SG_ RFC_Loc069_RCS : 400|16@1+ (0.00390625,-128) [-128|127.99609375] "dBsm"  DASy
 SG_ RFC_Loc069_RSSI : 416|16@1+ (0.00195312,0) [0|127.998046875] "dimensionless"  DASy

BO_ 435 RFC_Location_070_071: 64 RadarFrontCenter
 SG_ RFC_Loc070_CRC : 0|16@1+ (1,0) [0|65535] ""  DASy
 SG_ RFC_Loc070_AliveCtr : 16|8@1+ (1,0) [0|255] ""  DASy
 SG_ RFC_Loc070_ProtBlockCtr : 24|8@1+ (1,0) [0|255] ""  DASy
 SG_ RFC_Loc070_Dr : 32|16@1+ (0.0078125,0) [0|511.9921875] "m"  DASy
 SG_ RFC_Loc070_Vr : 48|16@1+ (0.00390625,-128) [-128|127.99609375] "m/s"  DASy
 SG_ RFC_Loc070_Theta : 64|16@1+ (0.01,-327.68) [-90|90] "deg"  DASy
 SG_ RFC_Loc070_Phi : 80|16@1+ (0.01,-327.68) [-30|30] "deg"  DASy
 SG_ RFC_Loc070_DrVnce : 96|16@1+ (1.52588E-005,0) [0|0.999984741210937] "m^2"  DASy
 SG_ RFC_Loc070_VrVnce : 112|16@1+ (1.52588E-005,0) [0|0.999984741210937] "m^2/s^2"  DASy
 SG_ RFC_Loc070_ThetaVnce : 128|16@1+ (0.00390625,0) [0|255.99609375] "deg^2"  DASy
 SG_ RFC_Loc070_PhiVnce : 144|16@1+ (0.00390625,0) [0|255.99609375] "deg^2"  DASy
 SG_ RFC_Loc070_RCS : 176|16@1+ (0.00390625,-128) [-128|127.99609375] "dBsm"  DASy
 SG_ RFC_Loc070_RSSI : 192|16@1+ (0.00195312,0) [0|127.998046875] "dimensionless"  DASy
 SG_ RFC_Loc071_Dr : 256|16@1+ (0.0078125,0) [0|511.9921875] "m"  DASy
 SG_ RFC_Loc071_Vr : 272|16@1+ (0.00390625,-128) [-128|127.99609375] "m/s"  DASy
 SG_ RFC_Loc071_Theta : 288|16@1+ (0.01,-327.68) [-90|90] "deg"  DASy
 SG_ RFC_Loc071_Phi : 304|16@1+ (0.01,-327.68) [-30|30] "deg"  DASy
 SG_ RFC_Loc071_DrVnce : 320|16@1+ (1.52588E-005,0) [0|0.999984741210937] "m^2"  DASy
 SG_ RFC_Loc071_VrVnce : 336|16@1+ (1.52588E-005,0) [0|0.999984741210937] "m^2/s^2"  DASy
 SG_ RFC_Loc071_ThetaVnce : 352|16@1+ (0.00390625,0) [0|255.99609375] "deg^2"  DASy
 SG_ RFC_Loc071_PhiVnce : 368|16@1+ (0.00390625,0) [0|255.99609375] "deg^2"  DASy
 SG_ RFC_Loc071_RCS : 400|16@1+ (0.00390625,-128) [-128|127.99609375] "dBsm"  DASy
 SG_ RFC_Loc071_RSSI : 416|16@1+ (0.00195312,0) [0|127.998046875] "dimensionless"  DASy

BO_ 436 RFC_Location_072_073: 64 RadarFrontCenter
 SG_ RFC_Loc072_CRC : 0|16@1+ (1,0) [0|65535] ""  DASy
 SG_ RFC_Loc072_AliveCtr : 16|8@1+ (1,0) [0|255] ""  DASy
 SG_ RFC_Loc072_ProtBlockCtr : 24|8@1+ (1,0) [0|255] ""  DASy
 SG_ RFC_Loc072_Dr : 32|16@1+ (0.0078125,0) [0|511.9921875] "m"  DASy
 SG_ RFC_Loc072_Vr : 48|16@1+ (0.00390625,-128) [-128|127.99609375] "m/s"  DASy
 SG_ RFC_Loc072_Theta : 64|16@1+ (0.01,-327.68) [-90|90] "deg"  DASy
 SG_ RFC_Loc072_Phi : 80|16@1+ (0.01,-327.68) [-30|30] "deg"  DASy
 SG_ RFC_Loc072_DrVnce : 96|16@1+ (1.52588E-005,0) [0|0.999984741210937] "m^2"  DASy
 SG_ RFC_Loc072_VrVnce : 112|16@1+ (1.52588E-005,0) [0|0.999984741210937] "m^2/s^2"  DASy
 SG_ RFC_Loc072_ThetaVnce : 128|16@1+ (0.00390625,0) [0|255.99609375] "deg^2"  DASy
 SG_ RFC_Loc072_PhiVnce : 144|16@1+ (0.00390625,0) [0|255.99609375] "deg^2"  DASy
 SG_ RFC_Loc072_RCS : 176|16@1+ (0.00390625,-128) [-128|127.99609375] "dBsm"  DASy
 SG_ RFC_Loc072_RSSI : 192|16@1+ (0.00195312,0) [0|127.998046875] "dimensionless"  DASy
 SG_ RFC_Loc073_Dr : 256|16@1+ (0.0078125,0) [0|511.9921875] "m"  DASy
 SG_ RFC_Loc073_Vr : 272|16@1+ (0.00390625,-128) [-128|127.99609375] "m/s"  DASy
 SG_ RFC_Loc073_Theta : 288|16@1+ (0.01,-327.68) [-90|90] "deg"  DASy
 SG_ RFC_Loc073_Phi : 304|16@1+ (0.01,-327.68) [-30|30] "deg"  DASy
 SG_ RFC_Loc073_DrVnce : 320|16@1+ (1.52588E-005,0) [0|0.999984741210937] "m^2"  DASy
 SG_ RFC_Loc073_VrVnce : 336|16@1+ (1.52588E-005,0) [0|0.999984741210937] "m^2/s^2"  DASy
 SG_ RFC_Loc073_ThetaVnce : 352|16@1+ (0.00390625,0) [0|255.99609375] "deg^2"  DASy
 SG_ RFC_Loc073_PhiVnce : 368|16@1+ (0.00390625,0) [0|255.99609375] "deg^2"  DASy
 SG_ RFC_Loc073_RCS : 400|16@1+ (0.00390625,-128) [-128|127.99609375] "dBsm"  DASy
 SG_ RFC_Loc073_RSSI : 416|16@1+ (0.00195312,0) [0|127.998046875] "dimensionless"  DASy

BO_ 437 RFC_Location_074_075: 64 RadarFrontCenter
 SG_ RFC_Loc074_CRC : 0|16@1+ (1,0) [0|65535] ""  DASy
 SG_ RFC_Loc074_AliveCtr : 16|8@1+ (1,0) [0|255] ""  DASy
 SG_ RFC_Loc074_ProtBlockCtr : 24|8@1+ (1,0) [0|255] ""  DASy
 SG_ RFC_Loc074_Dr : 32|16@1+ (0.0078125,0) [0|511.9921875] "m"  DASy
 SG_ RFC_Loc074_Vr : 48|16@1+ (0.00390625,-128) [-128|127.99609375] "m/s"  DASy
 SG_ RFC_Loc074_Theta : 64|16@1+ (0.01,-327.68) [-90|90] "deg"  DASy
 SG_ RFC_Loc074_Phi : 80|16@1+ (0.01,-327.68) [-30|30] "deg"  DASy
 SG_ RFC_Loc074_DrVnce : 96|16@1+ (1.52588E-005,0) [0|0.999984741210937] "m^2"  DASy
 SG_ RFC_Loc074_VrVnce : 112|16@1+ (1.52588E-005,0) [0|0.999984741210937] "m^2/s^2"  DASy
 SG_ RFC_Loc074_ThetaVnce : 128|16@1+ (0.00390625,0) [0|255.99609375] "deg^2"  DASy
 SG_ RFC_Loc074_PhiVnce : 144|16@1+ (0.00390625,0) [0|255.99609375] "deg^2"  DASy
 SG_ RFC_Loc074_RCS : 176|16@1+ (0.00390625,-128) [-128|127.99609375] "dBsm"  DASy
 SG_ RFC_Loc074_RSSI : 192|16@1+ (0.00195312,0) [0|127.998046875] "dimensionless"  DASy
 SG_ RFC_Loc075_Dr : 256|16@1+ (0.0078125,0) [0|511.9921875] "m"  DASy
 SG_ RFC_Loc075_Vr : 272|16@1+ (0.00390625,-128) [-128|127.99609375] "m/s"  DASy
 SG_ RFC_Loc075_Theta : 288|16@1+ (0.01,-327.68) [-90|90] "deg"  DASy
 SG_ RFC_Loc075_Phi : 304|16@1+ (0.01,-327.68) [-30|30] "deg"  DASy
 SG_ RFC_Loc075_DrVnce : 320|16@1+ (1.52588E-005,0) [0|0.999984741210937] "m^2"  DASy
 SG_ RFC_Loc075_VrVnce : 336|16@1+ (1.52588E-005,0) [0|0.999984741210937] "m^2/s^2"  DASy
 SG_ RFC_Loc075_ThetaVnce : 352|16@1+ (0.00390625,0) [0|255.99609375] "deg^2"  DASy
 SG_ RFC_Loc075_PhiVnce : 368|16@1+ (0.00390625,0) [0|255.99609375] "deg^2"  DASy
 SG_ RFC_Loc075_RCS : 400|16@1+ (0.00390625,-128) [-128|127.99609375] "dBsm"  DASy
 SG_ RFC_Loc075_RSSI : 416|16@1+ (0.00195312,0) [0|127.998046875] "dimensionless"  DASy

BO_ 438 RFC_Location_076_077: 64 RadarFrontCenter
 SG_ RFC_Loc076_CRC : 0|16@1+ (1,0) [0|65535] ""  DASy
 SG_ RFC_Loc076_AliveCtr : 16|8@1+ (1,0) [0|255] ""  DASy
 SG_ RFC_Loc076_ProtBlockCtr : 24|8@1+ (1,0) [0|255] ""  DASy
 SG_ RFC_Loc076_Dr : 32|16@1+ (0.0078125,0) [0|511.9921875] "m"  DASy
 SG_ RFC_Loc076_Vr : 48|16@1+ (0.00390625,-128) [-128|127.99609375] "m/s"  DASy
 SG_ RFC_Loc076_Theta : 64|16@1+ (0.01,-327.68) [-90|90] "deg"  DASy
 SG_ RFC_Loc076_Phi : 80|16@1+ (0.01,-327.68) [-30|30] "deg"  DASy
 SG_ RFC_Loc076_DrVnce : 96|16@1+ (1.52588E-005,0) [0|0.999984741210937] "m^2"  DASy
 SG_ RFC_Loc076_VrVnce : 112|16@1+ (1.52588E-005,0) [0|0.999984741210937] "m^2/s^2"  DASy
 SG_ RFC_Loc076_ThetaVnce : 128|16@1+ (0.00390625,0) [0|255.99609375] "deg^2"  DASy
 SG_ RFC_Loc076_PhiVnce : 144|16@1+ (0.00390625,0) [0|255.99609375] "deg^2"  DASy
 SG_ RFC_Loc076_RCS : 176|16@1+ (0.00390625,-128) [-128|127.99609375] "dBsm"  DASy
 SG_ RFC_Loc076_RSSI : 192|16@1+ (0.00195312,0) [0|127.998046875] "dimensionless"  DASy
 SG_ RFC_Loc077_Dr : 256|16@1+ (0.0078125,0) [0|511.9921875] "m"  DASy
 SG_ RFC_Loc077_Vr : 272|16@1+ (0.00390625,-128) [-128|127.99609375] "m/s"  DASy
 SG_ RFC_Loc077_Theta : 288|16@1+ (0.01,-327.68) [-90|90] "deg"  DASy
 SG_ RFC_Loc077_Phi : 304|16@1+ (0.01,-327.68) [-30|30] "deg"  DASy
 SG_ RFC_Loc077_DrVnce : 320|16@1+ (1.52588E-005,0) [0|0.999984741210937] "m^2"  DASy
 SG_ RFC_Loc077_VrVnce : 336|16@1+ (1.52588E-005,0) [0|0.999984741210937] "m^2/s^2"  DASy
 SG_ RFC_Loc077_ThetaVnce : 352|16@1+ (0.00390625,0) [0|255.99609375] "deg^2"  DASy
 SG_ RFC_Loc077_PhiVnce : 368|16@1+ (0.00390625,0) [0|255.99609375] "deg^2"  DASy
 SG_ RFC_Loc077_RCS : 400|16@1+ (0.00390625,-128) [-128|127.99609375] "dBsm"  DASy
 SG_ RFC_Loc077_RSSI : 416|16@1+ (0.00195312,0) [0|127.998046875] "dimensionless"  DASy

BO_ 439 RFC_Location_078_079: 64 RadarFrontCenter
 SG_ RFC_Loc078_CRC : 0|16@1+ (1,0) [0|65535] ""  DASy
 SG_ RFC_Loc078_AliveCtr : 16|8@1+ (1,0) [0|255] ""  DASy
 SG_ RFC_Loc078_ProtBlockCtr : 24|8@1+ (1,0) [0|255] ""  DASy
 SG_ RFC_Loc078_Dr : 32|16@1+ (0.0078125,0) [0|511.9921875] "m"  DASy
 SG_ RFC_Loc078_Vr : 48|16@1+ (0.00390625,-128) [-128|127.99609375] "m/s"  DASy
 SG_ RFC_Loc078_Theta : 64|16@1+ (0.01,-327.68) [-90|90] "deg"  DASy
 SG_ RFC_Loc078_Phi : 80|16@1+ (0.01,-327.68) [-30|30] "deg"  DASy
 SG_ RFC_Loc078_DrVnce : 96|16@1+ (1.52588E-005,0) [0|0.999984741210937] "m^2"  DASy
 SG_ RFC_Loc078_VrVnce : 112|16@1+ (1.52588E-005,0) [0|0.999984741210937] "m^2/s^2"  DASy
 SG_ RFC_Loc078_ThetaVnce : 128|16@1+ (0.00390625,0) [0|255.99609375] "deg^2"  DASy
 SG_ RFC_Loc078_PhiVnce : 144|16@1+ (0.00390625,0) [0|255.99609375] "deg^2"  DASy
 SG_ RFC_Loc078_RCS : 176|16@1+ (0.00390625,-128) [-128|127.99609375] "dBsm"  DASy
 SG_ RFC_Loc078_RSSI : 192|16@1+ (0.00195312,0) [0|127.998046875] "dimensionless"  DASy
 SG_ RFC_Loc079_Dr : 256|16@1+ (0.0078125,0) [0|511.9921875] "m"  DASy
 SG_ RFC_Loc079_Vr : 272|16@1+ (0.00390625,-128) [-128|127.99609375] "m/s"  DASy
 SG_ RFC_Loc079_Theta : 288|16@1+ (0.01,-327.68) [-90|90] "deg"  DASy
 SG_ RFC_Loc079_Phi : 304|16@1+ (0.01,-327.68) [-30|30] "deg"  DASy
 SG_ RFC_Loc079_DrVnce : 320|16@1+ (1.52588E-005,0) [0|0.999984741210937] "m^2"  DASy
 SG_ RFC_Loc079_VrVnce : 336|16@1+ (1.52588E-005,0) [0|0.999984741210937] "m^2/s^2"  DASy
 SG_ RFC_Loc079_ThetaVnce : 352|16@1+ (0.00390625,0) [0|255.99609375] "deg^2"  DASy
 SG_ RFC_Loc079_PhiVnce : 368|16@1+ (0.00390625,0) [0|255.99609375] "deg^2"  DASy
 SG_ RFC_Loc079_RCS : 400|16@1+ (0.00390625,-128) [-128|127.99609375] "dBsm"  DASy
 SG_ RFC_Loc079_RSSI : 416|16@1+ (0.00195312,0) [0|127.998046875] "dimensionless"  DASy

BO_ 440 RFC_Location_080_081: 64 RadarFrontCenter
 SG_ RFC_Loc080_CRC : 0|16@1+ (1,0) [0|65535] ""  DASy
 SG_ RFC_Loc080_AliveCtr : 16|8@1+ (1,0) [0|255] ""  DASy
 SG_ RFC_Loc080_ProtBlockCtr : 24|8@1+ (1,0) [0|255] ""  DASy
 SG_ RFC_Loc080_Dr : 32|16@1+ (0.0078125,0) [0|511.9921875] "m"  DASy
 SG_ RFC_Loc080_Vr : 48|16@1+ (0.00390625,-128) [-128|127.99609375] "m/s"  DASy
 SG_ RFC_Loc080_Theta : 64|16@1+ (0.01,-327.68) [-90|90] "deg"  DASy
 SG_ RFC_Loc080_Phi : 80|16@1+ (0.01,-327.68) [-30|30] "deg"  DASy
 SG_ RFC_Loc080_DrVnce : 96|16@1+ (1.52588E-005,0) [0|0.999984741210937] "m^2"  DASy
 SG_ RFC_Loc080_VrVnce : 112|16@1+ (1.52588E-005,0) [0|0.999984741210937] "m^2/s^2"  DASy
 SG_ RFC_Loc080_ThetaVnce : 128|16@1+ (0.00390625,0) [0|255.99609375] "deg^2"  DASy
 SG_ RFC_Loc080_PhiVnce : 144|16@1+ (0.00390625,0) [0|255.99609375] "deg^2"  DASy
 SG_ RFC_Loc080_RCS : 176|16@1+ (0.00390625,-128) [-128|127.99609375] "dBsm"  DASy
 SG_ RFC_Loc080_RSSI : 192|16@1+ (0.00195312,0) [0|127.998046875] "dimensionless"  DASy
 SG_ RFC_Loc081_Dr : 256|16@1+ (0.0078125,0) [0|511.9921875] "m"  DASy
 SG_ RFC_Loc081_Vr : 272|16@1+ (0.00390625,-128) [-128|127.99609375] "m/s"  DASy
 SG_ RFC_Loc081_Theta : 288|16@1+ (0.01,-327.68) [-90|90] "deg"  DASy
 SG_ RFC_Loc081_Phi : 304|16@1+ (0.01,-327.68) [-30|30] "deg"  DASy
 SG_ RFC_Loc081_DrVnce : 320|16@1+ (1.52588E-005,0) [0|0.999984741210937] "m^2"  DASy
 SG_ RFC_Loc081_VrVnce : 336|16@1+ (1.52588E-005,0) [0|0.999984741210937] "m^2/s^2"  DASy
 SG_ RFC_Loc081_ThetaVnce : 352|16@1+ (0.00390625,0) [0|255.99609375] "deg^2"  DASy
 SG_ RFC_Loc081_PhiVnce : 368|16@1+ (0.00390625,0) [0|255.99609375] "deg^2"  DASy
 SG_ RFC_Loc081_RCS : 400|16@1+ (0.00390625,-128) [-128|127.99609375] "dBsm"  DASy
 SG_ RFC_Loc081_RSSI : 416|16@1+ (0.00195312,0) [0|127.998046875] "dimensionless"  DASy

BO_ 441 RFC_Location_082_083: 64 RadarFrontCenter
 SG_ RFC_Loc082_CRC : 0|16@1+ (1,0) [0|65535] ""  DASy
 SG_ RFC_Loc082_AliveCtr : 16|8@1+ (1,0) [0|255] ""  DASy
 SG_ RFC_Loc082_ProtBlockCtr : 24|8@1+ (1,0) [0|255] ""  DASy
 SG_ RFC_Loc082_Dr : 32|16@1+ (0.0078125,0) [0|511.9921875] "m"  DASy
 SG_ RFC_Loc082_Vr : 48|16@1+ (0.00390625,-128) [-128|127.99609375] "m/s"  DASy
 SG_ RFC_Loc082_Theta : 64|16@1+ (0.01,-327.68) [-90|90] "deg"  DASy
 SG_ RFC_Loc082_Phi : 80|16@1+ (0.01,-327.68) [-30|30] "deg"  DASy
 SG_ RFC_Loc082_DrVnce : 96|16@1+ (1.52588E-005,0) [0|0.999984741210937] "m^2"  DASy
 SG_ RFC_Loc082_VrVnce : 112|16@1+ (1.52588E-005,0) [0|0.999984741210937] "m^2/s^2"  DASy
 SG_ RFC_Loc082_ThetaVnce : 128|16@1+ (0.00390625,0) [0|255.99609375] "deg^2"  DASy
 SG_ RFC_Loc082_PhiVnce : 144|16@1+ (0.00390625,0) [0|255.99609375] "deg^2"  DASy
 SG_ RFC_Loc082_RCS : 176|16@1+ (0.00390625,-128) [-128|127.99609375] "dBsm"  DASy
 SG_ RFC_Loc082_RSSI : 192|16@1+ (0.00195312,0) [0|127.998046875] "dimensionless"  DASy
 SG_ RFC_Loc083_Dr : 256|16@1+ (0.0078125,0) [0|511.9921875] "m"  DASy
 SG_ RFC_Loc083_Vr : 272|16@1+ (0.00390625,-128) [-128|127.99609375] "m/s"  DASy
 SG_ RFC_Loc083_Theta : 288|16@1+ (0.01,-327.68) [-90|90] "deg"  DASy
 SG_ RFC_Loc083_Phi : 304|16@1+ (0.01,-327.68) [-30|30] "deg"  DASy
 SG_ RFC_Loc083_DrVnce : 320|16@1+ (1.52588E-005,0) [0|0.999984741210937] "m^2"  DASy
 SG_ RFC_Loc083_VrVnce : 336|16@1+ (1.52588E-005,0) [0|0.999984741210937] "m^2/s^2"  DASy
 SG_ RFC_Loc083_ThetaVnce : 352|16@1+ (0.00390625,0) [0|255.99609375] "deg^2"  DASy
 SG_ RFC_Loc083_PhiVnce : 368|16@1+ (0.00390625,0) [0|255.99609375] "deg^2"  DASy
 SG_ RFC_Loc083_RCS : 400|16@1+ (0.00390625,-128) [-128|127.99609375] "dBsm"  DASy
 SG_ RFC_Loc083_RSSI : 416|16@1+ (0.00195312,0) [0|127.998046875] "dimensionless"  DASy

BO_ 442 RFC_Location_084_085: 64 RadarFrontCenter
 SG_ RFC_Loc084_CRC : 0|16@1+ (1,0) [0|65535] ""  DASy
 SG_ RFC_Loc084_AliveCtr : 16|8@1+ (1,0) [0|255] ""  DASy
 SG_ RFC_Loc084_ProtBlockCtr : 24|8@1+ (1,0) [0|255] ""  DASy
 SG_ RFC_Loc084_Dr : 32|16@1+ (0.0078125,0) [0|511.9921875] "m"  DASy
 SG_ RFC_Loc084_Vr : 48|16@1+ (0.00390625,-128) [-128|127.99609375] "m/s"  DASy
 SG_ RFC_Loc084_Theta : 64|16@1+ (0.01,-327.68) [-90|90] "deg"  DASy
 SG_ RFC_Loc084_Phi : 80|16@1+ (0.01,-327.68) [-30|30] "deg"  DASy
 SG_ RFC_Loc084_DrVnce : 96|16@1+ (1.52588E-005,0) [0|0.999984741210937] "m^2"  DASy
 SG_ RFC_Loc084_VrVnce : 112|16@1+ (1.52588E-005,0) [0|0.999984741210937] "m^2/s^2"  DASy
 SG_ RFC_Loc084_ThetaVnce : 128|16@1+ (0.00390625,0) [0|255.99609375] "deg^2"  DASy
 SG_ RFC_Loc084_PhiVnce : 144|16@1+ (0.00390625,0) [0|255.99609375] "deg^2"  DASy
 SG_ RFC_Loc084_RCS : 176|16@1+ (0.00390625,-128) [-128|127.99609375] "dBsm"  DASy
 SG_ RFC_Loc084_RSSI : 192|16@1+ (0.00195312,0) [0|127.998046875] "dimensionless"  DASy
 SG_ RFC_Loc085_Dr : 256|16@1+ (0.0078125,0) [0|511.9921875] "m"  DASy
 SG_ RFC_Loc085_Vr : 272|16@1+ (0.00390625,-128) [-128|127.99609375] "m/s"  DASy
 SG_ RFC_Loc085_Theta : 288|16@1+ (0.01,-327.68) [-90|90] "deg"  DASy
 SG_ RFC_Loc085_Phi : 304|16@1+ (0.01,-327.68) [-30|30] "deg"  DASy
 SG_ RFC_Loc085_DrVnce : 320|16@1+ (1.52588E-005,0) [0|0.999984741210937] "m^2"  DASy
 SG_ RFC_Loc085_VrVnce : 336|16@1+ (1.52588E-005,0) [0|0.999984741210937] "m^2/s^2"  DASy
 SG_ RFC_Loc085_ThetaVnce : 352|16@1+ (0.00390625,0) [0|255.99609375] "deg^2"  DASy
 SG_ RFC_Loc085_PhiVnce : 368|16@1+ (0.00390625,0) [0|255.99609375] "deg^2"  DASy
 SG_ RFC_Loc085_RCS : 400|16@1+ (0.00390625,-128) [-128|127.99609375] "dBsm"  DASy
 SG_ RFC_Loc085_RSSI : 416|16@1+ (0.00195312,0) [0|127.998046875] "dimensionless"  DASy

BO_ 443 RFC_Location_086_087: 64 RadarFrontCenter
 SG_ RFC_Loc086_CRC : 0|16@1+ (1,0) [0|65535] ""  DASy
 SG_ RFC_Loc086_AliveCtr : 16|8@1+ (1,0) [0|255] ""  DASy
 SG_ RFC_Loc086_ProtBlockCtr : 24|8@1+ (1,0) [0|255] ""  DASy
 SG_ RFC_Loc086_Dr : 32|16@1+ (0.0078125,0) [0|511.9921875] "m"  DASy
 SG_ RFC_Loc086_Vr : 48|16@1+ (0.00390625,-128) [-128|127.99609375] "m/s"  DASy
 SG_ RFC_Loc086_Theta : 64|16@1+ (0.01,-327.68) [-90|90] "deg"  DASy
 SG_ RFC_Loc086_Phi : 80|16@1+ (0.01,-327.68) [-30|30] "deg"  DASy
 SG_ RFC_Loc086_DrVnce : 96|16@1+ (1.52588E-005,0) [0|0.999984741210937] "m^2"  DASy
 SG_ RFC_Loc086_VrVnce : 112|16@1+ (1.52588E-005,0) [0|0.999984741210937] "m^2/s^2"  DASy
 SG_ RFC_Loc086_ThetaVnce : 128|16@1+ (0.00390625,0) [0|255.99609375] "deg^2"  DASy
 SG_ RFC_Loc086_PhiVnce : 144|16@1+ (0.00390625,0) [0|255.99609375] "deg^2"  DASy
 SG_ RFC_Loc086_RCS : 176|16@1+ (0.00390625,-128) [-128|127.99609375] "dBsm"  DASy
 SG_ RFC_Loc086_RSSI : 192|16@1+ (0.00195312,0) [0|127.998046875] "dimensionless"  DASy
 SG_ RFC_Loc087_Dr : 256|16@1+ (0.0078125,0) [0|511.9921875] "m"  DASy
 SG_ RFC_Loc087_Vr : 272|16@1+ (0.00390625,-128) [-128|127.99609375] "m/s"  DASy
 SG_ RFC_Loc087_Theta : 288|16@1+ (0.01,-327.68) [-90|90] "deg"  DASy
 SG_ RFC_Loc087_Phi : 304|16@1+ (0.01,-327.68) [-30|30] "deg"  DASy
 SG_ RFC_Loc087_DrVnce : 320|16@1+ (1.52588E-005,0) [0|0.999984741210937] "m^2"  DASy
 SG_ RFC_Loc087_VrVnce : 336|16@1+ (1.52588E-005,0) [0|0.999984741210937] "m^2/s^2"  DASy
 SG_ RFC_Loc087_ThetaVnce : 352|16@1+ (0.00390625,0) [0|255.99609375] "deg^2"  DASy
 SG_ RFC_Loc087_PhiVnce : 368|16@1+ (0.00390625,0) [0|255.99609375] "deg^2"  DASy
 SG_ RFC_Loc087_RCS : 400|16@1+ (0.00390625,-128) [-128|127.99609375] "dBsm"  DASy
 SG_ RFC_Loc087_RSSI : 416|16@1+ (0.00195312,0) [0|127.998046875] "dimensionless"  DASy

BO_ 444 RFC_Location_088_089: 64 RadarFrontCenter
 SG_ RFC_Loc088_CRC : 0|16@1+ (1,0) [0|65535] ""  DASy
 SG_ RFC_Loc088_AliveCtr : 16|8@1+ (1,0) [0|255] ""  DASy
 SG_ RFC_Loc088_ProtBlockCtr : 24|8@1+ (1,0) [0|255] ""  DASy
 SG_ RFC_Loc088_Dr : 32|16@1+ (0.0078125,0) [0|511.9921875] "m"  DASy
 SG_ RFC_Loc088_Vr : 48|16@1+ (0.00390625,-128) [-128|127.99609375] "m/s"  DASy
 SG_ RFC_Loc088_Theta : 64|16@1+ (0.01,-327.68) [-90|90] "deg"  DASy
 SG_ RFC_Loc088_Phi : 80|16@1+ (0.01,-327.68) [-30|30] "deg"  DASy
 SG_ RFC_Loc088_DrVnce : 96|16@1+ (1.52588E-005,0) [0|0.999984741210937] "m^2"  DASy
 SG_ RFC_Loc088_VrVnce : 112|16@1+ (1.52588E-005,0) [0|0.999984741210937] "m^2/s^2"  DASy
 SG_ RFC_Loc088_ThetaVnce : 128|16@1+ (0.00390625,0) [0|255.99609375] "deg^2"  DASy
 SG_ RFC_Loc088_PhiVnce : 144|16@1+ (0.00390625,0) [0|255.99609375] "deg^2"  DASy
 SG_ RFC_Loc088_RCS : 176|16@1+ (0.00390625,-128) [-128|127.99609375] "dBsm"  DASy
 SG_ RFC_Loc088_RSSI : 192|16@1+ (0.00195312,0) [0|127.998046875] "dimensionless"  DASy
 SG_ RFC_Loc089_Dr : 256|16@1+ (0.0078125,0) [0|511.9921875] "m"  DASy
 SG_ RFC_Loc089_Vr : 272|16@1+ (0.00390625,-128) [-128|127.99609375] "m/s"  DASy
 SG_ RFC_Loc089_Theta : 288|16@1+ (0.01,-327.68) [-90|90] "deg"  DASy
 SG_ RFC_Loc089_Phi : 304|16@1+ (0.01,-327.68) [-30|30] "deg"  DASy
 SG_ RFC_Loc089_DrVnce : 320|16@1+ (1.52588E-005,0) [0|0.999984741210937] "m^2"  DASy
 SG_ RFC_Loc089_VrVnce : 336|16@1+ (1.52588E-005,0) [0|0.999984741210937] "m^2/s^2"  DASy
 SG_ RFC_Loc089_ThetaVnce : 352|16@1+ (0.00390625,0) [0|255.99609375] "deg^2"  DASy
 SG_ RFC_Loc089_PhiVnce : 368|16@1+ (0.00390625,0) [0|255.99609375] "deg^2"  DASy
 SG_ RFC_Loc089_RCS : 400|16@1+ (0.00390625,-128) [-128|127.99609375] "dBsm"  DASy
 SG_ RFC_Loc089_RSSI : 416|16@1+ (0.00195312,0) [0|127.998046875] "dimensionless"  DASy

BO_ 445 RFC_Location_090_091: 64 RadarFrontCenter
 SG_ RFC_Loc090_CRC : 0|16@1+ (1,0) [0|65535] ""  DASy
 SG_ RFC_Loc090_AliveCtr : 16|8@1+ (1,0) [0|255] ""  DASy
 SG_ RFC_Loc090_ProtBlockCtr : 24|8@1+ (1,0) [0|255] ""  DASy
 SG_ RFC_Loc090_Dr : 32|16@1+ (0.0078125,0) [0|511.9921875] "m"  DASy
 SG_ RFC_Loc090_Vr : 48|16@1+ (0.00390625,-128) [-128|127.99609375] "m/s"  DASy
 SG_ RFC_Loc090_Theta : 64|16@1+ (0.01,-327.68) [-90|90] "deg"  DASy
 SG_ RFC_Loc090_Phi : 80|16@1+ (0.01,-327.68) [-30|30] "deg"  DASy
 SG_ RFC_Loc090_DrVnce : 96|16@1+ (1.52588E-005,0) [0|0.999984741210937] "m^2"  DASy
 SG_ RFC_Loc090_VrVnce : 112|16@1+ (1.52588E-005,0) [0|0.999984741210937] "m^2/s^2"  DASy
 SG_ RFC_Loc090_ThetaVnce : 128|16@1+ (0.00390625,0) [0|255.99609375] "deg^2"  DASy
 SG_ RFC_Loc090_PhiVnce : 144|16@1+ (0.00390625,0) [0|255.99609375] "deg^2"  DASy
 SG_ RFC_Loc090_RCS : 176|16@1+ (0.00390625,-128) [-128|127.99609375] "dBsm"  DASy
 SG_ RFC_Loc090_RSSI : 192|16@1+ (0.00195312,0) [0|127.998046875] "dimensionless"  DASy
 SG_ RFC_Loc091_Dr : 256|16@1+ (0.0078125,0) [0|511.9921875] "m"  DASy
 SG_ RFC_Loc091_Vr : 272|16@1+ (0.00390625,-128) [-128|127.99609375] "m/s"  DASy
 SG_ RFC_Loc091_Theta : 288|16@1+ (0.01,-327.68) [-90|90] "deg"  DASy
 SG_ RFC_Loc091_Phi : 304|16@1+ (0.01,-327.68) [-30|30] "deg"  DASy
 SG_ RFC_Loc091_DrVnce : 320|16@1+ (1.52588E-005,0) [0|0.999984741210937] "m^2"  DASy
 SG_ RFC_Loc091_VrVnce : 336|16@1+ (1.52588E-005,0) [0|0.999984741210937] "m^2/s^2"  DASy
 SG_ RFC_Loc091_ThetaVnce : 352|16@1+ (0.00390625,0) [0|255.99609375] "deg^2"  DASy
 SG_ RFC_Loc091_PhiVnce : 368|16@1+ (0.00390625,0) [0|255.99609375] "deg^2"  DASy
 SG_ RFC_Loc091_RCS : 400|16@1+ (0.00390625,-128) [-128|127.99609375] "dBsm"  DASy
 SG_ RFC_Loc091_RSSI : 416|16@1+ (0.00195312,0) [0|127.998046875] "dimensionless"  DASy

BO_ 446 RFC_Location_092_093: 64 RadarFrontCenter
 SG_ RFC_Loc092_CRC : 0|16@1+ (1,0) [0|65535] ""  DASy
 SG_ RFC_Loc092_AliveCtr : 16|8@1+ (1,0) [0|255] ""  DASy
 SG_ RFC_Loc092_ProtBlockCtr : 24|8@1+ (1,0) [0|255] ""  DASy
 SG_ RFC_Loc092_Dr : 32|16@1+ (0.0078125,0) [0|511.9921875] "m"  DASy
 SG_ RFC_Loc092_Vr : 48|16@1+ (0.00390625,-128) [-128|127.99609375] "m/s"  DASy
 SG_ RFC_Loc092_Theta : 64|16@1+ (0.01,-327.68) [-90|90] "deg"  DASy
 SG_ RFC_Loc092_Phi : 80|16@1+ (0.01,-327.68) [-30|30] "deg"  DASy
 SG_ RFC_Loc092_DrVnce : 96|16@1+ (1.52588E-005,0) [0|0.999984741210937] "m^2"  DASy
 SG_ RFC_Loc092_VrVnce : 112|16@1+ (1.52588E-005,0) [0|0.999984741210937] "m^2/s^2"  DASy
 SG_ RFC_Loc092_ThetaVnce : 128|16@1+ (0.00390625,0) [0|255.99609375] "deg^2"  DASy
 SG_ RFC_Loc092_PhiVnce : 144|16@1+ (0.00390625,0) [0|255.99609375] "deg^2"  DASy
 SG_ RFC_Loc092_RCS : 176|16@1+ (0.00390625,-128) [-128|127.99609375] "dBsm"  DASy
 SG_ RFC_Loc092_RSSI : 192|16@1+ (0.00195312,0) [0|127.998046875] "dimensionless"  DASy
 SG_ RFC_Loc093_Dr : 256|16@1+ (0.0078125,0) [0|511.9921875] "m"  DASy
 SG_ RFC_Loc093_Vr : 272|16@1+ (0.00390625,-128) [-128|127.99609375] "m/s"  DASy
 SG_ RFC_Loc093_Theta : 288|16@1+ (0.01,-327.68) [-90|90] "deg"  DASy
 SG_ RFC_Loc093_Phi : 304|16@1+ (0.01,-327.68) [-30|30] "deg"  DASy
 SG_ RFC_Loc093_DrVnce : 320|16@1+ (1.52588E-005,0) [0|0.999984741210937] "m^2"  DASy
 SG_ RFC_Loc093_VrVnce : 336|16@1+ (1.52588E-005,0) [0|0.999984741210937] "m^2/s^2"  DASy
 SG_ RFC_Loc093_ThetaVnce : 352|16@1+ (0.00390625,0) [0|255.99609375] "deg^2"  DASy
 SG_ RFC_Loc093_PhiVnce : 368|16@1+ (0.00390625,0) [0|255.99609375] "deg^2"  DASy
 SG_ RFC_Loc093_RCS : 400|16@1+ (0.00390625,-128) [-128|127.99609375] "dBsm"  DASy
 SG_ RFC_Loc093_RSSI : 416|16@1+ (0.00195312,0) [0|127.998046875] "dimensionless"  DASy

BO_ 447 RFC_Location_094_095: 64 RadarFrontCenter
 SG_ RFC_Loc094_CRC : 0|16@1+ (1,0) [0|65535] ""  DASy
 SG_ RFC_Loc094_AliveCtr : 16|8@1+ (1,0) [0|255] ""  DASy
 SG_ RFC_Loc094_ProtBlockCtr : 24|8@1+ (1,0) [0|255] ""  DASy
 SG_ RFC_Loc094_Dr : 32|16@1+ (0.0078125,0) [0|511.9921875] "m"  DASy
 SG_ RFC_Loc094_Vr : 48|16@1+ (0.00390625,-128) [-128|127.99609375] "m/s"  DASy
 SG_ RFC_Loc094_Theta : 64|16@1+ (0.01,-327.68) [-90|90] "deg"  DASy
 SG_ RFC_Loc094_Phi : 80|16@1+ (0.01,-327.68) [-30|30] "deg"  DASy
 SG_ RFC_Loc094_DrVnce : 96|16@1+ (1.52588E-005,0) [0|0.999984741210937] "m^2"  DASy
 SG_ RFC_Loc094_VrVnce : 112|16@1+ (1.52588E-005,0) [0|0.999984741210937] "m^2/s^2"  DASy
 SG_ RFC_Loc094_ThetaVnce : 128|16@1+ (0.00390625,0) [0|255.99609375] "deg^2"  DASy
 SG_ RFC_Loc094_PhiVnce : 144|16@1+ (0.00390625,0) [0|255.99609375] "deg^2"  DASy
 SG_ RFC_Loc094_RCS : 176|16@1+ (0.00390625,-128) [-128|127.99609375] "dBsm"  DASy
 SG_ RFC_Loc094_RSSI : 192|16@1+ (0.00195312,0) [0|127.998046875] "dimensionless"  DASy
 SG_ RFC_Loc095_Dr : 256|16@1+ (0.0078125,0) [0|511.9921875] "m"  DASy
 SG_ RFC_Loc095_Vr : 272|16@1+ (0.00390625,-128) [-128|127.99609375] "m/s"  DASy
 SG_ RFC_Loc095_Theta : 288|16@1+ (0.01,-327.68) [-90|90] "deg"  DASy
 SG_ RFC_Loc095_Phi : 304|16@1+ (0.01,-327.68) [-30|30] "deg"  DASy
 SG_ RFC_Loc095_DrVnce : 320|16@1+ (1.52588E-005,0) [0|0.999984741210937] "m^2"  DASy
 SG_ RFC_Loc095_VrVnce : 336|16@1+ (1.52588E-005,0) [0|0.999984741210937] "m^2/s^2"  DASy
 SG_ RFC_Loc095_ThetaVnce : 352|16@1+ (0.00390625,0) [0|255.99609375] "deg^2"  DASy
 SG_ RFC_Loc095_PhiVnce : 368|16@1+ (0.00390625,0) [0|255.99609375] "deg^2"  DASy
 SG_ RFC_Loc095_RCS : 400|16@1+ (0.00390625,-128) [-128|127.99609375] "dBsm"  DASy
 SG_ RFC_Loc095_RSSI : 416|16@1+ (0.00195312,0) [0|127.998046875] "dimensionless"  DASy

BO_ 448 RFC_Location_096_097: 64 RadarFrontCenter
 SG_ RFC_Loc096_CRC : 0|16@1+ (1,0) [0|65535] ""  DASy
 SG_ RFC_Loc096_AliveCtr : 16|8@1+ (1,0) [0|255] ""  DASy
 SG_ RFC_Loc096_ProtBlockCtr : 24|8@1+ (1,0) [0|255] ""  DASy
 SG_ RFC_Loc096_Dr : 32|16@1+ (0.0078125,0) [0|511.9921875] "m"  DASy
 SG_ RFC_Loc096_Vr : 48|16@1+ (0.00390625,-128) [-128|127.99609375] "m/s"  DASy
 SG_ RFC_Loc096_Theta : 64|16@1+ (0.01,-327.68) [-90|90] "deg"  DASy
 SG_ RFC_Loc096_Phi : 80|16@1+ (0.01,-327.68) [-30|30] "deg"  DASy
 SG_ RFC_Loc096_DrVnce : 96|16@1+ (1.52588E-005,0) [0|0.999984741210937] "m^2"  DASy
 SG_ RFC_Loc096_VrVnce : 112|16@1+ (1.52588E-005,0) [0|0.999984741210937] "m^2/s^2"  DASy
 SG_ RFC_Loc096_ThetaVnce : 128|16@1+ (0.00390625,0) [0|255.99609375] "deg^2"  DASy
 SG_ RFC_Loc096_PhiVnce : 144|16@1+ (0.00390625,0) [0|255.99609375] "deg^2"  DASy
 SG_ RFC_Loc096_RCS : 176|16@1+ (0.00390625,-128) [-128|127.99609375] "dBsm"  DASy
 SG_ RFC_Loc096_RSSI : 192|16@1+ (0.00195312,0) [0|127.998046875] "dimensionless"  DASy
 SG_ RFC_Loc097_Dr : 256|16@1+ (0.0078125,0) [0|511.9921875] "m"  DASy
 SG_ RFC_Loc097_Vr : 272|16@1+ (0.00390625,-128) [-128|127.99609375] "m/s"  DASy
 SG_ RFC_Loc097_Theta : 288|16@1+ (0.01,-327.68) [-90|90] "deg"  DASy
 SG_ RFC_Loc097_Phi : 304|16@1+ (0.01,-327.68) [-30|30] "deg"  DASy
 SG_ RFC_Loc097_DrVnce : 320|16@1+ (1.52588E-005,0) [0|0.999984741210937] "m^2"  DASy
 SG_ RFC_Loc097_VrVnce : 336|16@1+ (1.52588E-005,0) [0|0.999984741210937] "m^2/s^2"  DASy
 SG_ RFC_Loc097_ThetaVnce : 352|16@1+ (0.00390625,0) [0|255.99609375] "deg^2"  DASy
 SG_ RFC_Loc097_PhiVnce : 368|16@1+ (0.00390625,0) [0|255.99609375] "deg^2"  DASy
 SG_ RFC_Loc097_RCS : 400|16@1+ (0.00390625,-128) [-128|127.99609375] "dBsm"  DASy
 SG_ RFC_Loc097_RSSI : 416|16@1+ (0.00195312,0) [0|127.998046875] "dimensionless"  DASy

BO_ 449 RFC_Location_098_099: 64 RadarFrontCenter
 SG_ RFC_Loc098_CRC : 0|16@1+ (1,0) [0|65535] ""  DASy
 SG_ RFC_Loc098_AliveCtr : 16|8@1+ (1,0) [0|255] ""  DASy
 SG_ RFC_Loc098_ProtBlockCtr : 24|8@1+ (1,0) [0|255] ""  DASy
 SG_ RFC_Loc098_Dr : 32|16@1+ (0.0078125,0) [0|511.9921875] "m"  DASy
 SG_ RFC_Loc098_Vr : 48|16@1+ (0.00390625,-128) [-128|127.99609375] "m/s"  DASy
 SG_ RFC_Loc098_Theta : 64|16@1+ (0.01,-327.68) [-90|90] "deg"  DASy
 SG_ RFC_Loc098_Phi : 80|16@1+ (0.01,-327.68) [-30|30] "deg"  DASy
 SG_ RFC_Loc098_DrVnce : 96|16@1+ (1.52588E-005,0) [0|0.999984741210937] "m^2"  DASy
 SG_ RFC_Loc098_VrVnce : 112|16@1+ (1.52588E-005,0) [0|0.999984741210937] "m^2/s^2"  DASy
 SG_ RFC_Loc098_ThetaVnce : 128|16@1+ (0.00390625,0) [0|255.99609375] "deg^2"  DASy
 SG_ RFC_Loc098_PhiVnce : 144|16@1+ (0.00390625,0) [0|255.99609375] "deg^2"  DASy
 SG_ RFC_Loc098_RCS : 176|16@1+ (0.00390625,-128) [-128|127.99609375] "dBsm"  DASy
 SG_ RFC_Loc098_RSSI : 192|16@1+ (0.00195312,0) [0|127.998046875] "dimensionless"  DASy
 SG_ RFC_Loc099_Dr : 256|16@1+ (0.0078125,0) [0|511.9921875] "m"  DASy
 SG_ RFC_Loc099_Vr : 272|16@1+ (0.00390625,-128) [-128|127.99609375] "m/s"  DASy
 SG_ RFC_Loc099_Theta : 288|16@1+ (0.01,-327.68) [-90|90] "deg"  DASy
 SG_ RFC_Loc099_Phi : 304|16@1+ (0.01,-327.68) [-30|30] "deg"  DASy
 SG_ RFC_Loc099_DrVnce : 320|16@1+ (1.52588E-005,0) [0|0.999984741210937] "m^2"  DASy
 SG_ RFC_Loc099_VrVnce : 336|16@1+ (1.52588E-005,0) [0|0.999984741210937] "m^2/s^2"  DASy
 SG_ RFC_Loc099_ThetaVnce : 352|16@1+ (0.00390625,0) [0|255.99609375] "deg^2"  DASy
 SG_ RFC_Loc099_PhiVnce : 368|16@1+ (0.00390625,0) [0|255.99609375] "deg^2"  DASy
 SG_ RFC_Loc099_RCS : 400|16@1+ (0.00390625,-128) [-128|127.99609375] "dBsm"  DASy
 SG_ RFC_Loc099_RSSI : 416|16@1+ (0.00195312,0) [0|127.998046875] "dimensionless"  DASy

BO_ 450 RFC_Location_100_101: 64 RadarFrontCenter
 SG_ RFC_Loc100_CRC : 0|16@1+ (1,0) [0|65535] ""  DASy
 SG_ RFC_Loc100_AliveCtr : 16|8@1+ (1,0) [0|255] ""  DASy
 SG_ RFC_Loc100_ProtBlockCtr : 24|8@1+ (1,0) [0|255] ""  DASy
 SG_ RFC_Loc100_Dr : 32|16@1+ (0.0078125,0) [0|511.9921875] "m"  DASy
 SG_ RFC_Loc100_Vr : 48|16@1+ (0.00390625,-128) [-128|127.99609375] "m/s"  DASy
 SG_ RFC_Loc100_Theta : 64|16@1+ (0.01,-327.68) [-90|90] "deg"  DASy
 SG_ RFC_Loc100_Phi : 80|16@1+ (0.01,-327.68) [-30|30] "deg"  DASy
 SG_ RFC_Loc100_DrVnce : 96|16@1+ (1.52588E-005,0) [0|0.999984741210937] "m^2"  DASy
 SG_ RFC_Loc100_VrVnce : 112|16@1+ (1.52588E-005,0) [0|0.999984741210937] "m^2/s^2"  DASy
 SG_ RFC_Loc100_ThetaVnce : 128|16@1+ (0.00390625,0) [0|255.99609375] "deg^2"  DASy
 SG_ RFC_Loc100_PhiVnce : 144|16@1+ (0.00390625,0) [0|255.99609375] "deg^2"  DASy
 SG_ RFC_Loc100_RCS : 176|16@1+ (0.00390625,-128) [-128|127.99609375] "dBsm"  DASy
 SG_ RFC_Loc100_RSSI : 192|16@1+ (0.00195312,0) [0|127.998046875] "dimensionless"  DASy
 SG_ RFC_Loc101_Dr : 256|16@1+ (0.0078125,0) [0|511.9921875] "m"  DASy
 SG_ RFC_Loc101_Vr : 272|16@1+ (0.00390625,-128) [-128|127.99609375] "m/s"  DASy
 SG_ RFC_Loc101_Theta : 288|16@1+ (0.01,-327.68) [-90|90] "deg"  DASy
 SG_ RFC_Loc101_Phi : 304|16@1+ (0.01,-327.68) [-30|30] "deg"  DASy
 SG_ RFC_Loc101_DrVnce : 320|16@1+ (1.52588E-005,0) [0|0.999984741210937] "m^2"  DASy
 SG_ RFC_Loc101_VrVnce : 336|16@1+ (1.52588E-005,0) [0|0.999984741210937] "m^2/s^2"  DASy
 SG_ RFC_Loc101_ThetaVnce : 352|16@1+ (0.00390625,0) [0|255.99609375] "deg^2"  DASy
 SG_ RFC_Loc101_PhiVnce : 368|16@1+ (0.00390625,0) [0|255.99609375] "deg^2"  DASy
 SG_ RFC_Loc101_RCS : 400|16@1+ (0.00390625,-128) [-128|127.99609375] "dBsm"  DASy
 SG_ RFC_Loc101_RSSI : 416|16@1+ (0.00195312,0) [0|127.998046875] "dimensionless"  DASy

BO_ 451 RFC_Location_102_103: 64 RadarFrontCenter
 SG_ RFC_Loc102_CRC : 0|16@1+ (1,0) [0|65535] ""  DASy
 SG_ RFC_Loc102_AliveCtr : 16|8@1+ (1,0) [0|255] ""  DASy
 SG_ RFC_Loc102_ProtBlockCtr : 24|8@1+ (1,0) [0|255] ""  DASy
 SG_ RFC_Loc102_Dr : 32|16@1+ (0.0078125,0) [0|511.9921875] "m"  DASy
 SG_ RFC_Loc102_Vr : 48|16@1+ (0.00390625,-128) [-128|127.99609375] "m/s"  DASy
 SG_ RFC_Loc102_Theta : 64|16@1+ (0.01,-327.68) [-90|90] "deg"  DASy
 SG_ RFC_Loc102_Phi : 80|16@1+ (0.01,-327.68) [-30|30] "deg"  DASy
 SG_ RFC_Loc102_DrVnce : 96|16@1+ (1.52588E-005,0) [0|0.999984741210937] "m^2"  DASy
 SG_ RFC_Loc102_VrVnce : 112|16@1+ (1.52588E-005,0) [0|0.999984741210937] "m^2/s^2"  DASy
 SG_ RFC_Loc102_ThetaVnce : 128|16@1+ (0.00390625,0) [0|255.99609375] "deg^2"  DASy
 SG_ RFC_Loc102_PhiVnce : 144|16@1+ (0.00390625,0) [0|255.99609375] "deg^2"  DASy
 SG_ RFC_Loc102_RCS : 176|16@1+ (0.00390625,-128) [-128|127.99609375] "dBsm"  DASy
 SG_ RFC_Loc102_RSSI : 192|16@1+ (0.00195312,0) [0|127.998046875] "dimensionless"  DASy
 SG_ RFC_Loc103_Dr : 256|16@1+ (0.0078125,0) [0|511.9921875] "m"  DASy
 SG_ RFC_Loc103_Vr : 272|16@1+ (0.00390625,-128) [-128|127.99609375] "m/s"  DASy
 SG_ RFC_Loc103_Theta : 288|16@1+ (0.01,-327.68) [-90|90] "deg"  DASy
 SG_ RFC_Loc103_Phi : 304|16@1+ (0.01,-327.68) [-30|30] "deg"  DASy
 SG_ RFC_Loc103_DrVnce : 320|16@1+ (1.52588E-005,0) [0|0.999984741210937] "m^2"  DASy
 SG_ RFC_Loc103_VrVnce : 336|16@1+ (1.52588E-005,0) [0|0.999984741210937] "m^2/s^2"  DASy
 SG_ RFC_Loc103_ThetaVnce : 352|16@1+ (0.00390625,0) [0|255.99609375] "deg^2"  DASy
 SG_ RFC_Loc103_PhiVnce : 368|16@1+ (0.00390625,0) [0|255.99609375] "deg^2"  DASy
 SG_ RFC_Loc103_RCS : 400|16@1+ (0.00390625,-128) [-128|127.99609375] "dBsm"  DASy
 SG_ RFC_Loc103_RSSI : 416|16@1+ (0.00195312,0) [0|127.998046875] "dimensionless"  DASy

BO_ 452 RFC_Location_104_105: 64 RadarFrontCenter
 SG_ RFC_Loc104_CRC : 0|16@1+ (1,0) [0|65535] ""  DASy
 SG_ RFC_Loc104_AliveCtr : 16|8@1+ (1,0) [0|255] ""  DASy
 SG_ RFC_Loc104_ProtBlockCtr : 24|8@1+ (1,0) [0|255] ""  DASy
 SG_ RFC_Loc104_Dr : 32|16@1+ (0.0078125,0) [0|511.9921875] "m"  DASy
 SG_ RFC_Loc104_Vr : 48|16@1+ (0.00390625,-128) [-128|127.99609375] "m/s"  DASy
 SG_ RFC_Loc104_Theta : 64|16@1+ (0.01,-327.68) [-90|90] "deg"  DASy
 SG_ RFC_Loc104_Phi : 80|16@1+ (0.01,-327.68) [-30|30] "deg"  DASy
 SG_ RFC_Loc104_DrVnce : 96|16@1+ (1.52588E-005,0) [0|0.999984741210937] "m^2"  DASy
 SG_ RFC_Loc104_VrVnce : 112|16@1+ (1.52588E-005,0) [0|0.999984741210937] "m^2/s^2"  DASy
 SG_ RFC_Loc104_ThetaVnce : 128|16@1+ (0.00390625,0) [0|255.99609375] "deg^2"  DASy
 SG_ RFC_Loc104_PhiVnce : 144|16@1+ (0.00390625,0) [0|255.99609375] "deg^2"  DASy
 SG_ RFC_Loc104_RCS : 176|16@1+ (0.00390625,-128) [-128|127.99609375] "dBsm"  DASy
 SG_ RFC_Loc104_RSSI : 192|16@1+ (0.00195312,0) [0|127.998046875] "dimensionless"  DASy
 SG_ RFC_Loc105_Dr : 256|16@1+ (0.0078125,0) [0|511.9921875] "m"  DASy
 SG_ RFC_Loc105_Vr : 272|16@1+ (0.00390625,-128) [-128|127.99609375] "m/s"  DASy
 SG_ RFC_Loc105_Theta : 288|16@1+ (0.01,-327.68) [-90|90] "deg"  DASy
 SG_ RFC_Loc105_Phi : 304|16@1+ (0.01,-327.68) [-30|30] "deg"  DASy
 SG_ RFC_Loc105_DrVnce : 320|16@1+ (1.52588E-005,0) [0|0.999984741210937] "m^2"  DASy
 SG_ RFC_Loc105_VrVnce : 336|16@1+ (1.52588E-005,0) [0|0.999984741210937] "m^2/s^2"  DASy
 SG_ RFC_Loc105_ThetaVnce : 352|16@1+ (0.00390625,0) [0|255.99609375] "deg^2"  DASy
 SG_ RFC_Loc105_PhiVnce : 368|16@1+ (0.00390625,0) [0|255.99609375] "deg^2"  DASy
 SG_ RFC_Loc105_RCS : 400|16@1+ (0.00390625,-128) [-128|127.99609375] "dBsm"  DASy
 SG_ RFC_Loc105_RSSI : 416|16@1+ (0.00195312,0) [0|127.998046875] "dimensionless"  DASy

BO_ 453 RFC_Location_106_107: 64 RadarFrontCenter
 SG_ RFC_Loc106_CRC : 0|16@1+ (1,0) [0|65535] ""  DASy
 SG_ RFC_Loc106_AliveCtr : 16|8@1+ (1,0) [0|255] ""  DASy
 SG_ RFC_Loc106_ProtBlockCtr : 24|8@1+ (1,0) [0|255] ""  DASy
 SG_ RFC_Loc106_Dr : 32|16@1+ (0.0078125,0) [0|511.9921875] "m"  DASy
 SG_ RFC_Loc106_Vr : 48|16@1+ (0.00390625,-128) [-128|127.99609375] "m/s"  DASy
 SG_ RFC_Loc106_Theta : 64|16@1+ (0.01,-327.68) [-90|90] "deg"  DASy
 SG_ RFC_Loc106_Phi : 80|16@1+ (0.01,-327.68) [-30|30] "deg"  DASy
 SG_ RFC_Loc106_DrVnce : 96|16@1+ (1.52588E-005,0) [0|0.999984741210937] "m^2"  DASy
 SG_ RFC_Loc106_VrVnce : 112|16@1+ (1.52588E-005,0) [0|0.999984741210937] "m^2/s^2"  DASy
 SG_ RFC_Loc106_ThetaVnce : 128|16@1+ (0.00390625,0) [0|255.99609375] "deg^2"  DASy
 SG_ RFC_Loc106_PhiVnce : 144|16@1+ (0.00390625,0) [0|255.99609375] "deg^2"  DASy
 SG_ RFC_Loc106_RCS : 176|16@1+ (0.00390625,-128) [-128|127.99609375] "dBsm"  DASy
 SG_ RFC_Loc106_RSSI : 192|16@1+ (0.00195312,0) [0|127.998046875] "dimensionless"  DASy
 SG_ RFC_Loc107_Dr : 256|16@1+ (0.0078125,0) [0|511.9921875] "m"  DASy
 SG_ RFC_Loc107_Vr : 272|16@1+ (0.00390625,-128) [-128|127.99609375] "m/s"  DASy
 SG_ RFC_Loc107_Theta : 288|16@1+ (0.01,-327.68) [-90|90] "deg"  DASy
 SG_ RFC_Loc107_Phi : 304|16@1+ (0.01,-327.68) [-30|30] "deg"  DASy
 SG_ RFC_Loc107_DrVnce : 320|16@1+ (1.52588E-005,0) [0|0.999984741210937] "m^2"  DASy
 SG_ RFC_Loc107_VrVnce : 336|16@1+ (1.52588E-005,0) [0|0.999984741210937] "m^2/s^2"  DASy
 SG_ RFC_Loc107_ThetaVnce : 352|16@1+ (0.00390625,0) [0|255.99609375] "deg^2"  DASy
 SG_ RFC_Loc107_PhiVnce : 368|16@1+ (0.00390625,0) [0|255.99609375] "deg^2"  DASy
 SG_ RFC_Loc107_RCS : 400|16@1+ (0.00390625,-128) [-128|127.99609375] "dBsm"  DASy
 SG_ RFC_Loc107_RSSI : 416|16@1+ (0.00195312,0) [0|127.998046875] "dimensionless"  DASy

BO_ 454 RFC_Location_108_109: 64 RadarFrontCenter
 SG_ RFC_Loc108_CRC : 0|16@1+ (1,0) [0|65535] ""  DASy
 SG_ RFC_Loc108_AliveCtr : 16|8@1+ (1,0) [0|255] ""  DASy
 SG_ RFC_Loc108_ProtBlockCtr : 24|8@1+ (1,0) [0|255] ""  DASy
 SG_ RFC_Loc108_Dr : 32|16@1+ (0.0078125,0) [0|511.9921875] "m"  DASy
 SG_ RFC_Loc108_Vr : 48|16@1+ (0.00390625,-128) [-128|127.99609375] "m/s"  DASy
 SG_ RFC_Loc108_Theta : 64|16@1+ (0.01,-327.68) [-90|90] "deg"  DASy
 SG_ RFC_Loc108_Phi : 80|16@1+ (0.01,-327.68) [-30|30] "deg"  DASy
 SG_ RFC_Loc108_DrVnce : 96|16@1+ (1.52588E-005,0) [0|0.999984741210937] "m^2"  DASy
 SG_ RFC_Loc108_VrVnce : 112|16@1+ (1.52588E-005,0) [0|0.999984741210937] "m^2/s^2"  DASy
 SG_ RFC_Loc108_ThetaVnce : 128|16@1+ (0.00390625,0) [0|255.99609375] "deg^2"  DASy
 SG_ RFC_Loc108_PhiVnce : 144|16@1+ (0.00390625,0) [0|255.99609375] "deg^2"  DASy
 SG_ RFC_Loc108_RCS : 176|16@1+ (0.00390625,-128) [-128|127.99609375] "dBsm"  DASy
 SG_ RFC_Loc108_RSSI : 192|16@1+ (0.00195312,0) [0|127.998046875] "dimensionless"  DASy
 SG_ RFC_Loc109_Dr : 256|16@1+ (0.0078125,0) [0|511.9921875] "m"  DASy
 SG_ RFC_Loc109_Vr : 272|16@1+ (0.00390625,-128) [-128|127.99609375] "m/s"  DASy
 SG_ RFC_Loc109_Theta : 288|16@1+ (0.01,-327.68) [-90|90] "deg"  DASy
 SG_ RFC_Loc109_Phi : 304|16@1+ (0.01,-327.68) [-30|30] "deg"  DASy
 SG_ RFC_Loc109_DrVnce : 320|16@1+ (1.52588E-005,0) [0|0.999984741210937] "m^2"  DASy
 SG_ RFC_Loc109_VrVnce : 336|16@1+ (1.52588E-005,0) [0|0.999984741210937] "m^2/s^2"  DASy
 SG_ RFC_Loc109_ThetaVnce : 352|16@1+ (0.00390625,0) [0|255.99609375] "deg^2"  DASy
 SG_ RFC_Loc109_PhiVnce : 368|16@1+ (0.00390625,0) [0|255.99609375] "deg^2"  DASy
 SG_ RFC_Loc109_RCS : 400|16@1+ (0.00390625,-128) [-128|127.99609375] "dBsm"  DASy
 SG_ RFC_Loc109_RSSI : 416|16@1+ (0.00195312,0) [0|127.998046875] "dimensionless"  DASy

BO_ 455 RFC_Location_110_111: 64 RadarFrontCenter
 SG_ RFC_Loc110_CRC : 0|16@1+ (1,0) [0|65535] ""  DASy
 SG_ RFC_Loc110_AliveCtr : 16|8@1+ (1,0) [0|255] ""  DASy
 SG_ RFC_Loc110_ProtBlockCtr : 24|8@1+ (1,0) [0|255] ""  DASy
 SG_ RFC_Loc110_Dr : 32|16@1+ (0.0078125,0) [0|511.9921875] "m"  DASy
 SG_ RFC_Loc110_Vr : 48|16@1+ (0.00390625,-128) [-128|127.99609375] "m/s"  DASy
 SG_ RFC_Loc110_Theta : 64|16@1+ (0.01,-327.68) [-90|90] "deg"  DASy
 SG_ RFC_Loc110_Phi : 80|16@1+ (0.01,-327.68) [-30|30] "deg"  DASy
 SG_ RFC_Loc110_DrVnce : 96|16@1+ (1.52588E-005,0) [0|0.999984741210937] "m^2"  DASy
 SG_ RFC_Loc110_VrVnce : 112|16@1+ (1.52588E-005,0) [0|0.999984741210937] "m^2/s^2"  DASy
 SG_ RFC_Loc110_ThetaVnce : 128|16@1+ (0.00390625,0) [0|255.99609375] "deg^2"  DASy
 SG_ RFC_Loc110_PhiVnce : 144|16@1+ (0.00390625,0) [0|255.99609375] "deg^2"  DASy
 SG_ RFC_Loc110_RCS : 176|16@1+ (0.00390625,-128) [-128|127.99609375] "dBsm"  DASy
 SG_ RFC_Loc110_RSSI : 192|16@1+ (0.00195312,0) [0|127.998046875] "dimensionless"  DASy
 SG_ RFC_Loc111_Dr : 256|16@1+ (0.0078125,0) [0|511.9921875] "m"  DASy
 SG_ RFC_Loc111_Vr : 272|16@1+ (0.00390625,-128) [-128|127.99609375] "m/s"  DASy
 SG_ RFC_Loc111_Theta : 288|16@1+ (0.01,-327.68) [-90|90] "deg"  DASy
 SG_ RFC_Loc111_Phi : 304|16@1+ (0.01,-327.68) [-30|30] "deg"  DASy
 SG_ RFC_Loc111_DrVnce : 320|16@1+ (1.52588E-005,0) [0|0.999984741210937] "m^2"  DASy
 SG_ RFC_Loc111_VrVnce : 336|16@1+ (1.52588E-005,0) [0|0.999984741210937] "m^2/s^2"  DASy
 SG_ RFC_Loc111_ThetaVnce : 352|16@1+ (0.00390625,0) [0|255.99609375] "deg^2"  DASy
 SG_ RFC_Loc111_PhiVnce : 368|16@1+ (0.00390625,0) [0|255.99609375] "deg^2"  DASy
 SG_ RFC_Loc111_RCS : 400|16@1+ (0.00390625,-128) [-128|127.99609375] "dBsm"  DASy
 SG_ RFC_Loc111_RSSI : 416|16@1+ (0.00195312,0) [0|127.998046875] "dimensionless"  DASy

BO_ 456 RFC_Location_112_113: 64 RadarFrontCenter
 SG_ RFC_Loc112_CRC : 0|16@1+ (1,0) [0|65535] ""  DASy
 SG_ RFC_Loc112_AliveCtr : 16|8@1+ (1,0) [0|255] ""  DASy
 SG_ RFC_Loc112_ProtBlockCtr : 24|8@1+ (1,0) [0|255] ""  DASy
 SG_ RFC_Loc112_Dr : 32|16@1+ (0.0078125,0) [0|511.9921875] "m"  DASy
 SG_ RFC_Loc112_Vr : 48|16@1+ (0.00390625,-128) [-128|127.99609375] "m/s"  DASy
 SG_ RFC_Loc112_Theta : 64|16@1+ (0.01,-327.68) [-90|90] "deg"  DASy
 SG_ RFC_Loc112_Phi : 80|16@1+ (0.01,-327.68) [-30|30] "deg"  DASy
 SG_ RFC_Loc112_DrVnce : 96|16@1+ (1.52588E-005,0) [0|0.999984741210937] "m^2"  DASy
 SG_ RFC_Loc112_VrVnce : 112|16@1+ (1.52588E-005,0) [0|0.999984741210937] "m^2/s^2"  DASy
 SG_ RFC_Loc112_ThetaVnce : 128|16@1+ (0.00390625,0) [0|255.99609375] "deg^2"  DASy
 SG_ RFC_Loc112_PhiVnce : 144|16@1+ (0.00390625,0) [0|255.99609375] "deg^2"  DASy
 SG_ RFC_Loc112_RCS : 176|16@1+ (0.00390625,-128) [-128|127.99609375] "dBsm"  DASy
 SG_ RFC_Loc112_RSSI : 192|16@1+ (0.00195312,0) [0|127.998046875] "dimensionless"  DASy
 SG_ RFC_Loc113_Dr : 256|16@1+ (0.0078125,0) [0|511.9921875] "m"  DASy
 SG_ RFC_Loc113_Vr : 272|16@1+ (0.00390625,-128) [-128|127.99609375] "m/s"  DASy
 SG_ RFC_Loc113_Theta : 288|16@1+ (0.01,-327.68) [-90|90] "deg"  DASy
 SG_ RFC_Loc113_Phi : 304|16@1+ (0.01,-327.68) [-30|30] "deg"  DASy
 SG_ RFC_Loc113_DrVnce : 320|16@1+ (1.52588E-005,0) [0|0.999984741210937] "m^2"  DASy
 SG_ RFC_Loc113_VrVnce : 336|16@1+ (1.52588E-005,0) [0|0.999984741210937] "m^2/s^2"  DASy
 SG_ RFC_Loc113_ThetaVnce : 352|16@1+ (0.00390625,0) [0|255.99609375] "deg^2"  DASy
 SG_ RFC_Loc113_PhiVnce : 368|16@1+ (0.00390625,0) [0|255.99609375] "deg^2"  DASy
 SG_ RFC_Loc113_RCS : 400|16@1+ (0.00390625,-128) [-128|127.99609375] "dBsm"  DASy
 SG_ RFC_Loc113_RSSI : 416|16@1+ (0.00195312,0) [0|127.998046875] "dimensionless"  DASy

CM_ SG_ 428 RFC_Loc056_CRC "CRC - Autosar E2E Profile 5, DataID = TBD";
CM_ SG_ 428 RFC_Loc056_AliveCtr "Alive counter - Autosar E2E Profile 5";
CM_ SG_ 428 RFC_Loc056_ProtBlockCtr "Protocol-Signal: Block-Counter";
CM_ SG_ 428 RFC_Loc056_Dr "Location radial distance";
CM_ SG_ 428 RFC_Loc056_Vr "Location radial relative velocity";
CM_ SG_ 428 RFC_Loc056_Theta "Location azimuth angle. \"Not a number\" TBD";
CM_ SG_ 428 RFC_Loc056_Phi "Location elevation angle. \"Not a number\" TBD";
CM_ SG_ 428 RFC_Loc056_DrVnce "Variance of Location radial distance";
CM_ SG_ 428 RFC_Loc056_VrVnce "Variance of Location radial relative velocity";
CM_ SG_ 428 RFC_Loc056_ThetaVnce "Variance of Location azimuth angle";
CM_ SG_ 428 RFC_Loc056_PhiVnce "Variance of Location elevation angle";
CM_ SG_ 428 RFC_Loc056_RCS "Radar Cross Section (RCS) estimation";
CM_ SG_ 428 RFC_Loc056_RSSI "Received Signal Strength Indication (RSSI)";
CM_ SG_ 428 RFC_Loc057_Dr "Location radial distance";
CM_ SG_ 428 RFC_Loc057_Vr "Location radial relative velocity";
CM_ SG_ 428 RFC_Loc057_Theta "Location azimuth angle. \"Not a number\" TBD";
CM_ SG_ 428 RFC_Loc057_Phi "Location elevation angle. \"Not a number\" TBD";
CM_ SG_ 428 RFC_Loc057_DrVnce "Variance of Location radial distance";
CM_ SG_ 428 RFC_Loc057_VrVnce "Variance of Location radial relative velocity";
CM_ SG_ 428 RFC_Loc057_ThetaVnce "Variance of Location azimuth angle";
CM_ SG_ 428 RFC_Loc057_PhiVnce "Variance of Location elevation angle";
CM_ SG_ 428 RFC_Loc057_RCS "Radar Cross Section (RCS) estimation";
CM_ SG_ 428 RFC_Loc057_RSSI "Received Signal Strength Indication (RSSI)";
CM_ SG_ 429 RFC_Loc058_CRC "CRC - Autosar E2E Profile 5, DataID = TBD";
CM_ SG_ 429 RFC_Loc058_AliveCtr "Alive counter - Autosar E2E Profile 5";
CM_ SG_ 429 RFC_Loc058_ProtBlockCtr "Protocol-Signal: Block-Counter";
CM_ SG_ 429 RFC_Loc058_Dr "Location radial distance";
CM_ SG_ 429 RFC_Loc058_Vr "Location radial relative velocity";
CM_ SG_ 429 RFC_Loc058_Theta "Location azimuth angle. \"Not a number\" TBD";
CM_ SG_ 429 RFC_Loc058_Phi "Location elevation angle. \"Not a number\" TBD";
CM_ SG_ 429 RFC_Loc058_DrVnce "Variance of Location radial distance";
CM_ SG_ 429 RFC_Loc058_VrVnce "Variance of Location radial relative velocity";
CM_ SG_ 429 RFC_Loc058_ThetaVnce "Variance of Location azimuth angle";
CM_ SG_ 429 RFC_Loc058_PhiVnce "Variance of Location elevation angle";
CM_ SG_ 429 RFC_Loc058_RCS "Radar Cross Section (RCS) estimation";
CM_ SG_ 429 RFC_Loc058_RSSI "Received Signal Strength Indication (RSSI)";
CM_ SG_ 429 RFC_Loc059_Dr "Location radial distance";
CM_ SG_ 429 RFC_Loc059_Vr "Location radial relative velocity";
CM_ SG_ 429 RFC_Loc059_Theta "Location azimuth angle. \"Not a number\" TBD";
CM_ SG_ 429 RFC_Loc059_Phi "Location elevation angle. \"Not a number\" TBD";
CM_ SG_ 429 RFC_Loc059_DrVnce "Variance of Location radial distance";
CM_ SG_ 429 RFC_Loc059_VrVnce "Variance of Location radial relative velocity";
CM_ SG_ 429 RFC_Loc059_ThetaVnce "Variance of Location azimuth angle";
CM_ SG_ 429 RFC_Loc059_PhiVnce "Variance of Location elevation angle";
CM_ SG_ 429 RFC_Loc059_RCS "Radar Cross Section (RCS) estimation";
CM_ SG_ 429 RFC_Loc059_RSSI "Received Signal Strength Indication (RSSI)";
CM_ SG_ 430 RFC_Loc060_CRC "CRC - Autosar E2E Profile 5, DataID = TBD";
CM_ SG_ 430 RFC_Loc060_AliveCtr "Alive counter - Autosar E2E Profile 5";
CM_ SG_ 430 RFC_Loc060_ProtBlockCtr "Protocol-Signal: Block-Counter";
CM_ SG_ 430 RFC_Loc060_Dr "Location radial distance";
CM_ SG_ 430 RFC_Loc060_Vr "Location radial relative velocity";
CM_ SG_ 430 RFC_Loc060_Theta "Location azimuth angle. \"Not a number\" TBD";
CM_ SG_ 430 RFC_Loc060_Phi "Location elevation angle. \"Not a number\" TBD";
CM_ SG_ 430 RFC_Loc060_DrVnce "Variance of Location radial distance";
CM_ SG_ 430 RFC_Loc060_VrVnce "Variance of Location radial relative velocity";
CM_ SG_ 430 RFC_Loc060_ThetaVnce "Variance of Location azimuth angle";
CM_ SG_ 430 RFC_Loc060_PhiVnce "Variance of Location elevation angle";
CM_ SG_ 430 RFC_Loc060_RCS "Radar Cross Section (RCS) estimation";
CM_ SG_ 430 RFC_Loc060_RSSI "Received Signal Strength Indication (RSSI)";
CM_ SG_ 430 RFC_Loc061_Dr "Location radial distance";
CM_ SG_ 430 RFC_Loc061_Vr "Location radial relative velocity";
CM_ SG_ 430 RFC_Loc061_Theta "Location azimuth angle. \"Not a number\" TBD";
CM_ SG_ 430 RFC_Loc061_Phi "Location elevation angle. \"Not a number\" TBD";
CM_ SG_ 430 RFC_Loc061_DrVnce "Variance of Location radial distance";
CM_ SG_ 430 RFC_Loc061_VrVnce "Variance of Location radial relative velocity";
CM_ SG_ 430 RFC_Loc061_ThetaVnce "Variance of Location azimuth angle";
CM_ SG_ 430 RFC_Loc061_PhiVnce "Variance of Location elevation angle";
CM_ SG_ 430 RFC_Loc061_RCS "Radar Cross Section (RCS) estimation";
CM_ SG_ 430 RFC_Loc061_RSSI "Received Signal Strength Indication (RSSI)";
CM_ SG_ 431 RFC_Loc062_CRC "CRC - Autosar E2E Profile 5, DataID = TBD";
CM_ SG_ 431 RFC_Loc062_AliveCtr "Alive counter - Autosar E2E Profile 5";
CM_ SG_ 431 RFC_Loc062_ProtBlockCtr "Protocol-Signal: Block-Counter";
CM_ SG_ 431 RFC_Loc062_Dr "Location radial distance";
CM_ SG_ 431 RFC_Loc062_Vr "Location radial relative velocity";
CM_ SG_ 431 RFC_Loc062_Theta "Location azimuth angle. \"Not a number\" TBD";
CM_ SG_ 431 RFC_Loc062_Phi "Location elevation angle. \"Not a number\" TBD";
CM_ SG_ 431 RFC_Loc062_DrVnce "Variance of Location radial distance";
CM_ SG_ 431 RFC_Loc062_VrVnce "Variance of Location radial relative velocity";
CM_ SG_ 431 RFC_Loc062_ThetaVnce "Variance of Location azimuth angle";
CM_ SG_ 431 RFC_Loc062_PhiVnce "Variance of Location elevation angle";
CM_ SG_ 431 RFC_Loc062_RCS "Radar Cross Section (RCS) estimation";
CM_ SG_ 431 RFC_Loc062_RSSI "Received Signal Strength Indication (RSSI)";
CM_ SG_ 431 RFC_Loc063_Dr "Location radial distance";
CM_ SG_ 431 RFC_Loc063_Vr "Location radial relative velocity";
CM_ SG_ 431 RFC_Loc063_Theta "Location azimuth angle. \"Not a number\" TBD";
CM_ SG_ 431 RFC_Loc063_Phi "Location elevation angle. \"Not a number\" TBD";
CM_ SG_ 431 RFC_Loc063_DrVnce "Variance of Location radial distance";
CM_ SG_ 431 RFC_Loc063_VrVnce "Variance of Location radial relative velocity";
CM_ SG_ 431 RFC_Loc063_ThetaVnce "Variance of Location azimuth angle";
CM_ SG_ 431 RFC_Loc063_PhiVnce "Variance of Location elevation angle";
CM_ SG_ 431 RFC_Loc063_RCS "Radar Cross Section (RCS) estimation";
CM_ SG_ 431 RFC_Loc063_RSSI "Received Signal Strength Indication (RSSI)";
CM_ SG_ 432 RFC_Loc064_CRC "CRC - Autosar E2E Profile 5, DataID = TBD";
CM_ SG_ 432 RFC_Loc064_AliveCtr "Alive counter - Autosar E2E Profile 5";
CM_ SG_ 432 RFC_Loc064_ProtBlockCtr "Protocol-Signal: Block-Counter";
CM_ SG_ 432 RFC_Loc064_Dr "Location radial distance";
CM_ SG_ 432 RFC_Loc064_Vr "Location radial relative velocity";
CM_ SG_ 432 RFC_Loc064_Theta "Location azimuth angle. \"Not a number\" TBD";
CM_ SG_ 432 RFC_Loc064_Phi "Location elevation angle. \"Not a number\" TBD";
CM_ SG_ 432 RFC_Loc064_DrVnce "Variance of Location radial distance";
CM_ SG_ 432 RFC_Loc064_VrVnce "Variance of Location radial relative velocity";
CM_ SG_ 432 RFC_Loc064_ThetaVnce "Variance of Location azimuth angle";
CM_ SG_ 432 RFC_Loc064_PhiVnce "Variance of Location elevation angle";
CM_ SG_ 432 RFC_Loc064_RCS "Radar Cross Section (RCS) estimation";
CM_ SG_ 432 RFC_Loc064_RSSI "Received Signal Strength Indication (RSSI)";
CM_ SG_ 432 RFC_Loc065_Dr "Location radial distance";
CM_ SG_ 432 RFC_Loc065_Vr "Location radial relative velocity";
CM_ SG_ 432 RFC_Loc065_Theta "Location azimuth angle. \"Not a number\" TBD";
CM_ SG_ 432 RFC_Loc065_Phi "Location elevation angle. \"Not a number\" TBD";
CM_ SG_ 432 RFC_Loc065_DrVnce "Variance of Location radial distance";
CM_ SG_ 432 RFC_Loc065_VrVnce "Variance of Location radial relative velocity";
CM_ SG_ 432 RFC_Loc065_ThetaVnce "Variance of Location azimuth angle";
CM_ SG_ 432 RFC_Loc065_PhiVnce "Variance of Location elevation angle";
CM_ SG_ 432 RFC_Loc065_RCS "Radar Cross Section (RCS) estimation";
CM_ SG_ 432 RFC_Loc065_RSSI "Received Signal Strength Indication (RSSI)";
CM_ SG_ 433 RFC_Loc066_CRC "CRC - Autosar E2E Profile 5, DataID = TBD";
CM_ SG_ 433 RFC_Loc066_AliveCtr "Alive counter - Autosar E2E Profile 5";
CM_ SG_ 433 RFC_Loc066_ProtBlockCtr "Protocol-Signal: Block-Counter";
CM_ SG_ 433 RFC_Loc066_Dr "Location radial distance";
CM_ SG_ 433 RFC_Loc066_Vr "Location radial relative velocity";
CM_ SG_ 433 RFC_Loc066_Theta "Location azimuth angle. \"Not a number\" TBD";
CM_ SG_ 433 RFC_Loc066_Phi "Location elevation angle. \"Not a number\" TBD";
CM_ SG_ 433 RFC_Loc066_DrVnce "Variance of Location radial distance";
CM_ SG_ 433 RFC_Loc066_VrVnce "Variance of Location radial relative velocity";
CM_ SG_ 433 RFC_Loc066_ThetaVnce "Variance of Location azimuth angle";
CM_ SG_ 433 RFC_Loc066_PhiVnce "Variance of Location elevation angle";
CM_ SG_ 433 RFC_Loc066_RCS "Radar Cross Section (RCS) estimation";
CM_ SG_ 433 RFC_Loc066_RSSI "Received Signal Strength Indication (RSSI)";
CM_ SG_ 433 RFC_Loc067_Dr "Location radial distance";
CM_ SG_ 433 RFC_Loc067_Vr "Location radial relative velocity";
CM_ SG_ 433 RFC_Loc067_Theta "Location azimuth angle. \"Not a number\" TBD";
CM_ SG_ 433 RFC_Loc067_Phi "Location elevation angle. \"Not a number\" TBD";
CM_ SG_ 433 RFC_Loc067_DrVnce "Variance of Location radial distance";
CM_ SG_ 433 RFC_Loc067_VrVnce "Variance of Location radial relative velocity";
CM_ SG_ 433 RFC_Loc067_ThetaVnce "Variance of Location azimuth angle";
CM_ SG_ 433 RFC_Loc067_PhiVnce "Variance of Location elevation angle";
CM_ SG_ 433 RFC_Loc067_RCS "Radar Cross Section (RCS) estimation";
CM_ SG_ 433 RFC_Loc067_RSSI "Received Signal Strength Indication (RSSI)";
CM_ SG_ 434 RFC_Loc068_CRC "CRC - Autosar E2E Profile 5, DataID = TBD";
CM_ SG_ 434 RFC_Loc068_AliveCtr "Alive counter - Autosar E2E Profile 5";
CM_ SG_ 434 RFC_Loc068_ProtBlockCtr "Protocol-Signal: Block-Counter";
CM_ SG_ 434 RFC_Loc068_Dr "Location radial distance";
CM_ SG_ 434 RFC_Loc068_Vr "Location radial relative velocity";
CM_ SG_ 434 RFC_Loc068_Theta "Location azimuth angle. \"Not a number\" TBD";
CM_ SG_ 434 RFC_Loc068_Phi "Location elevation angle. \"Not a number\" TBD";
CM_ SG_ 434 RFC_Loc068_DrVnce "Variance of Location radial distance";
CM_ SG_ 434 RFC_Loc068_VrVnce "Variance of Location radial relative velocity";
CM_ SG_ 434 RFC_Loc068_ThetaVnce "Variance of Location azimuth angle";
CM_ SG_ 434 RFC_Loc068_PhiVnce "Variance of Location elevation angle";
CM_ SG_ 434 RFC_Loc068_RCS "Radar Cross Section (RCS) estimation";
CM_ SG_ 434 RFC_Loc068_RSSI "Received Signal Strength Indication (RSSI)";
CM_ SG_ 434 RFC_Loc069_Dr "Location radial distance";
CM_ SG_ 434 RFC_Loc069_Vr "Location radial relative velocity";
CM_ SG_ 434 RFC_Loc069_Theta "Location azimuth angle. \"Not a number\" TBD";
CM_ SG_ 434 RFC_Loc069_Phi "Location elevation angle. \"Not a number\" TBD";
CM_ SG_ 434 RFC_Loc069_DrVnce "Variance of Location radial distance";
CM_ SG_ 434 RFC_Loc069_VrVnce "Variance of Location radial relative velocity";
CM_ SG_ 434 RFC_Loc069_ThetaVnce "Variance of Location azimuth angle";
CM_ SG_ 434 RFC_Loc069_PhiVnce "Variance of Location elevation angle";
CM_ SG_ 434 RFC_Loc069_RCS "Radar Cross Section (RCS) estimation";
CM_ SG_ 434 RFC_Loc069_RSSI "Received Signal Strength Indication (RSSI)";
CM_ SG_ 435 RFC_Loc070_CRC "CRC - Autosar E2E Profile 5, DataID = TBD";
CM_ SG_ 435 RFC_Loc070_AliveCtr "Alive counter - Autosar E2E Profile 5";
CM_ SG_ 435 RFC_Loc070_ProtBlockCtr "Protocol-Signal: Block-Counter";
CM_ SG_ 435 RFC_Loc070_Dr "Location radial distance";
CM_ SG_ 435 RFC_Loc070_Vr "Location radial relative velocity";
CM_ SG_ 435 RFC_Loc070_Theta "Location azimuth angle. \"Not a number\" TBD";
CM_ SG_ 435 RFC_Loc070_Phi "Location elevation angle. \"Not a number\" TBD";
CM_ SG_ 435 RFC_Loc070_DrVnce "Variance of Location radial distance";
CM_ SG_ 435 RFC_Loc070_VrVnce "Variance of Location radial relative velocity";
CM_ SG_ 435 RFC_Loc070_ThetaVnce "Variance of Location azimuth angle";
CM_ SG_ 435 RFC_Loc070_PhiVnce "Variance of Location elevation angle";
CM_ SG_ 435 RFC_Loc070_RCS "Radar Cross Section (RCS) estimation";
CM_ SG_ 435 RFC_Loc070_RSSI "Received Signal Strength Indication (RSSI)";
CM_ SG_ 435 RFC_Loc071_Dr "Location radial distance";
CM_ SG_ 435 RFC_Loc071_Vr "Location radial relative velocity";
CM_ SG_ 435 RFC_Loc071_Theta "Location azimuth angle. \"Not a number\" TBD";
CM_ SG_ 435 RFC_Loc071_Phi "Location elevation angle. \"Not a number\" TBD";
CM_ SG_ 435 RFC_Loc071_DrVnce "Variance of Location radial distance";
CM_ SG_ 435 RFC_Loc071_VrVnce "Variance of Location radial relative velocity";
CM_ SG_ 435 RFC_Loc071_ThetaVnce "Variance of Location azimuth angle";
CM_ SG_ 435 RFC_Loc071_PhiVnce "Variance of Location elevation angle";
CM_ SG_ 435 RFC_Loc071_RCS "Radar Cross Section (RCS) estimation";
CM_ SG_ 435 RFC_Loc071_RSSI "Received Signal Strength Indication (RSSI)";
CM_ SG_ 436 RFC_Loc072_CRC "CRC - Autosar E2E Profile 5, DataID = TBD";
CM_ SG_ 436 RFC_Loc072_AliveCtr "Alive counter - Autosar E2E Profile 5";
CM_ SG_ 436 RFC_Loc072_ProtBlockCtr "Protocol-Signal: Block-Counter";
CM_ SG_ 436 RFC_Loc072_Dr "Location radial distance";
CM_ SG_ 436 RFC_Loc072_Vr "Location radial relative velocity";
CM_ SG_ 436 RFC_Loc072_Theta "Location azimuth angle. \"Not a number\" TBD";
CM_ SG_ 436 RFC_Loc072_Phi "Location elevation angle. \"Not a number\" TBD";
CM_ SG_ 436 RFC_Loc072_DrVnce "Variance of Location radial distance";
CM_ SG_ 436 RFC_Loc072_VrVnce "Variance of Location radial relative velocity";
CM_ SG_ 436 RFC_Loc072_ThetaVnce "Variance of Location azimuth angle";
CM_ SG_ 436 RFC_Loc072_PhiVnce "Variance of Location elevation angle";
CM_ SG_ 436 RFC_Loc072_RCS "Radar Cross Section (RCS) estimation";
CM_ SG_ 436 RFC_Loc072_RSSI "Received Signal Strength Indication (RSSI)";
CM_ SG_ 436 RFC_Loc073_Dr "Location radial distance";
CM_ SG_ 436 RFC_Loc073_Vr "Location radial relative velocity";
CM_ SG_ 436 RFC_Loc073_Theta "Location azimuth angle. \"Not a number\" TBD";
CM_ SG_ 436 RFC_Loc073_Phi "Location elevation angle. \"Not a number\" TBD";
CM_ SG_ 436 RFC_Loc073_DrVnce "Variance of Location radial distance";
CM_ SG_ 436 RFC_Loc073_VrVnce "Variance of Location radial relative velocity";
CM_ SG_ 436 RFC_Loc073_ThetaVnce "Variance of Location azimuth angle";
CM_ SG_ 436 RFC_Loc073_PhiVnce "Variance of Location elevation angle";
CM_ SG_ 436 RFC_Loc073_RCS "Radar Cross Section (RCS) estimation";
CM_ SG_ 436 RFC_Loc073_RSSI "Received Signal Strength Indication (RSSI)";
CM_ SG_ 437 RFC_Loc074_CRC "CRC - Autosar E2E Profile 5, DataID = TBD";
CM_ SG_ 437 RFC_Loc074_AliveCtr "Alive counter - Autosar E2E Profile 5";
CM_ SG_ 437 RFC_Loc074_ProtBlockCtr "Protocol-Signal: Block-Counter";
CM_ SG_ 437 RFC_Loc074_Dr "Location radial distance";
CM_ SG_ 437 RFC_Loc074_Vr "Location radial relative velocity";
CM_ SG_ 437 RFC_Loc074_Theta "Location azimuth angle. \"Not a number\" TBD";
CM_ SG_ 437 RFC_Loc074_Phi "Location elevation angle. \"Not a number\" TBD";
CM_ SG_ 437 RFC_Loc074_DrVnce "Variance of Location radial distance";
CM_ SG_ 437 RFC_Loc074_VrVnce "Variance of Location radial relative velocity";
CM_ SG_ 437 RFC_Loc074_ThetaVnce "Variance of Location azimuth angle";
CM_ SG_ 437 RFC_Loc074_PhiVnce "Variance of Location elevation angle";
CM_ SG_ 437 RFC_Loc074_RCS "Radar Cross Section (RCS) estimation";
CM_ SG_ 437 RFC_Loc074_RSSI "Received Signal Strength Indication (RSSI)";
CM_ SG_ 437 RFC_Loc075_Dr "Location radial distance";
CM_ SG_ 437 RFC_Loc075_Vr "Location radial relative velocity";
CM_ SG_ 437 RFC_Loc075_Theta "Location azimuth angle. \"Not a number\" TBD";
CM_ SG_ 437 RFC_Loc075_Phi "Location elevation angle. \"Not a number\" TBD";
CM_ SG_ 437 RFC_Loc075_DrVnce "Variance of Location radial distance";
CM_ SG_ 437 RFC_Loc075_VrVnce "Variance of Location radial relative velocity";
CM_ SG_ 437 RFC_Loc075_ThetaVnce "Variance of Location azimuth angle";
CM_ SG_ 437 RFC_Loc075_PhiVnce "Variance of Location elevation angle";
CM_ SG_ 437 RFC_Loc075_RCS "Radar Cross Section (RCS) estimation";
CM_ SG_ 437 RFC_Loc075_RSSI "Received Signal Strength Indication (RSSI)";
CM_ SG_ 438 RFC_Loc076_CRC "CRC - Autosar E2E Profile 5, DataID = TBD";
CM_ SG_ 438 RFC_Loc076_AliveCtr "Alive counter - Autosar E2E Profile 5";
CM_ SG_ 438 RFC_Loc076_ProtBlockCtr "Protocol-Signal: Block-Counter";
CM_ SG_ 438 RFC_Loc076_Dr "Location radial distance";
CM_ SG_ 438 RFC_Loc076_Vr "Location radial relative velocity";
CM_ SG_ 438 RFC_Loc076_Theta "Location azimuth angle. \"Not a number\" TBD";
CM_ SG_ 438 RFC_Loc076_Phi "Location elevation angle. \"Not a number\" TBD";
CM_ SG_ 438 RFC_Loc076_DrVnce "Variance of Location radial distance";
CM_ SG_ 438 RFC_Loc076_VrVnce "Variance of Location radial relative velocity";
CM_ SG_ 438 RFC_Loc076_ThetaVnce "Variance of Location azimuth angle";
CM_ SG_ 438 RFC_Loc076_PhiVnce "Variance of Location elevation angle";
CM_ SG_ 438 RFC_Loc076_RCS "Radar Cross Section (RCS) estimation";
CM_ SG_ 438 RFC_Loc076_RSSI "Received Signal Strength Indication (RSSI)";
CM_ SG_ 438 RFC_Loc077_Dr "Location radial distance";
CM_ SG_ 438 RFC_Loc077_Vr "Location radial relative velocity";
CM_ SG_ 438 RFC_Loc077_Theta "Location azimuth angle. \"Not a number\" TBD";
CM_ SG_ 438 RFC_Loc077_Phi "Location elevation angle. \"Not a number\" TBD";
CM_ SG_ 438 RFC_Loc077_DrVnce "Variance of Location radial distance";
CM_ SG_ 438 RFC_Loc077_VrVnce "Variance of Location radial relative velocity";
CM_ SG_ 438 RFC_Loc077_ThetaVnce "Variance of Location azimuth angle";
CM_ SG_ 438 RFC_Loc077_PhiVnce "Variance of Location elevation angle";
CM_ SG_ 438 RFC_Loc077_RCS "Radar Cross Section (RCS) estimation";
CM_ SG_ 438 RFC_Loc077_RSSI "Received Signal Strength Indication (RSSI)";
CM_ SG_ 439 RFC_Loc078_CRC "CRC - Autosar E2E Profile 5, DataID = TBD";
CM_ SG_ 439 RFC_Loc078_AliveCtr "Alive counter - Autosar E2E Profile 5";
CM_ SG_ 439 RFC_Loc078_ProtBlockCtr "Protocol-Signal: Block-Counter";
CM_ SG_ 439 RFC_Loc078_Dr "Location radial distance";
CM_ SG_ 439 RFC_Loc078_Vr "Location radial relative velocity";
CM_ SG_ 439 RFC_Loc078_Theta "Location azimuth angle. \"Not a number\" TBD";
CM_ SG_ 439 RFC_Loc078_Phi "Location elevation angle. \"Not a number\" TBD";
CM_ SG_ 439 RFC_Loc078_DrVnce "Variance of Location radial distance";
CM_ SG_ 439 RFC_Loc078_VrVnce "Variance of Location radial relative velocity";
CM_ SG_ 439 RFC_Loc078_ThetaVnce "Variance of Location azimuth angle";
CM_ SG_ 439 RFC_Loc078_PhiVnce "Variance of Location elevation angle";
CM_ SG_ 439 RFC_Loc078_RCS "Radar Cross Section (RCS) estimation";
CM_ SG_ 439 RFC_Loc078_RSSI "Received Signal Strength Indication (RSSI)";
CM_ SG_ 439 RFC_Loc079_Dr "Location radial distance";
CM_ SG_ 439 RFC_Loc079_Vr "Location radial relative velocity";
CM_ SG_ 439 RFC_Loc079_Theta "Location azimuth angle. \"Not a number\" TBD";
CM_ SG_ 439 RFC_Loc079_Phi "Location elevation angle. \"Not a number\" TBD";
CM_ SG_ 439 RFC_Loc079_DrVnce "Variance of Location radial distance";
CM_ SG_ 439 RFC_Loc079_VrVnce "Variance of Location radial relative velocity";
CM_ SG_ 439 RFC_Loc079_ThetaVnce "Variance of Location azimuth angle";
CM_ SG_ 439 RFC_Loc079_PhiVnce "Variance of Location elevation angle";
CM_ SG_ 439 RFC_Loc079_RCS "Radar Cross Section (RCS) estimation";
CM_ SG_ 439 RFC_Loc079_RSSI "Received Signal Strength Indication (RSSI)";
CM_ SG_ 440 RFC_Loc080_CRC "CRC - Autosar E2E Profile 5, DataID = TBD";
CM_ SG_ 440 RFC_Loc080_AliveCtr "Alive counter - Autosar E2E Profile 5";
CM_ SG_ 440 RFC_Loc080_ProtBlockCtr "Protocol-Signal: Block-Counter";
CM_ SG_ 440 RFC_Loc080_Dr "Location radial distance";
CM_ SG_ 440 RFC_Loc080_Vr "Location radial relative velocity";
CM_ SG_ 440 RFC_Loc080_Theta "Location azimuth angle. \"Not a number\" TBD";
CM_ SG_ 440 RFC_Loc080_Phi "Location elevation angle. \"Not a number\" TBD";
CM_ SG_ 440 RFC_Loc080_DrVnce "Variance of Location radial distance";
CM_ SG_ 440 RFC_Loc080_VrVnce "Variance of Location radial relative velocity";
CM_ SG_ 440 RFC_Loc080_ThetaVnce "Variance of Location azimuth angle";
CM_ SG_ 440 RFC_Loc080_PhiVnce "Variance of Location elevation angle";
CM_ SG_ 440 RFC_Loc080_RCS "Radar Cross Section (RCS) estimation";
CM_ SG_ 440 RFC_Loc080_RSSI "Received Signal Strength Indication (RSSI)";
CM_ SG_ 440 RFC_Loc081_Dr "Location radial distance";
CM_ SG_ 440 RFC_Loc081_Vr "Location radial relative velocity";
CM_ SG_ 440 RFC_Loc081_Theta "Location azimuth angle. \"Not a number\" TBD";
CM_ SG_ 440 RFC_Loc081_Phi "Location elevation angle. \"Not a number\" TBD";
CM_ SG_ 440 RFC_Loc081_DrVnce "Variance of Location radial distance";
CM_ SG_ 440 RFC_Loc081_VrVnce "Variance of Location radial relative velocity";
CM_ SG_ 440 RFC_Loc081_ThetaVnce "Variance of Location azimuth angle";
CM_ SG_ 440 RFC_Loc081_PhiVnce "Variance of Location elevation angle";
CM_ SG_ 440 RFC_Loc081_RCS "Radar Cross Section (RCS) estimation";
CM_ SG_ 440 RFC_Loc081_RSSI "Received Signal Strength Indication (RSSI)";
CM_ SG_ 441 RFC_Loc082_CRC "CRC - Autosar E2E Profile 5, DataID = TBD";
CM_ SG_ 441 RFC_Loc082_AliveCtr "Alive counter - Autosar E2E Profile 5";
CM_ SG_ 441 RFC_Loc082_ProtBlockCtr "Protocol-Signal: Block-Counter";
CM_ SG_ 441 RFC_Loc082_Dr "Location radial distance";
CM_ SG_ 441 RFC_Loc082_Vr "Location radial relative velocity";
CM_ SG_ 441 RFC_Loc082_Theta "Location azimuth angle. \"Not a number\" TBD";
CM_ SG_ 441 RFC_Loc082_Phi "Location elevation angle. \"Not a number\" TBD";
CM_ SG_ 441 RFC_Loc082_DrVnce "Variance of Location radial distance";
CM_ SG_ 441 RFC_Loc082_VrVnce "Variance of Location radial relative velocity";
CM_ SG_ 441 RFC_Loc082_ThetaVnce "Variance of Location azimuth angle";
CM_ SG_ 441 RFC_Loc082_PhiVnce "Variance of Location elevation angle";
CM_ SG_ 441 RFC_Loc082_RCS "Radar Cross Section (RCS) estimation";
CM_ SG_ 441 RFC_Loc082_RSSI "Received Signal Strength Indication (RSSI)";
CM_ SG_ 441 RFC_Loc083_Dr "Location radial distance";
CM_ SG_ 441 RFC_Loc083_Vr "Location radial relative velocity";
CM_ SG_ 441 RFC_Loc083_Theta "Location azimuth angle. \"Not a number\" TBD";
CM_ SG_ 441 RFC_Loc083_Phi "Location elevation angle. \"Not a number\" TBD";
CM_ SG_ 441 RFC_Loc083_DrVnce "Variance of Location radial distance";
CM_ SG_ 441 RFC_Loc083_VrVnce "Variance of Location radial relative velocity";
CM_ SG_ 441 RFC_Loc083_ThetaVnce "Variance of Location azimuth angle";
CM_ SG_ 441 RFC_Loc083_PhiVnce "Variance of Location elevation angle";
CM_ SG_ 441 RFC_Loc083_RCS "Radar Cross Section (RCS) estimation";
CM_ SG_ 441 RFC_Loc083_RSSI "Received Signal Strength Indication (RSSI)";
CM_ SG_ 442 RFC_Loc084_CRC "CRC - Autosar E2E Profile 5, DataID = TBD";
CM_ SG_ 442 RFC_Loc084_AliveCtr "Alive counter - Autosar E2E Profile 5";
CM_ SG_ 442 RFC_Loc084_ProtBlockCtr "Protocol-Signal: Block-Counter";
CM_ SG_ 442 RFC_Loc084_Dr "Location radial distance";
CM_ SG_ 442 RFC_Loc084_Vr "Location radial relative velocity";
CM_ SG_ 442 RFC_Loc084_Theta "Location azimuth angle. \"Not a number\" TBD";
CM_ SG_ 442 RFC_Loc084_Phi "Location elevation angle. \"Not a number\" TBD";
CM_ SG_ 442 RFC_Loc084_DrVnce "Variance of Location radial distance";
CM_ SG_ 442 RFC_Loc084_VrVnce "Variance of Location radial relative velocity";
CM_ SG_ 442 RFC_Loc084_ThetaVnce "Variance of Location azimuth angle";
CM_ SG_ 442 RFC_Loc084_PhiVnce "Variance of Location elevation angle";
CM_ SG_ 442 RFC_Loc084_RCS "Radar Cross Section (RCS) estimation";
CM_ SG_ 442 RFC_Loc084_RSSI "Received Signal Strength Indication (RSSI)";
CM_ SG_ 442 RFC_Loc085_Dr "Location radial distance";
CM_ SG_ 442 RFC_Loc085_Vr "Location radial relative velocity";
CM_ SG_ 442 RFC_Loc085_Theta "Location azimuth angle. \"Not a number\" TBD";
CM_ SG_ 442 RFC_Loc085_Phi "Location elevation angle. \"Not a number\" TBD";
CM_ SG_ 442 RFC_Loc085_DrVnce "Variance of Location radial distance";
CM_ SG_ 442 RFC_Loc085_VrVnce "Variance of Location radial relative velocity";
CM_ SG_ 442 RFC_Loc085_ThetaVnce "Variance of Location azimuth angle";
CM_ SG_ 442 RFC_Loc085_PhiVnce "Variance of Location elevation angle";
CM_ SG_ 442 RFC_Loc085_RCS "Radar Cross Section (RCS) estimation";
CM_ SG_ 442 RFC_Loc085_RSSI "Received Signal Strength Indication (RSSI)";
CM_ SG_ 443 RFC_Loc086_CRC "CRC - Autosar E2E Profile 5, DataID = TBD";
CM_ SG_ 443 RFC_Loc086_AliveCtr "Alive counter - Autosar E2E Profile 5";
CM_ SG_ 443 RFC_Loc086_ProtBlockCtr "Protocol-Signal: Block-Counter";
CM_ SG_ 443 RFC_Loc086_Dr "Location radial distance";
CM_ SG_ 443 RFC_Loc086_Vr "Location radial relative velocity";
CM_ SG_ 443 RFC_Loc086_Theta "Location azimuth angle. \"Not a number\" TBD";
CM_ SG_ 443 RFC_Loc086_Phi "Location elevation angle. \"Not a number\" TBD";
CM_ SG_ 443 RFC_Loc086_DrVnce "Variance of Location radial distance";
CM_ SG_ 443 RFC_Loc086_VrVnce "Variance of Location radial relative velocity";
CM_ SG_ 443 RFC_Loc086_ThetaVnce "Variance of Location azimuth angle";
CM_ SG_ 443 RFC_Loc086_PhiVnce "Variance of Location elevation angle";
CM_ SG_ 443 RFC_Loc086_RCS "Radar Cross Section (RCS) estimation";
CM_ SG_ 443 RFC_Loc086_RSSI "Received Signal Strength Indication (RSSI)";
CM_ SG_ 443 RFC_Loc087_Dr "Location radial distance";
CM_ SG_ 443 RFC_Loc087_Vr "Location radial relative velocity";
CM_ SG_ 443 RFC_Loc087_Theta "Location azimuth angle. \"Not a number\" TBD";
CM_ SG_ 443 RFC_Loc087_Phi "Location elevation angle. \"Not a number\" TBD";
CM_ SG_ 443 RFC_Loc087_DrVnce "Variance of Location radial distance";
CM_ SG_ 443 RFC_Loc087_VrVnce "Variance of Location radial relative velocity";
CM_ SG_ 443 RFC_Loc087_ThetaVnce "Variance of Location azimuth angle";
CM_ SG_ 443 RFC_Loc087_PhiVnce "Variance of Location elevation angle";
CM_ SG_ 443 RFC_Loc087_RCS "Radar Cross Section (RCS) estimation";
CM_ SG_ 443 RFC_Loc087_RSSI "Received Signal Strength Indication (RSSI)";
CM_ SG_ 444 RFC_Loc088_CRC "CRC - Autosar E2E Profile 5, DataID = TBD";
CM_ SG_ 444 RFC_Loc088_AliveCtr "Alive counter - Autosar E2E Profile 5";
CM_ SG_ 444 RFC_Loc088_ProtBlockCtr "Protocol-Signal: Block-Counter";
CM_ SG_ 444 RFC_Loc088_Dr "Location radial distance";
CM_ SG_ 444 RFC_Loc088_Vr "Location radial relative velocity";
CM_ SG_ 444 RFC_Loc088_Theta "Location azimuth angle. \"Not a number\" TBD";
CM_ SG_ 444 RFC_Loc088_Phi "Location elevation angle. \"Not a number\" TBD";
CM_ SG_ 444 RFC_Loc088_DrVnce "Variance of Location radial distance";
CM_ SG_ 444 RFC_Loc088_VrVnce "Variance of Location radial relative velocity";
CM_ SG_ 444 RFC_Loc088_ThetaVnce "Variance of Location azimuth angle";
CM_ SG_ 444 RFC_Loc088_PhiVnce "Variance of Location elevation angle";
CM_ SG_ 444 RFC_Loc088_RCS "Radar Cross Section (RCS) estimation";
CM_ SG_ 444 RFC_Loc088_RSSI "Received Signal Strength Indication (RSSI)";
CM_ SG_ 444 RFC_Loc089_Dr "Location radial distance";
CM_ SG_ 444 RFC_Loc089_Vr "Location radial relative velocity";
CM_ SG_ 444 RFC_Loc089_Theta "Location azimuth angle. \"Not a number\" TBD";
CM_ SG_ 444 RFC_Loc089_Phi "Location elevation angle. \"Not a number\" TBD";
CM_ SG_ 444 RFC_Loc089_DrVnce "Variance of Location radial distance";
CM_ SG_ 444 RFC_Loc089_VrVnce "Variance of Location radial relative velocity";
CM_ SG_ 444 RFC_Loc089_ThetaVnce "Variance of Location azimuth angle";
CM_ SG_ 444 RFC_Loc089_PhiVnce "Variance of Location elevation angle";
CM_ SG_ 444 RFC_Loc089_RCS "Radar Cross Section (RCS) estimation";
CM_ SG_ 444 RFC_Loc089_RSSI "Received Signal Strength Indication (RSSI)";
CM_ SG_ 445 RFC_Loc090_CRC "CRC - Autosar E2E Profile 5, DataID = TBD";
CM_ SG_ 445 RFC_Loc090_AliveCtr "Alive counter - Autosar E2E Profile 5";
CM_ SG_ 445 RFC_Loc090_ProtBlockCtr "Protocol-Signal: Block-Counter";
CM_ SG_ 445 RFC_Loc090_Dr "Location radial distance";
CM_ SG_ 445 RFC_Loc090_Vr "Location radial relative velocity";
CM_ SG_ 445 RFC_Loc090_Theta "Location azimuth angle. \"Not a number\" TBD";
CM_ SG_ 445 RFC_Loc090_Phi "Location elevation angle. \"Not a number\" TBD";
CM_ SG_ 445 RFC_Loc090_DrVnce "Variance of Location radial distance";
CM_ SG_ 445 RFC_Loc090_VrVnce "Variance of Location radial relative velocity";
CM_ SG_ 445 RFC_Loc090_ThetaVnce "Variance of Location azimuth angle";
CM_ SG_ 445 RFC_Loc090_PhiVnce "Variance of Location elevation angle";
CM_ SG_ 445 RFC_Loc090_RCS "Radar Cross Section (RCS) estimation";
CM_ SG_ 445 RFC_Loc090_RSSI "Received Signal Strength Indication (RSSI)";
CM_ SG_ 445 RFC_Loc091_Dr "Location radial distance";
CM_ SG_ 445 RFC_Loc091_Vr "Location radial relative velocity";
CM_ SG_ 445 RFC_Loc091_Theta "Location azimuth angle. \"Not a number\" TBD";
CM_ SG_ 445 RFC_Loc091_Phi "Location elevation angle. \"Not a number\" TBD";
CM_ SG_ 445 RFC_Loc091_DrVnce "Variance of Location radial distance";
CM_ SG_ 445 RFC_Loc091_VrVnce "Variance of Location radial relative velocity";
CM_ SG_ 445 RFC_Loc091_ThetaVnce "Variance of Location azimuth angle";
CM_ SG_ 445 RFC_Loc091_PhiVnce "Variance of Location elevation angle";
CM_ SG_ 445 RFC_Loc091_RCS "Radar Cross Section (RCS) estimation";
CM_ SG_ 445 RFC_Loc091_RSSI "Received Signal Strength Indication (RSSI)";
CM_ SG_ 446 RFC_Loc092_CRC "CRC - Autosar E2E Profile 5, DataID = TBD";
CM_ SG_ 446 RFC_Loc092_AliveCtr "Alive counter - Autosar E2E Profile 5";
CM_ SG_ 446 RFC_Loc092_ProtBlockCtr "Protocol-Signal: Block-Counter";
CM_ SG_ 446 RFC_Loc092_Dr "Location radial distance";
CM_ SG_ 446 RFC_Loc092_Vr "Location radial relative velocity";
CM_ SG_ 446 RFC_Loc092_Theta "Location azimuth angle. \"Not a number\" TBD";
CM_ SG_ 446 RFC_Loc092_Phi "Location elevation angle. \"Not a number\" TBD";
CM_ SG_ 446 RFC_Loc092_DrVnce "Variance of Location radial distance";
CM_ SG_ 446 RFC_Loc092_VrVnce "Variance of Location radial relative velocity";
CM_ SG_ 446 RFC_Loc092_ThetaVnce "Variance of Location azimuth angle";
CM_ SG_ 446 RFC_Loc092_PhiVnce "Variance of Location elevation angle";
CM_ SG_ 446 RFC_Loc092_RCS "Radar Cross Section (RCS) estimation";
CM_ SG_ 446 RFC_Loc092_RSSI "Received Signal Strength Indication (RSSI)";
CM_ SG_ 446 RFC_Loc093_Dr "Location radial distance";
CM_ SG_ 446 RFC_Loc093_Vr "Location radial relative velocity";
CM_ SG_ 446 RFC_Loc093_Theta "Location azimuth angle. \"Not a number\" TBD";
CM_ SG_ 446 RFC_Loc093_Phi "Location elevation angle. \"Not a number\" TBD";
CM_ SG_ 446 RFC_Loc093_DrVnce "Variance of Location radial distance";
CM_ SG_ 446 RFC_Loc093_VrVnce "Variance of Location radial relative velocity";
CM_ SG_ 446 RFC_Loc093_ThetaVnce "Variance of Location azimuth angle";
CM_ SG_ 446 RFC_Loc093_PhiVnce "Variance of Location elevation angle";
CM_ SG_ 446 RFC_Loc093_RCS "Radar Cross Section (RCS) estimation";
CM_ SG_ 446 RFC_Loc093_RSSI "Received Signal Strength Indication (RSSI)";
CM_ SG_ 447 RFC_Loc094_CRC "CRC - Autosar E2E Profile 5, DataID = TBD";
CM_ SG_ 447 RFC_Loc094_AliveCtr "Alive counter - Autosar E2E Profile 5";
CM_ SG_ 447 RFC_Loc094_ProtBlockCtr "Protocol-Signal: Block-Counter";
CM_ SG_ 447 RFC_Loc094_Dr "Location radial distance";
CM_ SG_ 447 RFC_Loc094_Vr "Location radial relative velocity";
CM_ SG_ 447 RFC_Loc094_Theta "Location azimuth angle. \"Not a number\" TBD";
CM_ SG_ 447 RFC_Loc094_Phi "Location elevation angle. \"Not a number\" TBD";
CM_ SG_ 447 RFC_Loc094_DrVnce "Variance of Location radial distance";
CM_ SG_ 447 RFC_Loc094_VrVnce "Variance of Location radial relative velocity";
CM_ SG_ 447 RFC_Loc094_ThetaVnce "Variance of Location azimuth angle";
CM_ SG_ 447 RFC_Loc094_PhiVnce "Variance of Location elevation angle";
CM_ SG_ 447 RFC_Loc094_RCS "Radar Cross Section (RCS) estimation";
CM_ SG_ 447 RFC_Loc094_RSSI "Received Signal Strength Indication (RSSI)";
CM_ SG_ 447 RFC_Loc095_Dr "Location radial distance";
CM_ SG_ 447 RFC_Loc095_Vr "Location radial relative velocity";
CM_ SG_ 447 RFC_Loc095_Theta "Location azimuth angle. \"Not a number\" TBD";
CM_ SG_ 447 RFC_Loc095_Phi "Location elevation angle. \"Not a number\" TBD";
CM_ SG_ 447 RFC_Loc095_DrVnce "Variance of Location radial distance";
CM_ SG_ 447 RFC_Loc095_VrVnce "Variance of Location radial relative velocity";
CM_ SG_ 447 RFC_Loc095_ThetaVnce "Variance of Location azimuth angle";
CM_ SG_ 447 RFC_Loc095_PhiVnce "Variance of Location elevation angle";
CM_ SG_ 447 RFC_Loc095_RCS "Radar Cross Section (RCS) estimation";
CM_ SG_ 447 RFC_Loc095_RSSI "Received Signal Strength Indication (RSSI)";
CM_ SG_ 448 RFC_Loc096_CRC "CRC - Autosar E2E Profile 5, DataID = TBD";
CM_ SG_ 448 RFC_Loc096_AliveCtr "Alive counter - Autosar E2E Profile 5";
CM_ SG_ 448 RFC_Loc096_ProtBlockCtr "Protocol-Signal: Block-Counter";
CM_ SG_ 448 RFC_Loc096_Dr "Location radial distance";
CM_ SG_ 448 RFC_Loc096_Vr "Location radial relative velocity";
CM_ SG_ 448 RFC_Loc096_Theta "Location azimuth angle. \"Not a number\" TBD";
CM_ SG_ 448 RFC_Loc096_Phi "Location elevation angle. \"Not a number\" TBD";
CM_ SG_ 448 RFC_Loc096_DrVnce "Variance of Location radial distance";
CM_ SG_ 448 RFC_Loc096_VrVnce "Variance of Location radial relative velocity";
CM_ SG_ 448 RFC_Loc096_ThetaVnce "Variance of Location azimuth angle";
CM_ SG_ 448 RFC_Loc096_PhiVnce "Variance of Location elevation angle";
CM_ SG_ 448 RFC_Loc096_RCS "Radar Cross Section (RCS) estimation";
CM_ SG_ 448 RFC_Loc096_RSSI "Received Signal Strength Indication (RSSI)";
CM_ SG_ 448 RFC_Loc097_Dr "Location radial distance";
CM_ SG_ 448 RFC_Loc097_Vr "Location radial relative velocity";
CM_ SG_ 448 RFC_Loc097_Theta "Location azimuth angle. \"Not a number\" TBD";
CM_ SG_ 448 RFC_Loc097_Phi "Location elevation angle. \"Not a number\" TBD";
CM_ SG_ 448 RFC_Loc097_DrVnce "Variance of Location radial distance";
CM_ SG_ 448 RFC_Loc097_VrVnce "Variance of Location radial relative velocity";
CM_ SG_ 448 RFC_Loc097_ThetaVnce "Variance of Location azimuth angle";
CM_ SG_ 448 RFC_Loc097_PhiVnce "Variance of Location elevation angle";
CM_ SG_ 448 RFC_Loc097_RCS "Radar Cross Section (RCS) estimation";
CM_ SG_ 448 RFC_Loc097_RSSI "Received Signal Strength Indication (RSSI)";
CM_ SG_ 449 RFC_Loc098_CRC "CRC - Autosar E2E Profile 5, DataID = TBD";
CM_ SG_ 449 RFC_Loc098_AliveCtr "Alive counter - Autosar E2E Profile 5";
CM_ SG_ 449 RFC_Loc098_ProtBlockCtr "Protocol-Signal: Block-Counter";
CM_ SG_ 449 RFC_Loc098_Dr "Location radial distance";
CM_ SG_ 449 RFC_Loc098_Vr "Location radial relative velocity";
CM_ SG_ 449 RFC_Loc098_Theta "Location azimuth angle. \"Not a number\" TBD";
CM_ SG_ 449 RFC_Loc098_Phi "Location elevation angle. \"Not a number\" TBD";
CM_ SG_ 449 RFC_Loc098_DrVnce "Variance of Location radial distance";
CM_ SG_ 449 RFC_Loc098_VrVnce "Variance of Location radial relative velocity";
CM_ SG_ 449 RFC_Loc098_ThetaVnce "Variance of Location azimuth angle";
CM_ SG_ 449 RFC_Loc098_PhiVnce "Variance of Location elevation angle";
CM_ SG_ 449 RFC_Loc098_RCS "Radar Cross Section (RCS) estimation";
CM_ SG_ 449 RFC_Loc098_RSSI "Received Signal Strength Indication (RSSI)";
CM_ SG_ 449 RFC_Loc099_Dr "Location radial distance";
CM_ SG_ 449 RFC_Loc099_Vr "Location radial relative velocity";
CM_ SG_ 449 RFC_Loc099_Theta "Location azimuth angle. \"Not a number\" TBD";
CM_ SG_ 449 RFC_Loc099_Phi "Location elevation angle. \"Not a number\" TBD";
CM_ SG_ 449 RFC_Loc099_DrVnce "Variance of Location radial distance";
CM_ SG_ 449 RFC_Loc099_VrVnce "Variance of Location radial relative velocity";
CM_ SG_ 449 RFC_Loc099_ThetaVnce "Variance of Location azimuth angle";
CM_ SG_ 449 RFC_Loc099_PhiVnce "Variance of Location elevation angle";
CM_ SG_ 449 RFC_Loc099_RCS "Radar Cross Section (RCS) estimation";
CM_ SG_ 449 RFC_Loc099_RSSI "Received Signal Strength Indication (RSSI)";
CM_ SG_ 450 RFC_Loc100_CRC "CRC - Autosar E2E Profile 5, DataID = TBD";
CM_ SG_ 450 RFC_Loc100_AliveCtr "Alive counter - Autosar E2E Profile 5";
CM_ SG_ 450 RFC_Loc100_ProtBlockCtr "Protocol-Signal: Block-Counter";
CM_ SG_ 450 RFC_Loc100_Dr "Location radial distance";
CM_ SG_ 450 RFC_Loc100_Vr "Location radial relative velocity";
CM_ SG_ 450 RFC_Loc100_Theta "Location azimuth angle. \"Not a number\" TBD";
CM_ SG_ 450 RFC_Loc100_Phi "Location elevation angle. \"Not a number\" TBD";
CM_ SG_ 450 RFC_Loc100_DrVnce "Variance of Location radial distance";
CM_ SG_ 450 RFC_Loc100_VrVnce "Variance of Location radial relative velocity";
CM_ SG_ 450 RFC_Loc100_ThetaVnce "Variance of Location azimuth angle";
CM_ SG_ 450 RFC_Loc100_PhiVnce "Variance of Location elevation angle";
CM_ SG_ 450 RFC_Loc100_RCS "Radar Cross Section (RCS) estimation";
CM_ SG_ 450 RFC_Loc100_RSSI "Received Signal Strength Indication (RSSI)";
CM_ SG_ 450 RFC_Loc101_Dr "Location radial distance";
CM_ SG_ 450 RFC_Loc101_Vr "Location radial relative velocity";
CM_ SG_ 450 RFC_Loc101_Theta "Location azimuth angle. \"Not a number\" TBD";
CM_ SG_ 450 RFC_Loc101_Phi "Location elevation angle. \"Not a number\" TBD";
CM_ SG_ 450 RFC_Loc101_DrVnce "Variance of Location radial distance";
CM_ SG_ 450 RFC_Loc101_VrVnce "Variance of Location radial relative velocity";
CM_ SG_ 450 RFC_Loc101_ThetaVnce "Variance of Location azimuth angle";
CM_ SG_ 450 RFC_Loc101_PhiVnce "Variance of Location elevation angle";
CM_ SG_ 450 RFC_Loc101_RCS "Radar Cross Section (RCS) estimation";
CM_ SG_ 450 RFC_Loc101_RSSI "Received Signal Strength Indication (RSSI)";
CM_ SG_ 451 RFC_Loc102_CRC "CRC - Autosar E2E Profile 5, DataID = TBD";
CM_ SG_ 451 RFC_Loc102_AliveCtr "Alive counter - Autosar E2E Profile 5";
CM_ SG_ 451 RFC_Loc102_ProtBlockCtr "Protocol-Signal: Block-Counter";
CM_ SG_ 451 RFC_Loc102_Dr "Location radial distance";
CM_ SG_ 451 RFC_Loc102_Vr "Location radial relative velocity";
CM_ SG_ 451 RFC_Loc102_Theta "Location azimuth angle. \"Not a number\" TBD";
CM_ SG_ 451 RFC_Loc102_Phi "Location elevation angle. \"Not a number\" TBD";
CM_ SG_ 451 RFC_Loc102_DrVnce "Variance of Location radial distance";
CM_ SG_ 451 RFC_Loc102_VrVnce "Variance of Location radial relative velocity";
CM_ SG_ 451 RFC_Loc102_ThetaVnce "Variance of Location azimuth angle";
CM_ SG_ 451 RFC_Loc102_PhiVnce "Variance of Location elevation angle";
CM_ SG_ 451 RFC_Loc102_RCS "Radar Cross Section (RCS) estimation";
CM_ SG_ 451 RFC_Loc102_RSSI "Received Signal Strength Indication (RSSI)";
CM_ SG_ 451 RFC_Loc103_Dr "Location radial distance";
CM_ SG_ 451 RFC_Loc103_Vr "Location radial relative velocity";
CM_ SG_ 451 RFC_Loc103_Theta "Location azimuth angle. \"Not a number\" TBD";
CM_ SG_ 451 RFC_Loc103_Phi "Location elevation angle. \"Not a number\" TBD";
CM_ SG_ 451 RFC_Loc103_DrVnce "Variance of Location radial distance";
CM_ SG_ 451 RFC_Loc103_VrVnce "Variance of Location radial relative velocity";
CM_ SG_ 451 RFC_Loc103_ThetaVnce "Variance of Location azimuth angle";
CM_ SG_ 451 RFC_Loc103_PhiVnce "Variance of Location elevation angle";
CM_ SG_ 451 RFC_Loc103_RCS "Radar Cross Section (RCS) estimation";
CM_ SG_ 451 RFC_Loc103_RSSI "Received Signal Strength Indication (RSSI)";
CM_ SG_ 452 RFC_Loc104_CRC "CRC - Autosar E2E Profile 5, DataID = TBD";
CM_ SG_ 452 RFC_Loc104_AliveCtr "Alive counter - Autosar E2E Profile 5";
CM_ SG_ 452 RFC_Loc104_ProtBlockCtr "Protocol-Signal: Block-Counter";
CM_ SG_ 452 RFC_Loc104_Dr "Location radial distance";
CM_ SG_ 452 RFC_Loc104_Vr "Location radial relative velocity";
CM_ SG_ 452 RFC_Loc104_Theta "Location azimuth angle. \"Not a number\" TBD";
CM_ SG_ 452 RFC_Loc104_Phi "Location elevation angle. \"Not a number\" TBD";
CM_ SG_ 452 RFC_Loc104_DrVnce "Variance of Location radial distance";
CM_ SG_ 452 RFC_Loc104_VrVnce "Variance of Location radial relative velocity";
CM_ SG_ 452 RFC_Loc104_ThetaVnce "Variance of Location azimuth angle";
CM_ SG_ 452 RFC_Loc104_PhiVnce "Variance of Location elevation angle";
CM_ SG_ 452 RFC_Loc104_RCS "Radar Cross Section (RCS) estimation";
CM_ SG_ 452 RFC_Loc104_RSSI "Received Signal Strength Indication (RSSI)";
CM_ SG_ 452 RFC_Loc105_Dr "Location radial distance";
CM_ SG_ 452 RFC_Loc105_Vr "Location radial relative velocity";
CM_ SG_ 452 RFC_Loc105_Theta "Location azimuth angle. \"Not a number\" TBD";
CM_ SG_ 452 RFC_Loc105_Phi "Location elevation angle. \"Not a number\" TBD";
CM_ SG_ 452 RFC_Loc105_DrVnce "Variance of Location radial distance";
CM_ SG_ 452 RFC_Loc105_VrVnce "Variance of Location radial relative velocity";
CM_ SG_ 452 RFC_Loc105_ThetaVnce "Variance of Location azimuth angle";
CM_ SG_ 452 RFC_Loc105_PhiVnce "Variance of Location elevation angle";
CM_ SG_ 452 RFC_Loc105_RCS "Radar Cross Section (RCS) estimation";
CM_ SG_ 452 RFC_Loc105_RSSI "Received Signal Strength Indication (RSSI)";
CM_ SG_ 453 RFC_Loc106_CRC "CRC - Autosar E2E Profile 5, DataID = TBD";
CM_ SG_ 453 RFC_Loc106_AliveCtr "Alive counter - Autosar E2E Profile 5";
CM_ SG_ 453 RFC_Loc106_ProtBlockCtr "Protocol-Signal: Block-Counter";
CM_ SG_ 453 RFC_Loc106_Dr "Location radial distance";
CM_ SG_ 453 RFC_Loc106_Vr "Location radial relative velocity";
CM_ SG_ 453 RFC_Loc106_Theta "Location azimuth angle. \"Not a number\" TBD";
CM_ SG_ 453 RFC_Loc106_Phi "Location elevation angle. \"Not a number\" TBD";
CM_ SG_ 453 RFC_Loc106_DrVnce "Variance of Location radial distance";
CM_ SG_ 453 RFC_Loc106_VrVnce "Variance of Location radial relative velocity";
CM_ SG_ 453 RFC_Loc106_ThetaVnce "Variance of Location azimuth angle";
CM_ SG_ 453 RFC_Loc106_PhiVnce "Variance of Location elevation angle";
CM_ SG_ 453 RFC_Loc106_RCS "Radar Cross Section (RCS) estimation";
CM_ SG_ 453 RFC_Loc106_RSSI "Received Signal Strength Indication (RSSI)";
CM_ SG_ 453 RFC_Loc107_Dr "Location radial distance";
CM_ SG_ 453 RFC_Loc107_Vr "Location radial relative velocity";
CM_ SG_ 453 RFC_Loc107_Theta "Location azimuth angle. \"Not a number\" TBD";
CM_ SG_ 453 RFC_Loc107_Phi "Location elevation angle. \"Not a number\" TBD";
CM_ SG_ 453 RFC_Loc107_DrVnce "Variance of Location radial distance";
CM_ SG_ 453 RFC_Loc107_VrVnce "Variance of Location radial relative velocity";
CM_ SG_ 453 RFC_Loc107_ThetaVnce "Variance of Location azimuth angle";
CM_ SG_ 453 RFC_Loc107_PhiVnce "Variance of Location elevation angle";
CM_ SG_ 453 RFC_Loc107_RCS "Radar Cross Section (RCS) estimation";
CM_ SG_ 453 RFC_Loc107_RSSI "Received Signal Strength Indication (RSSI)";
CM_ SG_ 454 RFC_Loc108_CRC "CRC - Autosar E2E Profile 5, DataID = TBD";
CM_ SG_ 454 RFC_Loc108_AliveCtr "Alive counter - Autosar E2E Profile 5";
CM_ SG_ 454 RFC_Loc108_ProtBlockCtr "Protocol-Signal: Block-Counter";
CM_ SG_ 454 RFC_Loc108_Dr "Location radial distance";
CM_ SG_ 454 RFC_Loc108_Vr "Location radial relative velocity";
CM_ SG_ 454 RFC_Loc108_Theta "Location azimuth angle. \"Not a number\" TBD";
CM_ SG_ 454 RFC_Loc108_Phi "Location elevation angle. \"Not a number\" TBD";
CM_ SG_ 454 RFC_Loc108_DrVnce "Variance of Location radial distance";
CM_ SG_ 454 RFC_Loc108_VrVnce "Variance of Location radial relative velocity";
CM_ SG_ 454 RFC_Loc108_ThetaVnce "Variance of Location azimuth angle";
CM_ SG_ 454 RFC_Loc108_PhiVnce "Variance of Location elevation angle";
CM_ SG_ 454 RFC_Loc108_RCS "Radar Cross Section (RCS) estimation";
CM_ SG_ 454 RFC_Loc108_RSSI "Received Signal Strength Indication (RSSI)";
CM_ SG_ 454 RFC_Loc109_Dr "Location radial distance";
CM_ SG_ 454 RFC_Loc109_Vr "Location radial relative velocity";
CM_ SG_ 454 RFC_Loc109_Theta "Location azimuth angle. \"Not a number\" TBD";
CM_ SG_ 454 RFC_Loc109_Phi "Location elevation angle. \"Not a number\" TBD";
CM_ SG_ 454 RFC_Loc109_DrVnce "Variance of Location radial distance";
CM_ SG_ 454 RFC_Loc109_VrVnce "Variance of Location radial relative velocity";
CM_ SG_ 454 RFC_Loc109_ThetaVnce "Variance of Location azimuth angle";
CM_ SG_ 454 RFC_Loc109_PhiVnce "Variance of Location elevation angle";
CM_ SG_ 454 RFC_Loc109_RCS "Radar Cross Section (RCS) estimation";
CM_ SG_ 454 RFC_Loc109_RSSI "Received Signal Strength Indication (RSSI)";
CM_ SG_ 455 RFC_Loc110_CRC "CRC - Autosar E2E Profile 5, DataID = TBD";
CM_ SG_ 455 RFC_Loc110_AliveCtr "Alive counter - Autosar E2E Profile 5";
CM_ SG_ 455 RFC_Loc110_ProtBlockCtr "Protocol-Signal: Block-Counter";
CM_ SG_ 455 RFC_Loc110_Dr "Location radial distance";
CM_ SG_ 455 RFC_Loc110_Vr "Location radial relative velocity";
CM_ SG_ 455 RFC_Loc110_Theta "Location azimuth angle. \"Not a number\" TBD";
CM_ SG_ 455 RFC_Loc110_Phi "Location elevation angle. \"Not a number\" TBD";
CM_ SG_ 455 RFC_Loc110_DrVnce "Variance of Location radial distance";
CM_ SG_ 455 RFC_Loc110_VrVnce "Variance of Location radial relative velocity";
CM_ SG_ 455 RFC_Loc110_ThetaVnce "Variance of Location azimuth angle";
CM_ SG_ 455 RFC_Loc110_PhiVnce "Variance of Location elevation angle";
CM_ SG_ 455 RFC_Loc110_RCS "Radar Cross Section (RCS) estimation";
CM_ SG_ 455 RFC_Loc110_RSSI "Received Signal Strength Indication (RSSI)";
CM_ SG_ 455 RFC_Loc111_Dr "Location radial distance";
CM_ SG_ 455 RFC_Loc111_Vr "Location radial relative velocity";
CM_ SG_ 455 RFC_Loc111_Theta "Location azimuth angle. \"Not a number\" TBD";
CM_ SG_ 455 RFC_Loc111_Phi "Location elevation angle. \"Not a number\" TBD";
CM_ SG_ 455 RFC_Loc111_DrVnce "Variance of Location radial distance";
CM_ SG_ 455 RFC_Loc111_VrVnce "Variance of Location radial relative velocity";
CM_ SG_ 455 RFC_Loc111_ThetaVnce "Variance of Location azimuth angle";
CM_ SG_ 455 RFC_Loc111_PhiVnce "Variance of Location elevation angle";
CM_ SG_ 455 RFC_Loc111_RCS "Radar Cross Section (RCS) estimation";
CM_ SG_ 455 RFC_Loc111_RSSI "Received Signal Strength Indication (RSSI)";
CM_ SG_ 456 RFC_Loc112_CRC "CRC - Autosar E2E Profile 5, DataID = TBD";
CM_ SG_ 456 RFC_Loc112_AliveCtr "Alive counter - Autosar E2E Profile 5";
CM_ SG_ 456 RFC_Loc112_ProtBlockCtr "Protocol-Signal: Block-Counter";
CM_ SG_ 456 RFC_Loc112_Dr "Location radial distance";
CM_ SG_ 456 RFC_Loc112_Vr "Location radial relative velocity";
CM_ SG_ 456 RFC_Loc112_Theta "Location azimuth angle. \"Not a number\" TBD";
CM_ SG_ 456 RFC_Loc112_Phi "Location elevation angle. \"Not a number\" TBD";
CM_ SG_ 456 RFC_Loc112_DrVnce "Variance of Location radial distance";
CM_ SG_ 456 RFC_Loc112_VrVnce "Variance of Location radial relative velocity";
CM_ SG_ 456 RFC_Loc112_ThetaVnce "Variance of Location azimuth angle";
CM_ SG_ 456 RFC_Loc112_PhiVnce "Variance of Location elevation angle";
CM_ SG_ 456 RFC_Loc112_RCS "Radar Cross Section (RCS) estimation";
CM_ SG_ 456 RFC_Loc112_RSSI "Received Signal Strength Indication (RSSI)";
CM_ SG_ 456 RFC_Loc113_Dr "Location radial distance";
CM_ SG_ 456 RFC_Loc113_Vr "Location radial relative velocity";
CM_ SG_ 456 RFC_Loc113_Theta "Location azimuth angle. \"Not a number\" TBD";
CM_ SG_ 456 RFC_Loc113_Phi "Location elevation angle. \"Not a number\" TBD";
CM_ SG_ 456 RFC_Loc113_DrVnce "Variance of Location radial distance";
CM_ SG_ 456 RFC_Loc113_VrVnce "Variance of Location radial relative velocity";
CM_ SG_ 456 RFC_Loc113_ThetaVnce "Variance of Location azimuth angle";
CM_ SG_ 456 RFC_Loc113_PhiVnce "Variance of Location elevation angle";
CM_ SG_ 456 RFC_Loc113_RCS "Radar Cross Section (RCS) estimation";
CM_ SG_ 456 RFC_Loc113_RSSI "Received Signal Strength Indication (RSSI)";
BA_DEF_ BO_  "GenMsgSendType" ENUM  "cyclic","NoMsgSendType","IfActive","Event","CA","CE";
BA_DEF_ BO_  "GenMsgCycleTime" INT 0 0;
BA_DEF_ SG_  "GenSigSendType" ENUM  "cyclic","OnChange","OnWrite","IfActive","OnChangeWithRepetition","OnWriteWithRepetition","IfActiveWithRepetition","CA","CE","Event";
BA_DEF_ SG_  "GenSigStartValue" INT 0 0;
BA_DEF_ BO_  "CANFD_BRS" ENUM  "0","1";
BA_DEF_ BO_  "VFrameFormat" ENUM  "StandardCAN","ExtendedCAN","reserved","reserved","reserved","reserved","reserved","reserved","reserved","reserved","reserved","reserved","reserved","reserved","StandardCAN_FD","ExtendedCAN_FD";
BA_DEF_ BO_  "GenMsgILSupport" ENUM  "No","Yes";
BA_DEF_DEF_  "GenMsgSendType" "cyclic";
BA_DEF_DEF_  "GenMsgCycleTime" 0;
BA_DEF_DEF_  "GenSigSendType" "cyclic";
BA_DEF_DEF_  "GenSigStartValue" 0;
BA_DEF_DEF_  "CANFD_BRS" "1";
BA_DEF_DEF_  "VFrameFormat" "";
BA_DEF_DEF_  "GenMsgILSupport" "Yes";
BA_ "GenMsgSendType" BO_ 428 3;
BA_ "VFrameFormat" BO_ 428 14;
BA_ "GenMsgSendType" BO_ 429 3;
BA_ "VFrameFormat" BO_ 429 14;
BA_ "GenMsgSendType" BO_ 430 3;
BA_ "VFrameFormat" BO_ 430 14;
BA_ "GenMsgSendType" BO_ 431 3;
BA_ "VFrameFormat" BO_ 431 14;
BA_ "GenMsgSendType" BO_ 432 3;
BA_ "VFrameFormat" BO_ 432 14;
BA_ "GenMsgSendType" BO_ 433 3;
BA_ "VFrameFormat" BO_ 433 14;
BA_ "GenMsgSendType" BO_ 434 3;
BA_ "VFrameFormat" BO_ 434 14;
BA_ "GenMsgSendType" BO_ 435 3;
BA_ "VFrameFormat" BO_ 435 14;
BA_ "GenMsgSendType" BO_ 436 3;
BA_ "VFrameFormat" BO_ 436 14;
BA_ "GenMsgSendType" BO_ 437 3;
BA_ "VFrameFormat" BO_ 437 14;
BA_ "GenMsgSendType" BO_ 438 3;
BA_ "VFrameFormat" BO_ 438 14;
BA_ "GenMsgSendType" BO_ 439 3;
BA_ "VFrameFormat" BO_ 439 14;
BA_ "GenMsgSendType" BO_ 440 3;
BA_ "VFrameFormat" BO_ 440 14;
BA_ "GenMsgSendType" BO_ 441 3;
BA_ "VFrameFormat" BO_ 441 14;
BA_ "GenMsgSendType" BO_ 442 3;
BA_ "VFrameFormat" BO_ 442 14;
BA_ "GenMsgSendType" BO_ 443 3;
BA_ "VFrameFormat" BO_ 443 14;
BA_ "GenMsgSendType" BO_ 444 3;
BA_ "VFrameFormat" BO_ 444 14;
BA_ "GenMsgSendType" BO_ 445 3;
BA_ "VFrameFormat" BO_ 445 14;
BA_ "GenMsgSendType" BO_ 446 3;
BA_ "VFrameFormat" BO_ 446 14;
BA_ "GenMsgSendType" BO_ 447 3;
BA_ "VFrameFormat" BO_ 447 14;
BA_ "GenMsgSendType" BO_ 448 3;
BA_ "VFrameFormat" BO_ 448 14;
BA_ "GenMsgSendType" BO_ 449 3;
BA_ "VFrameFormat" BO_ 449 14;
BA_ "GenMsgSendType" BO_ 450 3;
BA_ "VFrameFormat" BO_ 450 14;
BA_ "GenMsgSendType" BO_ 451 3;
BA_ "VFrameFormat" BO_ 451 14;
BA_ "GenMsgSendType" BO_ 452 3;
BA_ "VFrameFormat" BO_ 452 14;
BA_ "GenMsgSendType" BO_ 453 3;
BA_ "VFrameFormat" BO_ 453 14;
BA_ "GenMsgSendType" BO_ 454 3;
BA_ "VFrameFormat" BO_ 454 14;
BA_ "GenMsgSendType" BO_ 455 3;
BA_ "VFrameFormat" BO_ 455 14;
BA_ "GenMsgSendType" BO_ 456 3;
BA_ "VFrameFormat" BO_ 456 14;
BA_ "GenSigSendType" SG_ 428 RFC_Loc056_CRC 9;
BA_ "GenSigSendType" SG_ 428 RFC_Loc056_AliveCtr 9;
BA_ "GenSigSendType" SG_ 428 RFC_Loc056_ProtBlockCtr 9;
BA_ "GenSigSendType" SG_ 428 RFC_Loc056_Dr 9;
BA_ "GenSigSendType" SG_ 428 RFC_Loc056_Vr 9;
BA_ "GenSigStartValue" SG_ 428 RFC_Loc056_Vr 32768;
BA_ "GenSigSendType" SG_ 428 RFC_Loc056_Theta 9;
BA_ "GenSigStartValue" SG_ 428 RFC_Loc056_Theta 32768;
BA_ "GenSigSendType" SG_ 428 RFC_Loc056_Phi 9;
BA_ "GenSigStartValue" SG_ 428 RFC_Loc056_Phi 32768;
BA_ "GenSigSendType" SG_ 428 RFC_Loc056_DrVnce 9;
BA_ "GenSigSendType" SG_ 428 RFC_Loc056_VrVnce 9;
BA_ "GenSigSendType" SG_ 428 RFC_Loc056_ThetaVnce 9;
BA_ "GenSigSendType" SG_ 428 RFC_Loc056_PhiVnce 9;
BA_ "GenSigSendType" SG_ 428 RFC_Loc056_RCS 9;
BA_ "GenSigStartValue" SG_ 428 RFC_Loc056_RCS 32768;
BA_ "GenSigSendType" SG_ 428 RFC_Loc056_RSSI 9;
BA_ "GenSigSendType" SG_ 428 RFC_Loc057_Dr 9;
BA_ "GenSigSendType" SG_ 428 RFC_Loc057_Vr 9;
BA_ "GenSigStartValue" SG_ 428 RFC_Loc057_Vr 32768;
BA_ "GenSigSendType" SG_ 428 RFC_Loc057_Theta 9;
BA_ "GenSigStartValue" SG_ 428 RFC_Loc057_Theta 32768;
BA_ "GenSigSendType" SG_ 428 RFC_Loc057_Phi 9;
BA_ "GenSigStartValue" SG_ 428 RFC_Loc057_Phi 32768;
BA_ "GenSigSendType" SG_ 428 RFC_Loc057_DrVnce 9;
BA_ "GenSigSendType" SG_ 428 RFC_Loc057_VrVnce 9;
BA_ "GenSigSendType" SG_ 428 RFC_Loc057_ThetaVnce 9;
BA_ "GenSigSendType" SG_ 428 RFC_Loc057_PhiVnce 9;
BA_ "GenSigSendType" SG_ 428 RFC_Loc057_RCS 9;
BA_ "GenSigStartValue" SG_ 428 RFC_Loc057_RCS 32768;
BA_ "GenSigSendType" SG_ 428 RFC_Loc057_RSSI 9;
BA_ "GenSigSendType" SG_ 429 RFC_Loc058_CRC 9;
BA_ "GenSigSendType" SG_ 429 RFC_Loc058_AliveCtr 9;
BA_ "GenSigSendType" SG_ 429 RFC_Loc058_ProtBlockCtr 9;
BA_ "GenSigSendType" SG_ 429 RFC_Loc058_Dr 9;
BA_ "GenSigSendType" SG_ 429 RFC_Loc058_Vr 9;
BA_ "GenSigStartValue" SG_ 429 RFC_Loc058_Vr 32768;
BA_ "GenSigSendType" SG_ 429 RFC_Loc058_Theta 9;
BA_ "GenSigStartValue" SG_ 429 RFC_Loc058_Theta 32768;
BA_ "GenSigSendType" SG_ 429 RFC_Loc058_Phi 9;
BA_ "GenSigStartValue" SG_ 429 RFC_Loc058_Phi 32768;
BA_ "GenSigSendType" SG_ 429 RFC_Loc058_DrVnce 9;
BA_ "GenSigSendType" SG_ 429 RFC_Loc058_VrVnce 9;
BA_ "GenSigSendType" SG_ 429 RFC_Loc058_ThetaVnce 9;
BA_ "GenSigSendType" SG_ 429 RFC_Loc058_PhiVnce 9;
BA_ "GenSigSendType" SG_ 429 RFC_Loc058_RCS 9;
BA_ "GenSigStartValue" SG_ 429 RFC_Loc058_RCS 32768;
BA_ "GenSigSendType" SG_ 429 RFC_Loc058_RSSI 9;
BA_ "GenSigSendType" SG_ 429 RFC_Loc059_Dr 9;
BA_ "GenSigSendType" SG_ 429 RFC_Loc059_Vr 9;
BA_ "GenSigStartValue" SG_ 429 RFC_Loc059_Vr 32768;
BA_ "GenSigSendType" SG_ 429 RFC_Loc059_Theta 9;
BA_ "GenSigStartValue" SG_ 429 RFC_Loc059_Theta 32768;
BA_ "GenSigSendType" SG_ 429 RFC_Loc059_Phi 9;
BA_ "GenSigStartValue" SG_ 429 RFC_Loc059_Phi 32768;
BA_ "GenSigSendType" SG_ 429 RFC_Loc059_DrVnce 9;
BA_ "GenSigSendType" SG_ 429 RFC_Loc059_VrVnce 9;
BA_ "GenSigSendType" SG_ 429 RFC_Loc059_ThetaVnce 9;
BA_ "GenSigSendType" SG_ 429 RFC_Loc059_PhiVnce 9;
BA_ "GenSigSendType" SG_ 429 RFC_Loc059_RCS 9;
BA_ "GenSigStartValue" SG_ 429 RFC_Loc059_RCS 32768;
BA_ "GenSigSendType" SG_ 429 RFC_Loc059_RSSI 9;
BA_ "GenSigSendType" SG_ 430 RFC_Loc060_CRC 9;
BA_ "GenSigSendType" SG_ 430 RFC_Loc060_AliveCtr 9;
BA_ "GenSigSendType" SG_ 430 RFC_Loc060_ProtBlockCtr 9;
BA_ "GenSigSendType" SG_ 430 RFC_Loc060_Dr 9;
BA_ "GenSigSendType" SG_ 430 RFC_Loc060_Vr 9;
BA_ "GenSigStartValue" SG_ 430 RFC_Loc060_Vr 32768;
BA_ "GenSigSendType" SG_ 430 RFC_Loc060_Theta 9;
BA_ "GenSigStartValue" SG_ 430 RFC_Loc060_Theta 32768;
BA_ "GenSigSendType" SG_ 430 RFC_Loc060_Phi 9;
BA_ "GenSigStartValue" SG_ 430 RFC_Loc060_Phi 32768;
BA_ "GenSigSendType" SG_ 430 RFC_Loc060_DrVnce 9;
BA_ "GenSigSendType" SG_ 430 RFC_Loc060_VrVnce 9;
BA_ "GenSigSendType" SG_ 430 RFC_Loc060_ThetaVnce 9;
BA_ "GenSigSendType" SG_ 430 RFC_Loc060_PhiVnce 9;
BA_ "GenSigSendType" SG_ 430 RFC_Loc060_RCS 9;
BA_ "GenSigStartValue" SG_ 430 RFC_Loc060_RCS 32768;
BA_ "GenSigSendType" SG_ 430 RFC_Loc060_RSSI 9;
BA_ "GenSigSendType" SG_ 430 RFC_Loc061_Dr 9;
BA_ "GenSigSendType" SG_ 430 RFC_Loc061_Vr 9;
BA_ "GenSigStartValue" SG_ 430 RFC_Loc061_Vr 32768;
BA_ "GenSigSendType" SG_ 430 RFC_Loc061_Theta 9;
BA_ "GenSigStartValue" SG_ 430 RFC_Loc061_Theta 32768;
BA_ "GenSigSendType" SG_ 430 RFC_Loc061_Phi 9;
BA_ "GenSigStartValue" SG_ 430 RFC_Loc061_Phi 32768;
BA_ "GenSigSendType" SG_ 430 RFC_Loc061_DrVnce 9;
BA_ "GenSigSendType" SG_ 430 RFC_Loc061_VrVnce 9;
BA_ "GenSigSendType" SG_ 430 RFC_Loc061_ThetaVnce 9;
BA_ "GenSigSendType" SG_ 430 RFC_Loc061_PhiVnce 9;
BA_ "GenSigSendType" SG_ 430 RFC_Loc061_RCS 9;
BA_ "GenSigStartValue" SG_ 430 RFC_Loc061_RCS 32768;
BA_ "GenSigSendType" SG_ 430 RFC_Loc061_RSSI 9;
BA_ "GenSigSendType" SG_ 431 RFC_Loc062_CRC 9;
BA_ "GenSigSendType" SG_ 431 RFC_Loc062_AliveCtr 9;
BA_ "GenSigSendType" SG_ 431 RFC_Loc062_ProtBlockCtr 9;
BA_ "GenSigSendType" SG_ 431 RFC_Loc062_Dr 9;
BA_ "GenSigSendType" SG_ 431 RFC_Loc062_Vr 9;
BA_ "GenSigStartValue" SG_ 431 RFC_Loc062_Vr 32768;
BA_ "GenSigSendType" SG_ 431 RFC_Loc062_Theta 9;
BA_ "GenSigStartValue" SG_ 431 RFC_Loc062_Theta 32768;
BA_ "GenSigSendType" SG_ 431 RFC_Loc062_Phi 9;
BA_ "GenSigStartValue" SG_ 431 RFC_Loc062_Phi 32768;
BA_ "GenSigSendType" SG_ 431 RFC_Loc062_DrVnce 9;
BA_ "GenSigSendType" SG_ 431 RFC_Loc062_VrVnce 9;
BA_ "GenSigSendType" SG_ 431 RFC_Loc062_ThetaVnce 9;
BA_ "GenSigSendType" SG_ 431 RFC_Loc062_PhiVnce 9;
BA_ "GenSigSendType" SG_ 431 RFC_Loc062_RCS 9;
BA_ "GenSigStartValue" SG_ 431 RFC_Loc062_RCS 32768;
BA_ "GenSigSendType" SG_ 431 RFC_Loc062_RSSI 9;
BA_ "GenSigSendType" SG_ 431 RFC_Loc063_Dr 9;
BA_ "GenSigSendType" SG_ 431 RFC_Loc063_Vr 9;
BA_ "GenSigStartValue" SG_ 431 RFC_Loc063_Vr 32768;
BA_ "GenSigSendType" SG_ 431 RFC_Loc063_Theta 9;
BA_ "GenSigStartValue" SG_ 431 RFC_Loc063_Theta 32768;
BA_ "GenSigSendType" SG_ 431 RFC_Loc063_Phi 9;
BA_ "GenSigStartValue" SG_ 431 RFC_Loc063_Phi 32768;
BA_ "GenSigSendType" SG_ 431 RFC_Loc063_DrVnce 9;
BA_ "GenSigSendType" SG_ 431 RFC_Loc063_VrVnce 9;
BA_ "GenSigSendType" SG_ 431 RFC_Loc063_ThetaVnce 9;
BA_ "GenSigSendType" SG_ 431 RFC_Loc063_PhiVnce 9;
BA_ "GenSigSendType" SG_ 431 RFC_Loc063_RCS 9;
BA_ "GenSigStartValue" SG_ 431 RFC_Loc063_RCS 32768;
BA_ "GenSigSendType" SG_ 431 RFC_Loc063_RSSI 9;
BA_ "GenSigSendType" SG_ 432 RFC_Loc064_CRC 9;
BA_ "GenSigSendType" SG_ 432 RFC_Loc064_AliveCtr 9;
BA_ "GenSigSendType" SG_ 432 RFC_Loc064_ProtBlockCtr 9;
BA_ "GenSigSendType" SG_ 432 RFC_Loc064_Dr 9;
BA_ "GenSigSendType" SG_ 432 RFC_Loc064_Vr 9;
BA_ "GenSigStartValue" SG_ 432 RFC_Loc064_Vr 32768;
BA_ "GenSigSendType" SG_ 432 RFC_Loc064_Theta 9;
BA_ "GenSigStartValue" SG_ 432 RFC_Loc064_Theta 32768;
BA_ "GenSigSendType" SG_ 432 RFC_Loc064_Phi 9;
BA_ "GenSigStartValue" SG_ 432 RFC_Loc064_Phi 32768;
BA_ "GenSigSendType" SG_ 432 RFC_Loc064_DrVnce 9;
BA_ "GenSigSendType" SG_ 432 RFC_Loc064_VrVnce 9;
BA_ "GenSigSendType" SG_ 432 RFC_Loc064_ThetaVnce 9;
BA_ "GenSigSendType" SG_ 432 RFC_Loc064_PhiVnce 9;
BA_ "GenSigSendType" SG_ 432 RFC_Loc064_RCS 9;
BA_ "GenSigStartValue" SG_ 432 RFC_Loc064_RCS 32768;
BA_ "GenSigSendType" SG_ 432 RFC_Loc064_RSSI 9;
BA_ "GenSigSendType" SG_ 432 RFC_Loc065_Dr 9;
BA_ "GenSigSendType" SG_ 432 RFC_Loc065_Vr 9;
BA_ "GenSigStartValue" SG_ 432 RFC_Loc065_Vr 32768;
BA_ "GenSigSendType" SG_ 432 RFC_Loc065_Theta 9;
BA_ "GenSigStartValue" SG_ 432 RFC_Loc065_Theta 32768;
BA_ "GenSigSendType" SG_ 432 RFC_Loc065_Phi 9;
BA_ "GenSigStartValue" SG_ 432 RFC_Loc065_Phi 32768;
BA_ "GenSigSendType" SG_ 432 RFC_Loc065_DrVnce 9;
BA_ "GenSigSendType" SG_ 432 RFC_Loc065_VrVnce 9;
BA_ "GenSigSendType" SG_ 432 RFC_Loc065_ThetaVnce 9;
BA_ "GenSigSendType" SG_ 432 RFC_Loc065_PhiVnce 9;
BA_ "GenSigSendType" SG_ 432 RFC_Loc065_RCS 9;
BA_ "GenSigStartValue" SG_ 432 RFC_Loc065_RCS 32768;
BA_ "GenSigSendType" SG_ 432 RFC_Loc065_RSSI 9;
BA_ "GenSigSendType" SG_ 433 RFC_Loc066_CRC 9;
BA_ "GenSigSendType" SG_ 433 RFC_Loc066_AliveCtr 9;
BA_ "GenSigSendType" SG_ 433 RFC_Loc066_ProtBlockCtr 9;
BA_ "GenSigSendType" SG_ 433 RFC_Loc066_Dr 9;
BA_ "GenSigSendType" SG_ 433 RFC_Loc066_Vr 9;
BA_ "GenSigStartValue" SG_ 433 RFC_Loc066_Vr 32768;
BA_ "GenSigSendType" SG_ 433 RFC_Loc066_Theta 9;
BA_ "GenSigStartValue" SG_ 433 RFC_Loc066_Theta 32768;
BA_ "GenSigSendType" SG_ 433 RFC_Loc066_Phi 9;
BA_ "GenSigStartValue" SG_ 433 RFC_Loc066_Phi 32768;
BA_ "GenSigSendType" SG_ 433 RFC_Loc066_DrVnce 9;
BA_ "GenSigSendType" SG_ 433 RFC_Loc066_VrVnce 9;
BA_ "GenSigSendType" SG_ 433 RFC_Loc066_ThetaVnce 9;
BA_ "GenSigSendType" SG_ 433 RFC_Loc066_PhiVnce 9;
BA_ "GenSigSendType" SG_ 433 RFC_Loc066_RCS 9;
BA_ "GenSigStartValue" SG_ 433 RFC_Loc066_RCS 32768;
BA_ "GenSigSendType" SG_ 433 RFC_Loc066_RSSI 9;
BA_ "GenSigSendType" SG_ 433 RFC_Loc067_Dr 9;
BA_ "GenSigSendType" SG_ 433 RFC_Loc067_Vr 9;
BA_ "GenSigStartValue" SG_ 433 RFC_Loc067_Vr 32768;
BA_ "GenSigSendType" SG_ 433 RFC_Loc067_Theta 9;
BA_ "GenSigStartValue" SG_ 433 RFC_Loc067_Theta 32768;
BA_ "GenSigSendType" SG_ 433 RFC_Loc067_Phi 9;
BA_ "GenSigStartValue" SG_ 433 RFC_Loc067_Phi 32768;
BA_ "GenSigSendType" SG_ 433 RFC_Loc067_DrVnce 9;
BA_ "GenSigSendType" SG_ 433 RFC_Loc067_VrVnce 9;
BA_ "GenSigSendType" SG_ 433 RFC_Loc067_ThetaVnce 9;
BA_ "GenSigSendType" SG_ 433 RFC_Loc067_PhiVnce 9;
BA_ "GenSigSendType" SG_ 433 RFC_Loc067_RCS 9;
BA_ "GenSigStartValue" SG_ 433 RFC_Loc067_RCS 32768;
BA_ "GenSigSendType" SG_ 433 RFC_Loc067_RSSI 9;
BA_ "GenSigSendType" SG_ 434 RFC_Loc068_CRC 9;
BA_ "GenSigSendType" SG_ 434 RFC_Loc068_AliveCtr 9;
BA_ "GenSigSendType" SG_ 434 RFC_Loc068_ProtBlockCtr 9;
BA_ "GenSigSendType" SG_ 434 RFC_Loc068_Dr 9;
BA_ "GenSigSendType" SG_ 434 RFC_Loc068_Vr 9;
BA_ "GenSigStartValue" SG_ 434 RFC_Loc068_Vr 32768;
BA_ "GenSigSendType" SG_ 434 RFC_Loc068_Theta 9;
BA_ "GenSigStartValue" SG_ 434 RFC_Loc068_Theta 32768;
BA_ "GenSigSendType" SG_ 434 RFC_Loc068_Phi 9;
BA_ "GenSigStartValue" SG_ 434 RFC_Loc068_Phi 32768;
BA_ "GenSigSendType" SG_ 434 RFC_Loc068_DrVnce 9;
BA_ "GenSigSendType" SG_ 434 RFC_Loc068_VrVnce 9;
BA_ "GenSigSendType" SG_ 434 RFC_Loc068_ThetaVnce 9;
BA_ "GenSigSendType" SG_ 434 RFC_Loc068_PhiVnce 9;
BA_ "GenSigSendType" SG_ 434 RFC_Loc068_RCS 9;
BA_ "GenSigStartValue" SG_ 434 RFC_Loc068_RCS 32768;
BA_ "GenSigSendType" SG_ 434 RFC_Loc068_RSSI 9;
BA_ "GenSigSendType" SG_ 434 RFC_Loc069_Dr 9;
BA_ "GenSigSendType" SG_ 434 RFC_Loc069_Vr 9;
BA_ "GenSigStartValue" SG_ 434 RFC_Loc069_Vr 32768;
BA_ "GenSigSendType" SG_ 434 RFC_Loc069_Theta 9;
BA_ "GenSigStartValue" SG_ 434 RFC_Loc069_Theta 32768;
BA_ "GenSigSendType" SG_ 434 RFC_Loc069_Phi 9;
BA_ "GenSigStartValue" SG_ 434 RFC_Loc069_Phi 32768;
BA_ "GenSigSendType" SG_ 434 RFC_Loc069_DrVnce 9;
BA_ "GenSigSendType" SG_ 434 RFC_Loc069_VrVnce 9;
BA_ "GenSigSendType" SG_ 434 RFC_Loc069_ThetaVnce 9;
BA_ "GenSigSendType" SG_ 434 RFC_Loc069_PhiVnce 9;
BA_ "GenSigSendType" SG_ 434 RFC_Loc069_RCS 9;
BA_ "GenSigStartValue" SG_ 434 RFC_Loc069_RCS 32768;
BA_ "GenSigSendType" SG_ 434 RFC_Loc069_RSSI 9;
BA_ "GenSigSendType" SG_ 435 RFC_Loc070_CRC 9;
BA_ "GenSigSendType" SG_ 435 RFC_Loc070_AliveCtr 9;
BA_ "GenSigSendType" SG_ 435 RFC_Loc070_ProtBlockCtr 9;
BA_ "GenSigSendType" SG_ 435 RFC_Loc070_Dr 9;
BA_ "GenSigSendType" SG_ 435 RFC_Loc070_Vr 9;
BA_ "GenSigStartValue" SG_ 435 RFC_Loc070_Vr 32768;
BA_ "GenSigSendType" SG_ 435 RFC_Loc070_Theta 9;
BA_ "GenSigStartValue" SG_ 435 RFC_Loc070_Theta 32768;
BA_ "GenSigSendType" SG_ 435 RFC_Loc070_Phi 9;
BA_ "GenSigStartValue" SG_ 435 RFC_Loc070_Phi 32768;
BA_ "GenSigSendType" SG_ 435 RFC_Loc070_DrVnce 9;
BA_ "GenSigSendType" SG_ 435 RFC_Loc070_VrVnce 9;
BA_ "GenSigSendType" SG_ 435 RFC_Loc070_ThetaVnce 9;
BA_ "GenSigSendType" SG_ 435 RFC_Loc070_PhiVnce 9;
BA_ "GenSigSendType" SG_ 435 RFC_Loc070_RCS 9;
BA_ "GenSigStartValue" SG_ 435 RFC_Loc070_RCS 32768;
BA_ "GenSigSendType" SG_ 435 RFC_Loc070_RSSI 9;
BA_ "GenSigSendType" SG_ 435 RFC_Loc071_Dr 9;
BA_ "GenSigSendType" SG_ 435 RFC_Loc071_Vr 9;
BA_ "GenSigStartValue" SG_ 435 RFC_Loc071_Vr 32768;
BA_ "GenSigSendType" SG_ 435 RFC_Loc071_Theta 9;
BA_ "GenSigStartValue" SG_ 435 RFC_Loc071_Theta 32768;
BA_ "GenSigSendType" SG_ 435 RFC_Loc071_Phi 9;
BA_ "GenSigStartValue" SG_ 435 RFC_Loc071_Phi 32768;
BA_ "GenSigSendType" SG_ 435 RFC_Loc071_DrVnce 9;
BA_ "GenSigSendType" SG_ 435 RFC_Loc071_VrVnce 9;
BA_ "GenSigSendType" SG_ 435 RFC_Loc071_ThetaVnce 9;
BA_ "GenSigSendType" SG_ 435 RFC_Loc071_PhiVnce 9;
BA_ "GenSigSendType" SG_ 435 RFC_Loc071_RCS 9;
BA_ "GenSigStartValue" SG_ 435 RFC_Loc071_RCS 32768;
BA_ "GenSigSendType" SG_ 435 RFC_Loc071_RSSI 9;
BA_ "GenSigSendType" SG_ 436 RFC_Loc072_CRC 9;
BA_ "GenSigSendType" SG_ 436 RFC_Loc072_AliveCtr 9;
BA_ "GenSigSendType" SG_ 436 RFC_Loc072_ProtBlockCtr 9;
BA_ "GenSigSendType" SG_ 436 RFC_Loc072_Dr 9;
BA_ "GenSigSendType" SG_ 436 RFC_Loc072_Vr 9;
BA_ "GenSigStartValue" SG_ 436 RFC_Loc072_Vr 32768;
BA_ "GenSigSendType" SG_ 436 RFC_Loc072_Theta 9;
BA_ "GenSigStartValue" SG_ 436 RFC_Loc072_Theta 32768;
BA_ "GenSigSendType" SG_ 436 RFC_Loc072_Phi 9;
BA_ "GenSigStartValue" SG_ 436 RFC_Loc072_Phi 32768;
BA_ "GenSigSendType" SG_ 436 RFC_Loc072_DrVnce 9;
BA_ "GenSigSendType" SG_ 436 RFC_Loc072_VrVnce 9;
BA_ "GenSigSendType" SG_ 436 RFC_Loc072_ThetaVnce 9;
BA_ "GenSigSendType" SG_ 436 RFC_Loc072_PhiVnce 9;
BA_ "GenSigSendType" SG_ 436 RFC_Loc072_RCS 9;
BA_ "GenSigStartValue" SG_ 436 RFC_Loc072_RCS 32768;
BA_ "GenSigSendType" SG_ 436 RFC_Loc072_RSSI 9;
BA_ "GenSigSendType" SG_ 436 RFC_Loc073_Dr 9;
BA_ "GenSigSendType" SG_ 436 RFC_Loc073_Vr 9;
BA_ "GenSigStartValue" SG_ 436 RFC_Loc073_Vr 32768;
BA_ "GenSigSendType" SG_ 436 RFC_Loc073_Theta 9;
BA_ "GenSigStartValue" SG_ 436 RFC_Loc073_Theta 32768;
BA_ "GenSigSendType" SG_ 436 RFC_Loc073_Phi 9;
BA_ "GenSigStartValue" SG_ 436 RFC_Loc073_Phi 32768;
BA_ "GenSigSendType" SG_ 436 RFC_Loc073_DrVnce 9;
BA_ "GenSigSendType" SG_ 436 RFC_Loc073_VrVnce 9;
BA_ "GenSigSendType" SG_ 436 RFC_Loc073_ThetaVnce 9;
BA_ "GenSigSendType" SG_ 436 RFC_Loc073_PhiVnce 9;
BA_ "GenSigSendType" SG_ 436 RFC_Loc073_RCS 9;
BA_ "GenSigStartValue" SG_ 436 RFC_Loc073_RCS 32768;
BA_ "GenSigSendType" SG_ 436 RFC_Loc073_RSSI 9;
BA_ "GenSigSendType" SG_ 437 RFC_Loc074_CRC 9;
BA_ "GenSigSendType" SG_ 437 RFC_Loc074_AliveCtr 9;
BA_ "GenSigSendType" SG_ 437 RFC_Loc074_ProtBlockCtr 9;
BA_ "GenSigSendType" SG_ 437 RFC_Loc074_Dr 9;
BA_ "GenSigSendType" SG_ 437 RFC_Loc074_Vr 9;
BA_ "GenSigStartValue" SG_ 437 RFC_Loc074_Vr 32768;
BA_ "GenSigSendType" SG_ 437 RFC_Loc074_Theta 9;
BA_ "GenSigStartValue" SG_ 437 RFC_Loc074_Theta 32768;
BA_ "GenSigSendType" SG_ 437 RFC_Loc074_Phi 9;
BA_ "GenSigStartValue" SG_ 437 RFC_Loc074_Phi 32768;
BA_ "GenSigSendType" SG_ 437 RFC_Loc074_DrVnce 9;
BA_ "GenSigSendType" SG_ 437 RFC_Loc074_VrVnce 9;
BA_ "GenSigSendType" SG_ 437 RFC_Loc074_ThetaVnce 9;
BA_ "GenSigSendType" SG_ 437 RFC_Loc074_PhiVnce 9;
BA_ "GenSigSendType" SG_ 437 RFC_Loc074_RCS 9;
BA_ "GenSigStartValue" SG_ 437 RFC_Loc074_RCS 32768;
BA_ "GenSigSendType" SG_ 437 RFC_Loc074_RSSI 9;
BA_ "GenSigSendType" SG_ 437 RFC_Loc075_Dr 9;
BA_ "GenSigSendType" SG_ 437 RFC_Loc075_Vr 9;
BA_ "GenSigStartValue" SG_ 437 RFC_Loc075_Vr 32768;
BA_ "GenSigSendType" SG_ 437 RFC_Loc075_Theta 9;
BA_ "GenSigStartValue" SG_ 437 RFC_Loc075_Theta 32768;
BA_ "GenSigSendType" SG_ 437 RFC_Loc075_Phi 9;
BA_ "GenSigStartValue" SG_ 437 RFC_Loc075_Phi 32768;
BA_ "GenSigSendType" SG_ 437 RFC_Loc075_DrVnce 9;
BA_ "GenSigSendType" SG_ 437 RFC_Loc075_VrVnce 9;
BA_ "GenSigSendType" SG_ 437 RFC_Loc075_ThetaVnce 9;
BA_ "GenSigSendType" SG_ 437 RFC_Loc075_PhiVnce 9;
BA_ "GenSigSendType" SG_ 437 RFC_Loc075_RCS 9;
BA_ "GenSigStartValue" SG_ 437 RFC_Loc075_RCS 32768;
BA_ "GenSigSendType" SG_ 437 RFC_Loc075_RSSI 9;
BA_ "GenSigSendType" SG_ 438 RFC_Loc076_CRC 9;
BA_ "GenSigSendType" SG_ 438 RFC_Loc076_AliveCtr 9;
BA_ "GenSigSendType" SG_ 438 RFC_Loc076_ProtBlockCtr 9;
BA_ "GenSigSendType" SG_ 438 RFC_Loc076_Dr 9;
BA_ "GenSigSendType" SG_ 438 RFC_Loc076_Vr 9;
BA_ "GenSigStartValue" SG_ 438 RFC_Loc076_Vr 32768;
BA_ "GenSigSendType" SG_ 438 RFC_Loc076_Theta 9;
BA_ "GenSigStartValue" SG_ 438 RFC_Loc076_Theta 32768;
BA_ "GenSigSendType" SG_ 438 RFC_Loc076_Phi 9;
BA_ "GenSigStartValue" SG_ 438 RFC_Loc076_Phi 32768;
BA_ "GenSigSendType" SG_ 438 RFC_Loc076_DrVnce 9;
BA_ "GenSigSendType" SG_ 438 RFC_Loc076_VrVnce 9;
BA_ "GenSigSendType" SG_ 438 RFC_Loc076_ThetaVnce 9;
BA_ "GenSigSendType" SG_ 438 RFC_Loc076_PhiVnce 9;
BA_ "GenSigSendType" SG_ 438 RFC_Loc076_RCS 9;
BA_ "GenSigStartValue" SG_ 438 RFC_Loc076_RCS 32768;
BA_ "GenSigSendType" SG_ 438 RFC_Loc076_RSSI 9;
BA_ "GenSigSendType" SG_ 438 RFC_Loc077_Dr 9;
BA_ "GenSigSendType" SG_ 438 RFC_Loc077_Vr 9;
BA_ "GenSigStartValue" SG_ 438 RFC_Loc077_Vr 32768;
BA_ "GenSigSendType" SG_ 438 RFC_Loc077_Theta 9;
BA_ "GenSigStartValue" SG_ 438 RFC_Loc077_Theta 32768;
BA_ "GenSigSendType" SG_ 438 RFC_Loc077_Phi 9;
BA_ "GenSigStartValue" SG_ 438 RFC_Loc077_Phi 32768;
BA_ "GenSigSendType" SG_ 438 RFC_Loc077_DrVnce 9;
BA_ "GenSigSendType" SG_ 438 RFC_Loc077_VrVnce 9;
BA_ "GenSigSendType" SG_ 438 RFC_Loc077_ThetaVnce 9;
BA_ "GenSigSendType" SG_ 438 RFC_Loc077_PhiVnce 9;
BA_ "GenSigSendType" SG_ 438 RFC_Loc077_RCS 9;
BA_ "GenSigStartValue" SG_ 438 RFC_Loc077_RCS 32768;
BA_ "GenSigSendType" SG_ 438 RFC_Loc077_RSSI 9;
BA_ "GenSigSendType" SG_ 439 RFC_Loc078_CRC 9;
BA_ "GenSigSendType" SG_ 439 RFC_Loc078_AliveCtr 9;
BA_ "GenSigSendType" SG_ 439 RFC_Loc078_ProtBlockCtr 9;
BA_ "GenSigSendType" SG_ 439 RFC_Loc078_Dr 9;
BA_ "GenSigSendType" SG_ 439 RFC_Loc078_Vr 9;
BA_ "GenSigStartValue" SG_ 439 RFC_Loc078_Vr 32768;
BA_ "GenSigSendType" SG_ 439 RFC_Loc078_Theta 9;
BA_ "GenSigStartValue" SG_ 439 RFC_Loc078_Theta 32768;
BA_ "GenSigSendType" SG_ 439 RFC_Loc078_Phi 9;
BA_ "GenSigStartValue" SG_ 439 RFC_Loc078_Phi 32768;
BA_ "GenSigSendType" SG_ 439 RFC_Loc078_DrVnce 9;
BA_ "GenSigSendType" SG_ 439 RFC_Loc078_VrVnce 9;
BA_ "GenSigSendType" SG_ 439 RFC_Loc078_ThetaVnce 9;
BA_ "GenSigSendType" SG_ 439 RFC_Loc078_PhiVnce 9;
BA_ "GenSigSendType" SG_ 439 RFC_Loc078_RCS 9;
BA_ "GenSigStartValue" SG_ 439 RFC_Loc078_RCS 32768;
BA_ "GenSigSendType" SG_ 439 RFC_Loc078_RSSI 9;
BA_ "GenSigSendType" SG_ 439 RFC_Loc079_Dr 9;
BA_ "GenSigSendType" SG_ 439 RFC_Loc079_Vr 9;
BA_ "GenSigStartValue" SG_ 439 RFC_Loc079_Vr 32768;
BA_ "GenSigSendType" SG_ 439 RFC_Loc079_Theta 9;
BA_ "GenSigStartValue" SG_ 439 RFC_Loc079_Theta 32768;
BA_ "GenSigSendType" SG_ 439 RFC_Loc079_Phi 9;
BA_ "GenSigStartValue" SG_ 439 RFC_Loc079_Phi 32768;
BA_ "GenSigSendType" SG_ 439 RFC_Loc079_DrVnce 9;
BA_ "GenSigSendType" SG_ 439 RFC_Loc079_VrVnce 9;
BA_ "GenSigSendType" SG_ 439 RFC_Loc079_ThetaVnce 9;
BA_ "GenSigSendType" SG_ 439 RFC_Loc079_PhiVnce 9;
BA_ "GenSigSendType" SG_ 439 RFC_Loc079_RCS 9;
BA_ "GenSigStartValue" SG_ 439 RFC_Loc079_RCS 32768;
BA_ "GenSigSendType" SG_ 439 RFC_Loc079_RSSI 9;
BA_ "GenSigSendType" SG_ 440 RFC_Loc080_CRC 9;
BA_ "GenSigSendType" SG_ 440 RFC_Loc080_AliveCtr 9;
BA_ "GenSigSendType" SG_ 440 RFC_Loc080_ProtBlockCtr 9;
BA_ "GenSigSendType" SG_ 440 RFC_Loc080_Dr 9;
BA_ "GenSigSendType" SG_ 440 RFC_Loc080_Vr 9;
BA_ "GenSigStartValue" SG_ 440 RFC_Loc080_Vr 32768;
BA_ "GenSigSendType" SG_ 440 RFC_Loc080_Theta 9;
BA_ "GenSigStartValue" SG_ 440 RFC_Loc080_Theta 32768;
BA_ "GenSigSendType" SG_ 440 RFC_Loc080_Phi 9;
BA_ "GenSigStartValue" SG_ 440 RFC_Loc080_Phi 32768;
BA_ "GenSigSendType" SG_ 440 RFC_Loc080_DrVnce 9;
BA_ "GenSigSendType" SG_ 440 RFC_Loc080_VrVnce 9;
BA_ "GenSigSendType" SG_ 440 RFC_Loc080_ThetaVnce 9;
BA_ "GenSigSendType" SG_ 440 RFC_Loc080_PhiVnce 9;
BA_ "GenSigSendType" SG_ 440 RFC_Loc080_RCS 9;
BA_ "GenSigStartValue" SG_ 440 RFC_Loc080_RCS 32768;
BA_ "GenSigSendType" SG_ 440 RFC_Loc080_RSSI 9;
BA_ "GenSigSendType" SG_ 440 RFC_Loc081_Dr 9;
BA_ "GenSigSendType" SG_ 440 RFC_Loc081_Vr 9;
BA_ "GenSigStartValue" SG_ 440 RFC_Loc081_Vr 32768;
BA_ "GenSigSendType" SG_ 440 RFC_Loc081_Theta 9;
BA_ "GenSigStartValue" SG_ 440 RFC_Loc081_Theta 32768;
BA_ "GenSigSendType" SG_ 440 RFC_Loc081_Phi 9;
BA_ "GenSigStartValue" SG_ 440 RFC_Loc081_Phi 32768;
BA_ "GenSigSendType" SG_ 440 RFC_Loc081_DrVnce 9;
BA_ "GenSigSendType" SG_ 440 RFC_Loc081_VrVnce 9;
BA_ "GenSigSendType" SG_ 440 RFC_Loc081_ThetaVnce 9;
BA_ "GenSigSendType" SG_ 440 RFC_Loc081_PhiVnce 9;
BA_ "GenSigSendType" SG_ 440 RFC_Loc081_RCS 9;
BA_ "GenSigStartValue" SG_ 440 RFC_Loc081_RCS 32768;
BA_ "GenSigSendType" SG_ 440 RFC_Loc081_RSSI 9;
BA_ "GenSigSendType" SG_ 441 RFC_Loc082_CRC 9;
BA_ "GenSigSendType" SG_ 441 RFC_Loc082_AliveCtr 9;
BA_ "GenSigSendType" SG_ 441 RFC_Loc082_ProtBlockCtr 9;
BA_ "GenSigSendType" SG_ 441 RFC_Loc082_Dr 9;
BA_ "GenSigSendType" SG_ 441 RFC_Loc082_Vr 9;
BA_ "GenSigStartValue" SG_ 441 RFC_Loc082_Vr 32768;
BA_ "GenSigSendType" SG_ 441 RFC_Loc082_Theta 9;
BA_ "GenSigStartValue" SG_ 441 RFC_Loc082_Theta 32768;
BA_ "GenSigSendType" SG_ 441 RFC_Loc082_Phi 9;
BA_ "GenSigStartValue" SG_ 441 RFC_Loc082_Phi 32768;
BA_ "GenSigSendType" SG_ 441 RFC_Loc082_DrVnce 9;
BA_ "GenSigSendType" SG_ 441 RFC_Loc082_VrVnce 9;
BA_ "GenSigSendType" SG_ 441 RFC_Loc082_ThetaVnce 9;
BA_ "GenSigSendType" SG_ 441 RFC_Loc082_PhiVnce 9;
BA_ "GenSigSendType" SG_ 441 RFC_Loc082_RCS 9;
BA_ "GenSigStartValue" SG_ 441 RFC_Loc082_RCS 32768;
BA_ "GenSigSendType" SG_ 441 RFC_Loc082_RSSI 9;
BA_ "GenSigSendType" SG_ 441 RFC_Loc083_Dr 9;
BA_ "GenSigSendType" SG_ 441 RFC_Loc083_Vr 9;
BA_ "GenSigStartValue" SG_ 441 RFC_Loc083_Vr 32768;
BA_ "GenSigSendType" SG_ 441 RFC_Loc083_Theta 9;
BA_ "GenSigStartValue" SG_ 441 RFC_Loc083_Theta 32768;
BA_ "GenSigSendType" SG_ 441 RFC_Loc083_Phi 9;
BA_ "GenSigStartValue" SG_ 441 RFC_Loc083_Phi 32768;
BA_ "GenSigSendType" SG_ 441 RFC_Loc083_DrVnce 9;
BA_ "GenSigSendType" SG_ 441 RFC_Loc083_VrVnce 9;
BA_ "GenSigSendType" SG_ 441 RFC_Loc083_ThetaVnce 9;
BA_ "GenSigSendType" SG_ 441 RFC_Loc083_PhiVnce 9;
BA_ "GenSigSendType" SG_ 441 RFC_Loc083_RCS 9;
BA_ "GenSigStartValue" SG_ 441 RFC_Loc083_RCS 32768;
BA_ "GenSigSendType" SG_ 441 RFC_Loc083_RSSI 9;
BA_ "GenSigSendType" SG_ 442 RFC_Loc084_CRC 9;
BA_ "GenSigSendType" SG_ 442 RFC_Loc084_AliveCtr 9;
BA_ "GenSigSendType" SG_ 442 RFC_Loc084_ProtBlockCtr 9;
BA_ "GenSigSendType" SG_ 442 RFC_Loc084_Dr 9;
BA_ "GenSigSendType" SG_ 442 RFC_Loc084_Vr 9;
BA_ "GenSigStartValue" SG_ 442 RFC_Loc084_Vr 32768;
BA_ "GenSigSendType" SG_ 442 RFC_Loc084_Theta 9;
BA_ "GenSigStartValue" SG_ 442 RFC_Loc084_Theta 32768;
BA_ "GenSigSendType" SG_ 442 RFC_Loc084_Phi 9;
BA_ "GenSigStartValue" SG_ 442 RFC_Loc084_Phi 32768;
BA_ "GenSigSendType" SG_ 442 RFC_Loc084_DrVnce 9;
BA_ "GenSigSendType" SG_ 442 RFC_Loc084_VrVnce 9;
BA_ "GenSigSendType" SG_ 442 RFC_Loc084_ThetaVnce 9;
BA_ "GenSigSendType" SG_ 442 RFC_Loc084_PhiVnce 9;
BA_ "GenSigSendType" SG_ 442 RFC_Loc084_RCS 9;
BA_ "GenSigStartValue" SG_ 442 RFC_Loc084_RCS 32768;
BA_ "GenSigSendType" SG_ 442 RFC_Loc084_RSSI 9;
BA_ "GenSigSendType" SG_ 442 RFC_Loc085_Dr 9;
BA_ "GenSigSendType" SG_ 442 RFC_Loc085_Vr 9;
BA_ "GenSigStartValue" SG_ 442 RFC_Loc085_Vr 32768;
BA_ "GenSigSendType" SG_ 442 RFC_Loc085_Theta 9;
BA_ "GenSigStartValue" SG_ 442 RFC_Loc085_Theta 32768;
BA_ "GenSigSendType" SG_ 442 RFC_Loc085_Phi 9;
BA_ "GenSigStartValue" SG_ 442 RFC_Loc085_Phi 32768;
BA_ "GenSigSendType" SG_ 442 RFC_Loc085_DrVnce 9;
BA_ "GenSigSendType" SG_ 442 RFC_Loc085_VrVnce 9;
BA_ "GenSigSendType" SG_ 442 RFC_Loc085_ThetaVnce 9;
BA_ "GenSigSendType" SG_ 442 RFC_Loc085_PhiVnce 9;
BA_ "GenSigSendType" SG_ 442 RFC_Loc085_RCS 9;
BA_ "GenSigStartValue" SG_ 442 RFC_Loc085_RCS 32768;
BA_ "GenSigSendType" SG_ 442 RFC_Loc085_RSSI 9;
BA_ "GenSigSendType" SG_ 443 RFC_Loc086_CRC 9;
BA_ "GenSigSendType" SG_ 443 RFC_Loc086_AliveCtr 9;
BA_ "GenSigSendType" SG_ 443 RFC_Loc086_ProtBlockCtr 9;
BA_ "GenSigSendType" SG_ 443 RFC_Loc086_Dr 9;
BA_ "GenSigSendType" SG_ 443 RFC_Loc086_Vr 9;
BA_ "GenSigStartValue" SG_ 443 RFC_Loc086_Vr 32768;
BA_ "GenSigSendType" SG_ 443 RFC_Loc086_Theta 9;
BA_ "GenSigStartValue" SG_ 443 RFC_Loc086_Theta 32768;
BA_ "GenSigSendType" SG_ 443 RFC_Loc086_Phi 9;
BA_ "GenSigStartValue" SG_ 443 RFC_Loc086_Phi 32768;
BA_ "GenSigSendType" SG_ 443 RFC_Loc086_DrVnce 9;
BA_ "GenSigSendType" SG_ 443 RFC_Loc086_VrVnce 9;
BA_ "GenSigSendType" SG_ 443 RFC_Loc086_ThetaVnce 9;
BA_ "GenSigSendType" SG_ 443 RFC_Loc086_PhiVnce 9;
BA_ "GenSigSendType" SG_ 443 RFC_Loc086_RCS 9;
BA_ "GenSigStartValue" SG_ 443 RFC_Loc086_RCS 32768;
BA_ "GenSigSendType" SG_ 443 RFC_Loc086_RSSI 9;
BA_ "GenSigSendType" SG_ 443 RFC_Loc087_Dr 9;
BA_ "GenSigSendType" SG_ 443 RFC_Loc087_Vr 9;
BA_ "GenSigStartValue" SG_ 443 RFC_Loc087_Vr 32768;
BA_ "GenSigSendType" SG_ 443 RFC_Loc087_Theta 9;
BA_ "GenSigStartValue" SG_ 443 RFC_Loc087_Theta 32768;
BA_ "GenSigSendType" SG_ 443 RFC_Loc087_Phi 9;
BA_ "GenSigStartValue" SG_ 443 RFC_Loc087_Phi 32768;
BA_ "GenSigSendType" SG_ 443 RFC_Loc087_DrVnce 9;
BA_ "GenSigSendType" SG_ 443 RFC_Loc087_VrVnce 9;
BA_ "GenSigSendType" SG_ 443 RFC_Loc087_ThetaVnce 9;
BA_ "GenSigSendType" SG_ 443 RFC_Loc087_PhiVnce 9;
BA_ "GenSigSendType" SG_ 443 RFC_Loc087_RCS 9;
BA_ "GenSigStartValue" SG_ 443 RFC_Loc087_RCS 32768;
BA_ "GenSigSendType" SG_ 443 RFC_Loc087_RSSI 9;
BA_ "GenSigSendType" SG_ 444 RFC_Loc088_CRC 9;
BA_ "GenSigSendType" SG_ 444 RFC_Loc088_AliveCtr 9;
BA_ "GenSigSendType" SG_ 444 RFC_Loc088_ProtBlockCtr 9;
BA_ "GenSigSendType" SG_ 444 RFC_Loc088_Dr 9;
BA_ "GenSigSendType" SG_ 444 RFC_Loc088_Vr 9;
BA_ "GenSigStartValue" SG_ 444 RFC_Loc088_Vr 32768;
BA_ "GenSigSendType" SG_ 444 RFC_Loc088_Theta 9;
BA_ "GenSigStartValue" SG_ 444 RFC_Loc088_Theta 32768;
BA_ "GenSigSendType" SG_ 444 RFC_Loc088_Phi 9;
BA_ "GenSigStartValue" SG_ 444 RFC_Loc088_Phi 32768;
BA_ "GenSigSendType" SG_ 444 RFC_Loc088_DrVnce 9;
BA_ "GenSigSendType" SG_ 444 RFC_Loc088_VrVnce 9;
BA_ "GenSigSendType" SG_ 444 RFC_Loc088_ThetaVnce 9;
BA_ "GenSigSendType" SG_ 444 RFC_Loc088_PhiVnce 9;
BA_ "GenSigSendType" SG_ 444 RFC_Loc088_RCS 9;
BA_ "GenSigStartValue" SG_ 444 RFC_Loc088_RCS 32768;
BA_ "GenSigSendType" SG_ 444 RFC_Loc088_RSSI 9;
BA_ "GenSigSendType" SG_ 444 RFC_Loc089_Dr 9;
BA_ "GenSigSendType" SG_ 444 RFC_Loc089_Vr 9;
BA_ "GenSigStartValue" SG_ 444 RFC_Loc089_Vr 32768;
BA_ "GenSigSendType" SG_ 444 RFC_Loc089_Theta 9;
BA_ "GenSigStartValue" SG_ 444 RFC_Loc089_Theta 32768;
BA_ "GenSigSendType" SG_ 444 RFC_Loc089_Phi 9;
BA_ "GenSigStartValue" SG_ 444 RFC_Loc089_Phi 32768;
BA_ "GenSigSendType" SG_ 444 RFC_Loc089_DrVnce 9;
BA_ "GenSigSendType" SG_ 444 RFC_Loc089_VrVnce 9;
BA_ "GenSigSendType" SG_ 444 RFC_Loc089_ThetaVnce 9;
BA_ "GenSigSendType" SG_ 444 RFC_Loc089_PhiVnce 9;
BA_ "GenSigSendType" SG_ 444 RFC_Loc089_RCS 9;
BA_ "GenSigStartValue" SG_ 444 RFC_Loc089_RCS 32768;
BA_ "GenSigSendType" SG_ 444 RFC_Loc089_RSSI 9;
BA_ "GenSigSendType" SG_ 445 RFC_Loc090_CRC 9;
BA_ "GenSigSendType" SG_ 445 RFC_Loc090_AliveCtr 9;
BA_ "GenSigSendType" SG_ 445 RFC_Loc090_ProtBlockCtr 9;
BA_ "GenSigSendType" SG_ 445 RFC_Loc090_Dr 9;
BA_ "GenSigSendType" SG_ 445 RFC_Loc090_Vr 9;
BA_ "GenSigStartValue" SG_ 445 RFC_Loc090_Vr 32768;
BA_ "GenSigSendType" SG_ 445 RFC_Loc090_Theta 9;
BA_ "GenSigStartValue" SG_ 445 RFC_Loc090_Theta 32768;
BA_ "GenSigSendType" SG_ 445 RFC_Loc090_Phi 9;
BA_ "GenSigStartValue" SG_ 445 RFC_Loc090_Phi 32768;
BA_ "GenSigSendType" SG_ 445 RFC_Loc090_DrVnce 9;
BA_ "GenSigSendType" SG_ 445 RFC_Loc090_VrVnce 9;
BA_ "GenSigSendType" SG_ 445 RFC_Loc090_ThetaVnce 9;
BA_ "GenSigSendType" SG_ 445 RFC_Loc090_PhiVnce 9;
BA_ "GenSigSendType" SG_ 445 RFC_Loc090_RCS 9;
BA_ "GenSigStartValue" SG_ 445 RFC_Loc090_RCS 32768;
BA_ "GenSigSendType" SG_ 445 RFC_Loc090_RSSI 9;
BA_ "GenSigSendType" SG_ 445 RFC_Loc091_Dr 9;
BA_ "GenSigSendType" SG_ 445 RFC_Loc091_Vr 9;
BA_ "GenSigStartValue" SG_ 445 RFC_Loc091_Vr 32768;
BA_ "GenSigSendType" SG_ 445 RFC_Loc091_Theta 9;
BA_ "GenSigStartValue" SG_ 445 RFC_Loc091_Theta 32768;
BA_ "GenSigSendType" SG_ 445 RFC_Loc091_Phi 9;
BA_ "GenSigStartValue" SG_ 445 RFC_Loc091_Phi 32768;
BA_ "GenSigSendType" SG_ 445 RFC_Loc091_DrVnce 9;
BA_ "GenSigSendType" SG_ 445 RFC_Loc091_VrVnce 9;
BA_ "GenSigSendType" SG_ 445 RFC_Loc091_ThetaVnce 9;
BA_ "GenSigSendType" SG_ 445 RFC_Loc091_PhiVnce 9;
BA_ "GenSigSendType" SG_ 445 RFC_Loc091_RCS 9;
BA_ "GenSigStartValue" SG_ 445 RFC_Loc091_RCS 32768;
BA_ "GenSigSendType" SG_ 445 RFC_Loc091_RSSI 9;
BA_ "GenSigSendType" SG_ 446 RFC_Loc092_CRC 9;
BA_ "GenSigSendType" SG_ 446 RFC_Loc092_AliveCtr 9;
BA_ "GenSigSendType" SG_ 446 RFC_Loc092_ProtBlockCtr 9;
BA_ "GenSigSendType" SG_ 446 RFC_Loc092_Dr 9;
BA_ "GenSigSendType" SG_ 446 RFC_Loc092_Vr 9;
BA_ "GenSigStartValue" SG_ 446 RFC_Loc092_Vr 32768;
BA_ "GenSigSendType" SG_ 446 RFC_Loc092_Theta 9;
BA_ "GenSigStartValue" SG_ 446 RFC_Loc092_Theta 32768;
BA_ "GenSigSendType" SG_ 446 RFC_Loc092_Phi 9;
BA_ "GenSigStartValue" SG_ 446 RFC_Loc092_Phi 32768;
BA_ "GenSigSendType" SG_ 446 RFC_Loc092_DrVnce 9;
BA_ "GenSigSendType" SG_ 446 RFC_Loc092_VrVnce 9;
BA_ "GenSigSendType" SG_ 446 RFC_Loc092_ThetaVnce 9;
BA_ "GenSigSendType" SG_ 446 RFC_Loc092_PhiVnce 9;
BA_ "GenSigSendType" SG_ 446 RFC_Loc092_RCS 9;
BA_ "GenSigStartValue" SG_ 446 RFC_Loc092_RCS 32768;
BA_ "GenSigSendType" SG_ 446 RFC_Loc092_RSSI 9;
BA_ "GenSigSendType" SG_ 446 RFC_Loc093_Dr 9;
BA_ "GenSigSendType" SG_ 446 RFC_Loc093_Vr 9;
BA_ "GenSigStartValue" SG_ 446 RFC_Loc093_Vr 32768;
BA_ "GenSigSendType" SG_ 446 RFC_Loc093_Theta 9;
BA_ "GenSigStartValue" SG_ 446 RFC_Loc093_Theta 32768;
BA_ "GenSigSendType" SG_ 446 RFC_Loc093_Phi 9;
BA_ "GenSigStartValue" SG_ 446 RFC_Loc093_Phi 32768;
BA_ "GenSigSendType" SG_ 446 RFC_Loc093_DrVnce 9;
BA_ "GenSigSendType" SG_ 446 RFC_Loc093_VrVnce 9;
BA_ "GenSigSendType" SG_ 446 RFC_Loc093_ThetaVnce 9;
BA_ "GenSigSendType" SG_ 446 RFC_Loc093_PhiVnce 9;
BA_ "GenSigSendType" SG_ 446 RFC_Loc093_RCS 9;
BA_ "GenSigStartValue" SG_ 446 RFC_Loc093_RCS 32768;
BA_ "GenSigSendType" SG_ 446 RFC_Loc093_RSSI 9;
BA_ "GenSigSendType" SG_ 447 RFC_Loc094_CRC 9;
BA_ "GenSigSendType" SG_ 447 RFC_Loc094_AliveCtr 9;
BA_ "GenSigSendType" SG_ 447 RFC_Loc094_ProtBlockCtr 9;
BA_ "GenSigSendType" SG_ 447 RFC_Loc094_Dr 9;
BA_ "GenSigSendType" SG_ 447 RFC_Loc094_Vr 9;
BA_ "GenSigStartValue" SG_ 447 RFC_Loc094_Vr 32768;
BA_ "GenSigSendType" SG_ 447 RFC_Loc094_Theta 9;
BA_ "GenSigStartValue" SG_ 447 RFC_Loc094_Theta 32768;
BA_ "GenSigSendType" SG_ 447 RFC_Loc094_Phi 9;
BA_ "GenSigStartValue" SG_ 447 RFC_Loc094_Phi 32768;
BA_ "GenSigSendType" SG_ 447 RFC_Loc094_DrVnce 9;
BA_ "GenSigSendType" SG_ 447 RFC_Loc094_VrVnce 9;
BA_ "GenSigSendType" SG_ 447 RFC_Loc094_ThetaVnce 9;
BA_ "GenSigSendType" SG_ 447 RFC_Loc094_PhiVnce 9;
BA_ "GenSigSendType" SG_ 447 RFC_Loc094_RCS 9;
BA_ "GenSigStartValue" SG_ 447 RFC_Loc094_RCS 32768;
BA_ "GenSigSendType" SG_ 447 RFC_Loc094_RSSI 9;
BA_ "GenSigSendType" SG_ 447 RFC_Loc095_Dr 9;
BA_ "GenSigSendType" SG_ 447 RFC_Loc095_Vr 9;
BA_ "GenSigStartValue" SG_ 447 RFC_Loc095_Vr 32768;
BA_ "GenSigSendType" SG_ 447 RFC_Loc095_Theta 9;
BA_ "GenSigStartValue" SG_ 447 RFC_Loc095_Theta 32768;
BA_ "GenSigSendType" SG_ 447 RFC_Loc095_Phi 9;
BA_ "GenSigStartValue" SG_ 447 RFC_Loc095_Phi 32768;
BA_ "GenSigSendType" SG_ 447 RFC_Loc095_DrVnce 9;
BA_ "GenSigSendType" SG_ 447 RFC_Loc095_VrVnce 9;
BA_ "GenSigSendType" SG_ 447 RFC_Loc095_ThetaVnce 9;
BA_ "GenSigSendType" SG_ 447 RFC_Loc095_PhiVnce 9;
BA_ "GenSigSendType" SG_ 447 RFC_Loc095_RCS 9;
BA_ "GenSigStartValue" SG_ 447 RFC_Loc095_RCS 32768;
BA_ "GenSigSendType" SG_ 447 RFC_Loc095_RSSI 9;
BA_ "GenSigSendType" SG_ 448 RFC_Loc096_CRC 9;
BA_ "GenSigSendType" SG_ 448 RFC_Loc096_AliveCtr 9;
BA_ "GenSigSendType" SG_ 448 RFC_Loc096_ProtBlockCtr 9;
BA_ "GenSigSendType" SG_ 448 RFC_Loc096_Dr 9;
BA_ "GenSigSendType" SG_ 448 RFC_Loc096_Vr 9;
BA_ "GenSigStartValue" SG_ 448 RFC_Loc096_Vr 32768;
BA_ "GenSigSendType" SG_ 448 RFC_Loc096_Theta 9;
BA_ "GenSigStartValue" SG_ 448 RFC_Loc096_Theta 32768;
BA_ "GenSigSendType" SG_ 448 RFC_Loc096_Phi 9;
BA_ "GenSigStartValue" SG_ 448 RFC_Loc096_Phi 32768;
BA_ "GenSigSendType" SG_ 448 RFC_Loc096_DrVnce 9;
BA_ "GenSigSendType" SG_ 448 RFC_Loc096_VrVnce 9;
BA_ "GenSigSendType" SG_ 448 RFC_Loc096_ThetaVnce 9;
BA_ "GenSigSendType" SG_ 448 RFC_Loc096_PhiVnce 9;
BA_ "GenSigSendType" SG_ 448 RFC_Loc096_RCS 9;
BA_ "GenSigStartValue" SG_ 448 RFC_Loc096_RCS 32768;
BA_ "GenSigSendType" SG_ 448 RFC_Loc096_RSSI 9;
BA_ "GenSigSendType" SG_ 448 RFC_Loc097_Dr 9;
BA_ "GenSigSendType" SG_ 448 RFC_Loc097_Vr 9;
BA_ "GenSigStartValue" SG_ 448 RFC_Loc097_Vr 32768;
BA_ "GenSigSendType" SG_ 448 RFC_Loc097_Theta 9;
BA_ "GenSigStartValue" SG_ 448 RFC_Loc097_Theta 32768;
BA_ "GenSigSendType" SG_ 448 RFC_Loc097_Phi 9;
BA_ "GenSigStartValue" SG_ 448 RFC_Loc097_Phi 32768;
BA_ "GenSigSendType" SG_ 448 RFC_Loc097_DrVnce 9;
BA_ "GenSigSendType" SG_ 448 RFC_Loc097_VrVnce 9;
BA_ "GenSigSendType" SG_ 448 RFC_Loc097_ThetaVnce 9;
BA_ "GenSigSendType" SG_ 448 RFC_Loc097_PhiVnce 9;
BA_ "GenSigSendType" SG_ 448 RFC_Loc097_RCS 9;
BA_ "GenSigStartValue" SG_ 448 RFC_Loc097_RCS 32768;
BA_ "GenSigSendType" SG_ 448 RFC_Loc097_RSSI 9;
BA_ "GenSigSendType" SG_ 449 RFC_Loc098_CRC 9;
BA_ "GenSigSendType" SG_ 449 RFC_Loc098_AliveCtr 9;
BA_ "GenSigSendType" SG_ 449 RFC_Loc098_ProtBlockCtr 9;
BA_ "GenSigSendType" SG_ 449 RFC_Loc098_Dr 9;
BA_ "GenSigSendType" SG_ 449 RFC_Loc098_Vr 9;
BA_ "GenSigStartValue" SG_ 449 RFC_Loc098_Vr 32768;
BA_ "GenSigSendType" SG_ 449 RFC_Loc098_Theta 9;
BA_ "GenSigStartValue" SG_ 449 RFC_Loc098_Theta 32768;
BA_ "GenSigSendType" SG_ 449 RFC_Loc098_Phi 9;
BA_ "GenSigStartValue" SG_ 449 RFC_Loc098_Phi 32768;
BA_ "GenSigSendType" SG_ 449 RFC_Loc098_DrVnce 9;
BA_ "GenSigSendType" SG_ 449 RFC_Loc098_VrVnce 9;
BA_ "GenSigSendType" SG_ 449 RFC_Loc098_ThetaVnce 9;
BA_ "GenSigSendType" SG_ 449 RFC_Loc098_PhiVnce 9;
BA_ "GenSigSendType" SG_ 449 RFC_Loc098_RCS 9;
BA_ "GenSigStartValue" SG_ 449 RFC_Loc098_RCS 32768;
BA_ "GenSigSendType" SG_ 449 RFC_Loc098_RSSI 9;
BA_ "GenSigSendType" SG_ 449 RFC_Loc099_Dr 9;
BA_ "GenSigSendType" SG_ 449 RFC_Loc099_Vr 9;
BA_ "GenSigStartValue" SG_ 449 RFC_Loc099_Vr 32768;
BA_ "GenSigSendType" SG_ 449 RFC_Loc099_Theta 9;
BA_ "GenSigStartValue" SG_ 449 RFC_Loc099_Theta 32768;
BA_ "GenSigSendType" SG_ 449 RFC_Loc099_Phi 9;
BA_ "GenSigStartValue" SG_ 449 RFC_Loc099_Phi 32768;
BA_ "GenSigSendType" SG_ 449 RFC_Loc099_DrVnce 9;
BA_ "GenSigSendType" SG_ 449 RFC_Loc099_VrVnce 9;
BA_ "GenSigSendType" SG_ 449 RFC_Loc099_ThetaVnce 9;
BA_ "GenSigSendType" SG_ 449 RFC_Loc099_PhiVnce 9;
BA_ "GenSigSendType" SG_ 449 RFC_Loc099_RCS 9;
BA_ "GenSigStartValue" SG_ 449 RFC_Loc099_RCS 32768;
BA_ "GenSigSendType" SG_ 449 RFC_Loc099_RSSI 9;
BA_ "GenSigSendType" SG_ 450 RFC_Loc100_CRC 9;
BA_ "GenSigSendType" SG_ 450 RFC_Loc100_AliveCtr 9;
BA_ "GenSigSendType" SG_ 450 RFC_Loc100_ProtBlockCtr 9;
BA_ "GenSigSendType" SG_ 450 RFC_Loc100_Dr 9;
BA_ "GenSigSendType" SG_ 450 RFC_Loc100_Vr 9;
BA_ "GenSigStartValue" SG_ 450 RFC_Loc100_Vr 32768;
BA_ "GenSigSendType" SG_ 450 RFC_Loc100_Theta 9;
BA_ "GenSigStartValue" SG_ 450 RFC_Loc100_Theta 32768;
BA_ "GenSigSendType" SG_ 450 RFC_Loc100_Phi 9;
BA_ "GenSigStartValue" SG_ 450 RFC_Loc100_Phi 32768;
BA_ "GenSigSendType" SG_ 450 RFC_Loc100_DrVnce 9;
BA_ "GenSigSendType" SG_ 450 RFC_Loc100_VrVnce 9;
BA_ "GenSigSendType" SG_ 450 RFC_Loc100_ThetaVnce 9;
BA_ "GenSigSendType" SG_ 450 RFC_Loc100_PhiVnce 9;
BA_ "GenSigSendType" SG_ 450 RFC_Loc100_RCS 9;
BA_ "GenSigStartValue" SG_ 450 RFC_Loc100_RCS 32768;
BA_ "GenSigSendType" SG_ 450 RFC_Loc100_RSSI 9;
BA_ "GenSigSendType" SG_ 450 RFC_Loc101_Dr 9;
BA_ "GenSigSendType" SG_ 450 RFC_Loc101_Vr 9;
BA_ "GenSigStartValue" SG_ 450 RFC_Loc101_Vr 32768;
BA_ "GenSigSendType" SG_ 450 RFC_Loc101_Theta 9;
BA_ "GenSigStartValue" SG_ 450 RFC_Loc101_Theta 32768;
BA_ "GenSigSendType" SG_ 450 RFC_Loc101_Phi 9;
BA_ "GenSigStartValue" SG_ 450 RFC_Loc101_Phi 32768;
BA_ "GenSigSendType" SG_ 450 RFC_Loc101_DrVnce 9;
BA_ "GenSigSendType" SG_ 450 RFC_Loc101_VrVnce 9;
BA_ "GenSigSendType" SG_ 450 RFC_Loc101_ThetaVnce 9;
BA_ "GenSigSendType" SG_ 450 RFC_Loc101_PhiVnce 9;
BA_ "GenSigSendType" SG_ 450 RFC_Loc101_RCS 9;
BA_ "GenSigStartValue" SG_ 450 RFC_Loc101_RCS 32768;
BA_ "GenSigSendType" SG_ 450 RFC_Loc101_RSSI 9;
BA_ "GenSigSendType" SG_ 451 RFC_Loc102_CRC 9;
BA_ "GenSigSendType" SG_ 451 RFC_Loc102_AliveCtr 9;
BA_ "GenSigSendType" SG_ 451 RFC_Loc102_ProtBlockCtr 9;
BA_ "GenSigSendType" SG_ 451 RFC_Loc102_Dr 9;
BA_ "GenSigSendType" SG_ 451 RFC_Loc102_Vr 9;
BA_ "GenSigStartValue" SG_ 451 RFC_Loc102_Vr 32768;
BA_ "GenSigSendType" SG_ 451 RFC_Loc102_Theta 9;
BA_ "GenSigStartValue" SG_ 451 RFC_Loc102_Theta 32768;
BA_ "GenSigSendType" SG_ 451 RFC_Loc102_Phi 9;
BA_ "GenSigStartValue" SG_ 451 RFC_Loc102_Phi 32768;
BA_ "GenSigSendType" SG_ 451 RFC_Loc102_DrVnce 9;
BA_ "GenSigSendType" SG_ 451 RFC_Loc102_VrVnce 9;
BA_ "GenSigSendType" SG_ 451 RFC_Loc102_ThetaVnce 9;
BA_ "GenSigSendType" SG_ 451 RFC_Loc102_PhiVnce 9;
BA_ "GenSigSendType" SG_ 451 RFC_Loc102_RCS 9;
BA_ "GenSigStartValue" SG_ 451 RFC_Loc102_RCS 32768;
BA_ "GenSigSendType" SG_ 451 RFC_Loc102_RSSI 9;
BA_ "GenSigSendType" SG_ 451 RFC_Loc103_Dr 9;
BA_ "GenSigSendType" SG_ 451 RFC_Loc103_Vr 9;
BA_ "GenSigStartValue" SG_ 451 RFC_Loc103_Vr 32768;
BA_ "GenSigSendType" SG_ 451 RFC_Loc103_Theta 9;
BA_ "GenSigStartValue" SG_ 451 RFC_Loc103_Theta 32768;
BA_ "GenSigSendType" SG_ 451 RFC_Loc103_Phi 9;
BA_ "GenSigStartValue" SG_ 451 RFC_Loc103_Phi 32768;
BA_ "GenSigSendType" SG_ 451 RFC_Loc103_DrVnce 9;
BA_ "GenSigSendType" SG_ 451 RFC_Loc103_VrVnce 9;
BA_ "GenSigSendType" SG_ 451 RFC_Loc103_ThetaVnce 9;
BA_ "GenSigSendType" SG_ 451 RFC_Loc103_PhiVnce 9;
BA_ "GenSigSendType" SG_ 451 RFC_Loc103_RCS 9;
BA_ "GenSigStartValue" SG_ 451 RFC_Loc103_RCS 32768;
BA_ "GenSigSendType" SG_ 451 RFC_Loc103_RSSI 9;
BA_ "GenSigSendType" SG_ 452 RFC_Loc104_CRC 9;
BA_ "GenSigSendType" SG_ 452 RFC_Loc104_AliveCtr 9;
BA_ "GenSigSendType" SG_ 452 RFC_Loc104_ProtBlockCtr 9;
BA_ "GenSigSendType" SG_ 452 RFC_Loc104_Dr 9;
BA_ "GenSigSendType" SG_ 452 RFC_Loc104_Vr 9;
BA_ "GenSigStartValue" SG_ 452 RFC_Loc104_Vr 32768;
BA_ "GenSigSendType" SG_ 452 RFC_Loc104_Theta 9;
BA_ "GenSigStartValue" SG_ 452 RFC_Loc104_Theta 32768;
BA_ "GenSigSendType" SG_ 452 RFC_Loc104_Phi 9;
BA_ "GenSigStartValue" SG_ 452 RFC_Loc104_Phi 32768;
BA_ "GenSigSendType" SG_ 452 RFC_Loc104_DrVnce 9;
BA_ "GenSigSendType" SG_ 452 RFC_Loc104_VrVnce 9;
BA_ "GenSigSendType" SG_ 452 RFC_Loc104_ThetaVnce 9;
BA_ "GenSigSendType" SG_ 452 RFC_Loc104_PhiVnce 9;
BA_ "GenSigSendType" SG_ 452 RFC_Loc104_RCS 9;
BA_ "GenSigStartValue" SG_ 452 RFC_Loc104_RCS 32768;
BA_ "GenSigSendType" SG_ 452 RFC_Loc104_RSSI 9;
BA_ "GenSigSendType" SG_ 452 RFC_Loc105_Dr 9;
BA_ "GenSigSendType" SG_ 452 RFC_Loc105_Vr 9;
BA_ "GenSigStartValue" SG_ 452 RFC_Loc105_Vr 32768;
BA_ "GenSigSendType" SG_ 452 RFC_Loc105_Theta 9;
BA_ "GenSigStartValue" SG_ 452 RFC_Loc105_Theta 32768;
BA_ "GenSigSendType" SG_ 452 RFC_Loc105_Phi 9;
BA_ "GenSigStartValue" SG_ 452 RFC_Loc105_Phi 32768;
BA_ "GenSigSendType" SG_ 452 RFC_Loc105_DrVnce 9;
BA_ "GenSigSendType" SG_ 452 RFC_Loc105_VrVnce 9;
BA_ "GenSigSendType" SG_ 452 RFC_Loc105_ThetaVnce 9;
BA_ "GenSigSendType" SG_ 452 RFC_Loc105_PhiVnce 9;
BA_ "GenSigSendType" SG_ 452 RFC_Loc105_RCS 9;
BA_ "GenSigStartValue" SG_ 452 RFC_Loc105_RCS 32768;
BA_ "GenSigSendType" SG_ 452 RFC_Loc105_RSSI 9;
BA_ "GenSigSendType" SG_ 453 RFC_Loc106_CRC 9;
BA_ "GenSigSendType" SG_ 453 RFC_Loc106_AliveCtr 9;
BA_ "GenSigSendType" SG_ 453 RFC_Loc106_ProtBlockCtr 9;
BA_ "GenSigSendType" SG_ 453 RFC_Loc106_Dr 9;
BA_ "GenSigSendType" SG_ 453 RFC_Loc106_Vr 9;
BA_ "GenSigStartValue" SG_ 453 RFC_Loc106_Vr 32768;
BA_ "GenSigSendType" SG_ 453 RFC_Loc106_Theta 9;
BA_ "GenSigStartValue" SG_ 453 RFC_Loc106_Theta 32768;
BA_ "GenSigSendType" SG_ 453 RFC_Loc106_Phi 9;
BA_ "GenSigStartValue" SG_ 453 RFC_Loc106_Phi 32768;
BA_ "GenSigSendType" SG_ 453 RFC_Loc106_DrVnce 9;
BA_ "GenSigSendType" SG_ 453 RFC_Loc106_VrVnce 9;
BA_ "GenSigSendType" SG_ 453 RFC_Loc106_ThetaVnce 9;
BA_ "GenSigSendType" SG_ 453 RFC_Loc106_PhiVnce 9;
BA_ "GenSigSendType" SG_ 453 RFC_Loc106_RCS 9;
BA_ "GenSigStartValue" SG_ 453 RFC_Loc106_RCS 32768;
BA_ "GenSigSendType" SG_ 453 RFC_Loc106_RSSI 9;
BA_ "GenSigSendType" SG_ 453 RFC_Loc107_Dr 9;
BA_ "GenSigSendType" SG_ 453 RFC_Loc107_Vr 9;
BA_ "GenSigStartValue" SG_ 453 RFC_Loc107_Vr 32768;
BA_ "GenSigSendType" SG_ 453 RFC_Loc107_Theta 9;
BA_ "GenSigStartValue" SG_ 453 RFC_Loc107_Theta 32768;
BA_ "GenSigSendType" SG_ 453 RFC_Loc107_Phi 9;
BA_ "GenSigStartValue" SG_ 453 RFC_Loc107_Phi 32768;
BA_ "GenSigSendType" SG_ 453 RFC_Loc107_DrVnce 9;
BA_ "GenSigSendType" SG_ 453 RFC_Loc107_VrVnce 9;
BA_ "GenSigSendType" SG_ 453 RFC_Loc107_ThetaVnce 9;
BA_ "GenSigSendType" SG_ 453 RFC_Loc107_PhiVnce 9;
BA_ "GenSigSendType" SG_ 453 RFC_Loc107_RCS 9;
BA_ "GenSigStartValue" SG_ 453 RFC_Loc107_RCS 32768;
BA_ "GenSigSendType" SG_ 453 RFC_Loc107_RSSI 9;
BA_ "GenSigSendType" SG_ 454 RFC_Loc108_CRC 9;
BA_ "GenSigSendType" SG_ 454 RFC_Loc108_AliveCtr 9;
BA_ "GenSigSendType" SG_ 454 RFC_Loc108_ProtBlockCtr 9;
BA_ "GenSigSendType" SG_ 454 RFC_Loc108_Dr 9;
BA_ "GenSigSendType" SG_ 454 RFC_Loc108_Vr 9;
BA_ "GenSigStartValue" SG_ 454 RFC_Loc108_Vr 32768;
BA_ "GenSigSendType" SG_ 454 RFC_Loc108_Theta 9;
BA_ "GenSigStartValue" SG_ 454 RFC_Loc108_Theta 32768;
BA_ "GenSigSendType" SG_ 454 RFC_Loc108_Phi 9;
BA_ "GenSigStartValue" SG_ 454 RFC_Loc108_Phi 32768;
BA_ "GenSigSendType" SG_ 454 RFC_Loc108_DrVnce 9;
BA_ "GenSigSendType" SG_ 454 RFC_Loc108_VrVnce 9;
BA_ "GenSigSendType" SG_ 454 RFC_Loc108_ThetaVnce 9;
BA_ "GenSigSendType" SG_ 454 RFC_Loc108_PhiVnce 9;
BA_ "GenSigSendType" SG_ 454 RFC_Loc108_RCS 9;
BA_ "GenSigStartValue" SG_ 454 RFC_Loc108_RCS 32768;
BA_ "GenSigSendType" SG_ 454 RFC_Loc108_RSSI 9;
BA_ "GenSigSendType" SG_ 454 RFC_Loc109_Dr 9;
BA_ "GenSigSendType" SG_ 454 RFC_Loc109_Vr 9;
BA_ "GenSigStartValue" SG_ 454 RFC_Loc109_Vr 32768;
BA_ "GenSigSendType" SG_ 454 RFC_Loc109_Theta 9;
BA_ "GenSigStartValue" SG_ 454 RFC_Loc109_Theta 32768;
BA_ "GenSigSendType" SG_ 454 RFC_Loc109_Phi 9;
BA_ "GenSigStartValue" SG_ 454 RFC_Loc109_Phi 32768;
BA_ "GenSigSendType" SG_ 454 RFC_Loc109_DrVnce 9;
BA_ "GenSigSendType" SG_ 454 RFC_Loc109_VrVnce 9;
BA_ "GenSigSendType" SG_ 454 RFC_Loc109_ThetaVnce 9;
BA_ "GenSigSendType" SG_ 454 RFC_Loc109_PhiVnce 9;
BA_ "GenSigSendType" SG_ 454 RFC_Loc109_RCS 9;
BA_ "GenSigStartValue" SG_ 454 RFC_Loc109_RCS 32768;
BA_ "GenSigSendType" SG_ 454 RFC_Loc109_RSSI 9;
BA_ "GenSigSendType" SG_ 455 RFC_Loc110_CRC 9;
BA_ "GenSigSendType" SG_ 455 RFC_Loc110_AliveCtr 9;
BA_ "GenSigSendType" SG_ 455 RFC_Loc110_ProtBlockCtr 9;
BA_ "GenSigSendType" SG_ 455 RFC_Loc110_Dr 9;
BA_ "GenSigSendType" SG_ 455 RFC_Loc110_Vr 9;
BA_ "GenSigStartValue" SG_ 455 RFC_Loc110_Vr 32768;
BA_ "GenSigSendType" SG_ 455 RFC_Loc110_Theta 9;
BA_ "GenSigStartValue" SG_ 455 RFC_Loc110_Theta 32768;
BA_ "GenSigSendType" SG_ 455 RFC_Loc110_Phi 9;
BA_ "GenSigStartValue" SG_ 455 RFC_Loc110_Phi 32768;
BA_ "GenSigSendType" SG_ 455 RFC_Loc110_DrVnce 9;
BA_ "GenSigSendType" SG_ 455 RFC_Loc110_VrVnce 9;
BA_ "GenSigSendType" SG_ 455 RFC_Loc110_ThetaVnce 9;
BA_ "GenSigSendType" SG_ 455 RFC_Loc110_PhiVnce 9;
BA_ "GenSigSendType" SG_ 455 RFC_Loc110_RCS 9;
BA_ "GenSigStartValue" SG_ 455 RFC_Loc110_RCS 32768;
BA_ "GenSigSendType" SG_ 455 RFC_Loc110_RSSI 9;
BA_ "GenSigSendType" SG_ 455 RFC_Loc111_Dr 9;
BA_ "GenSigSendType" SG_ 455 RFC_Loc111_Vr 9;
BA_ "GenSigStartValue" SG_ 455 RFC_Loc111_Vr 32768;
BA_ "GenSigSendType" SG_ 455 RFC_Loc111_Theta 9;
BA_ "GenSigStartValue" SG_ 455 RFC_Loc111_Theta 32768;
BA_ "GenSigSendType" SG_ 455 RFC_Loc111_Phi 9;
BA_ "GenSigStartValue" SG_ 455 RFC_Loc111_Phi 32768;
BA_ "GenSigSendType" SG_ 455 RFC_Loc111_DrVnce 9;
BA_ "GenSigSendType" SG_ 455 RFC_Loc111_VrVnce 9;
BA_ "GenSigSendType" SG_ 455 RFC_Loc111_ThetaVnce 9;
BA_ "GenSigSendType" SG_ 455 RFC_Loc111_PhiVnce 9;
BA_ "GenSigSendType" SG_ 455 RFC_Loc111_RCS 9;
BA_ "GenSigStartValue" SG_ 455 RFC_Loc111_RCS 32768;
BA_ "GenSigSendType" SG_ 455 RFC_Loc111_RSSI 9;
BA_ "GenSigSendType" SG_ 456 RFC_Loc112_CRC 9;
BA_ "GenSigSendType" SG_ 456 RFC_Loc112_AliveCtr 9;
BA_ "GenSigSendType" SG_ 456 RFC_Loc112_ProtBlockCtr 9;
BA_ "GenSigSendType" SG_ 456 RFC_Loc112_Dr 9;
BA_ "GenSigSendType" SG_ 456 RFC_Loc112_Vr 9;
BA_ "GenSigStartValue" SG_ 456 RFC_Loc112_Vr 32768;
BA_ "GenSigSendType" SG_ 456 RFC_Loc112_Theta 9;
BA_ "GenSigStartValue" SG_ 456 RFC_Loc112_Theta 32768;
BA_ "GenSigSendType" SG_ 456 RFC_Loc112_Phi 9;
BA_ "GenSigStartValue" SG_ 456 RFC_Loc112_Phi 32768;
BA_ "GenSigSendType" SG_ 456 RFC_Loc112_DrVnce 9;
BA_ "GenSigSendType" SG_ 456 RFC_Loc112_VrVnce 9;
BA_ "GenSigSendType" SG_ 456 RFC_Loc112_ThetaVnce 9;
BA_ "GenSigSendType" SG_ 456 RFC_Loc112_PhiVnce 9;
BA_ "GenSigSendType" SG_ 456 RFC_Loc112_RCS 9;
BA_ "GenSigStartValue" SG_ 456 RFC_Loc112_RCS 32768;
BA_ "GenSigSendType" SG_ 456 RFC_Loc112_RSSI 9;
BA_ "GenSigSendType" SG_ 456 RFC_Loc113_Dr 9;
BA_ "GenSigSendType" SG_ 456 RFC_Loc113_Vr 9;
BA_ "GenSigStartValue" SG_ 456 RFC_Loc113_Vr 32768;
BA_ "GenSigSendType" SG_ 456 RFC_Loc113_Theta 9;
BA_ "GenSigStartValue" SG_ 456 RFC_Loc113_Theta 32768;
BA_ "GenSigSendType" SG_ 456 RFC_Loc113_Phi 9;
BA_ "GenSigStartValue" SG_ 456 RFC_Loc113_Phi 32768;
BA_ "GenSigSendType" SG_ 456 RFC_Loc113_DrVnce 9;
BA_ "GenSigSendType" SG_ 456 RFC_Loc113_VrVnce 9;
BA_ "GenSigSendType" SG_ 456 RFC_Loc113_ThetaVnce 9;
BA_ "GenSigSendType" SG_ 456 RFC_Loc113_PhiVnce 9;
BA_ "GenSigSendType" SG_ 456 RFC_Loc113_RCS 9;
BA_ "GenSigStartValue" SG_ 456 RFC_Loc113_RCS 32768;
BA_ "GenSigSendType" SG_ 456 RFC_Loc113_RSSI 9;
